
/* DO NOT EDIT!  This is an autogenerated file.  See scripts/layoutrom.py. */
OUTPUT_FORMAT("elf32-i386")
OUTPUT_ARCH("i386")
SECTIONS
{
Call16Data = 0xfadc ;
ExtraStack = 0xf2d8 ;
sercon_split = 0xf292 ;
rx_bytes = 0xf279 ;
rx_buf = 0xf27c ;
DebugOutputPort = 0x5f74 ;
cdemu_drive_gf = 0x5fc8 ;
CDEmu = 0xf2ac ;
RTCusers = 0xf270 ;
FloppyCount = 0x60a0 ;
diskette_param_table2 = 0x5f5c ;
FloppyDOR = 0xf260 ;
TimerPort = 0x5f78 ;
ShiftTSC = 0x5f76 ;
TimerLast = 0xf274 ;
TimerKHz = 0x5f7c ;
sercon_row_last = 0xf28e ;
DefaultDPTE = 0xf2c0 ;
StackPos = 0xf2d0 ;
HaveSmmCall32 = 0x60b4 ;
_cfunc32flat_xhci_poll_intr = 0xee676 ;
_cfunc32flat_call32_params_helper = 0xecc7a ;
_cfunc16__farcall16 = 0x8223 ;
CDRom_locks = 0xf298 ;
_cfunc16_check_irqs = 0x8a24 ;
sercon_port = 0xf294 ;
sercon_attr_last = 0xf290 ;
sercon_char = 0xf28d ;
sercon_attr = 0xf28c ;
sercon_col_last = 0xf28f ;
reply_msg = 0xf25c ;
Ps2ctr = 0xf26c ;
keyboards = 0x5f70 ;
mice = 0x5f6c ;
FloppyInfo = 0x5f00 ;
_cfunc32flat_process_op_32 = 0xecc8a ;
emulated_drive_gf = 0xf2a8 ;
bounce_buf_fl = 0x5fcc ;
IDMap = 0x5fe0 ;
_cfunc16_wait_irq = 0xb799 ;
acpi_pm1a_cnt = 0x54c4 ;
_cfunc16_invoke_mouse_handler = 0xbae3 ;
VGAHookHandlerType = 0x5f9c ;
ViaFBsize = 0x5f98 ;
ViaRamSpeed = 0x5f94 ;
IntelDisplayType = 0x5f92 ;
IntelDisplayId = 0x5f91 ;
SmiBootDisplay = 0x5f90 ;
HaveRunPost = 0x6108 ;
pmode_IDT_info = 0x60f8 ;
rmode_IDT_info = 0x6100 ;
LegacyRamSize = 0x54e0 ;
BIOS_CONFIG_TABLE = 0xe6f5 ;
e820_count = 0x54e4 ;
e820_list = 0x5500 ;
sercon_enable = 0xf291 ;
_cfunc32flat_tpm_interrupt_handler32 = 0xee366 ;
Century = 0xf278 ;
LastUSBkey = 0xf264 ;
CanPreempt = 0x60a4 ;
MainThread = 0x60a8 ;
_cfunc32flat_yield_preempt = 0xe1458 ;
_cfunc32flat_handle_resume32 = 0xedec6 ;
MaxPCIBus = 0x54cc ;
PirAddr = 0x54c8 ;
rombios32_gdt_48 = 0x60b8 ;
_cfunc32flat_handle_smi = 0xee6e1 ;
SMPLock = 0xf49c0 ;
SMPStack = 0xf49bc ;
_cfunc32flat_handle_smp = 0xee94a ;
_cfunc32flat_handle_pmm = 0xe6a19 ;
_cfunc32seg_handle_apm = 0x68ba ;
_cfunc32seg_handle_pcibios = 0x6594 ;
sercon_real_vga_handler = 0x5fc4 ;
_cfunc32flat_handle_19 = 0xee33c ;
_cfunc32flat_handle_18 = 0xee310 ;
_cfunc32flat_handle_post = 0xee22b ;

    zonelow_base = 0xd8000 ;
    _zonelow_seg = 0xd800 ;

.text.set_a20 0x6a60 : { *(.text.set_a20) }
.text.set_code_success 0x6a80 : { *(.text.set_code_success) }
.text.pic_eoi2 0x6a8c : { *(.text.pic_eoi2) }
.text.call32_prep 0x6a94 : { *(.text.call32_prep) }
.text.need_hop_back 0x6b2d : { *(.text.need_hop_back) }
.text.enqueue_key 0x6b52 : { *(.text.enqueue_key) }
.text.kbd_set_flag 0x6bac : { *(.text.kbd_set_flag) }
.text.cursor_pos_row 0x6c09 : { *(.text.cursor_pos_row) }
.text.sercon_cursor_pos_set 0xe6ff : { *(.text.sercon_cursor_pos_set) }
.text.shiftbuf 0x6c1b : { *(.text.shiftbuf) }
.text.irqtimer_check 0x6c61 : { *(.text.irqtimer_check) }
.text.qemu_debug_putc 0x6c9a : { *(.text.qemu_debug_putc) }
.text.ehci_reset_pipe 0xfeae : { *(.text.ehci_reset_pipe) }
.text.lba2chs 0x6ca6 : { *(.text.lba2chs) }
.text.getLCHS 0x6ced : { *(.text.getLCHS) }
.text.clear_usertimer 0x6d97 : { *(.text.clear_usertimer) }
.text.putsinglehex.constprop.0 0x6dd8 : { *(.text.putsinglehex.constprop.0) }
.text.puthex.constprop.0 0x6df9 : { *(.text.puthex.constprop.0) }
.text.call32_post 0x6ec4 : { *(.text.call32_post) }
.text.default_process_op.isra.0 0x6f67 : { *(.text.default_process_op.isra.0) }
.text.memset.isra.0 0x6f87 : { *(.text.memset.isra.0) }
.text.__disk_ret.constprop.0 0x6f96 : { *(.text.__disk_ret.constprop.0) }
.text.disk_1308 0x6fc5 : { *(.text.disk_1308) }
.text.disk_1315 0x70f1 : { *(.text.disk_1315) }
.text.handle_1524XX 0x7152 : { *(.text.handle_1524XX) }
.text.getComAddr 0x715e : { *(.text.getComAddr) }
.text.getLptAddr 0x7192 : { *(.text.getLptAddr) }
.text.floppy_dor_mask 0x71c7 : { *(.text.floppy_dor_mask) }
.text.floppy_disable_controller 0x71ea : { *(.text.floppy_disable_controller) }
.text.scsi_fill_cmd 0x71f6 : { *(.text.scsi_fill_cmd) }
.text.pci_next 0xff5d : { *(.text.pci_next) }
.text.putuint.constprop.0 0x72c2 : { *(.text.putuint.constprop.0) }
.text.bvprintf.constprop.0 0x7319 : { *(.text.bvprintf.constprop.0) }
.text.panic.constprop.0 0x761c : { *(.text.panic.constprop.0) }
.text.__dprintf 0x7632 : { *(.text.__dprintf) }
.text.dump_regs 0x7646 : { *(.text.dump_regs) }
.text.__warn_timeout 0x76dd : { *(.text.__warn_timeout) }
.text.disk_13XX.constprop.0 0x76f3 : { *(.text.disk_13XX.constprop.0) }
.text.rtc_setup 0xfe7e : { *(.text.rtc_setup) }
.text.set_usertimer 0x7720 : { *(.text.set_usertimer) }
.text.timer_read 0x7799 : { *(.text.timer_read) }
.text.timer_calc 0x7836 : { *(.text.timer_calc) }
.text.timer_calc_usec 0x7852 : { *(.text.timer_calc_usec) }
.text.timer_check 0x7882 : { *(.text.timer_check) }
.text.udelay 0x789e : { *(.text.udelay) }
.text.i8042_wait_write 0x78bf : { *(.text.i8042_wait_write) }
.text.__i8042_command 0x7907 : { *(.text.__i8042_command) }
.text.sercon_lazy_lf 0xff00 : { *(.text.sercon_lazy_lf) }
.text.fill_generic_edd 0x794d : { *(.text.fill_generic_edd) }
.text.fill_edd 0xe079 : { *(.text.fill_edd) }
.text.__stack_hop_back.isra.0 0x7ca8 : { *(.text.__stack_hop_back.isra.0) }
.text.handle_12 0x7d04 : { *(.text.handle_12) }
.text.handle_11 0x7d17 : { *(.text.handle_11) }
.text.handle_05 0x7d2a : { *(.text.handle_05) }
.text.handle_02 0x7d50 : { *(.text.handle_02) }
.text.call16_helper 0x7d75 : { *(.text.call16_helper) }
.text.__call32 0x7db5 : { *(.text.__call32) }
.text.__call32_params.constprop.0 0x7e79 : { *(.text.__call32_params.constprop.0) }
.text.usb_poll_intr 0x7ec0 : { *(.text.usb_poll_intr) }
.text._farcall16 0x8223 : { *(.text._farcall16) }
.text.__call16_int 0x826e : { *(.text.__call16_int) }
.text.handle_75 0x8281 : { *(.text.handle_75) }
.text.process_key 0x82ed : { *(.text.process_key) }
.text.prockeys 0x86dd : { *(.text.prockeys) }
.text.procmodkey 0x8754 : { *(.text.procmodkey) }
.text.procscankey 0x87a9 : { *(.text.procscankey) }
.text.ramdisk_copy 0x87cf : { *(.text.ramdisk_copy) }
.text.disk_1346.constprop.0 0x897e : { *(.text.disk_1346.constprop.0) }
.text.check_irqs 0x8a24 : { *(.text.check_irqs) }
.text.sercon_putchar 0x8a46 : { *(.text.sercon_putchar) }
.text.sercon_term_clear_screen 0x8ab1 : { *(.text.sercon_term_clear_screen) }
.text.sercon_print_utf8 0xefdb : { *(.text.sercon_print_utf8) }
.text.sercon_term_cursor_goto 0x8ade : { *(.text.sercon_term_cursor_goto) }
.text.sercon_set_attr 0x8b7d : { *(.text.sercon_set_attr) }
.text.sercon_lazy_flush 0xe2e8 : { *(.text.sercon_lazy_flush) }
.text.sercon_lazy_putchar 0x8c72 : { *(.text.sercon_lazy_putchar) }
.text.timer_sleep 0xf046 : { *(.text.timer_sleep) }
.text.usleep 0xfa63 : { *(.text.usleep) }
.text.lsi_scsi_process_op 0x8d27 : { *(.text.lsi_scsi_process_op) }
.text.esp_scsi_process_op 0xf869 : { *(.text.esp_scsi_process_op) }
.text.mpt_scsi_process_op 0x8f44 : { *(.text.mpt_scsi_process_op) }
.text.rtc_updating 0x9122 : { *(.text.rtc_updating) }
.text.ps2_recvbyte 0x916f : { *(.text.ps2_recvbyte) }
.text.ps2_sendbyte 0xf7cc : { *(.text.ps2_sendbyte) }
.text.__ps2_command 0xe411 : { *(.text.__ps2_command) }
.text.set_leds 0xef60 : { *(.text.set_leds) }
.text.mouse_command 0x9223 : { *(.text.mouse_command) }
.text.mouse_15c201 0x92ee : { *(.text.mouse_15c201) }
.text.handle_160a 0x932f : { *(.text.handle_160a) }
.text.uhci_waittick 0x9378 : { *(.text.uhci_waittick) }
.text.uhci_send_pipe.constprop.0 0x93d4 : { *(.text.uhci_send_pipe.constprop.0) }
.text.ehci_send_pipe.constprop.0 0xec62 : { *(.text.ehci_send_pipe.constprop.0) }
.text.usb_send_bulk 0x97ad : { *(.text.usb_send_bulk) }
.text.uas_process_op 0x97f9 : { *(.text.uas_process_op) }
.text.usb_process_op 0x9a1b : { *(.text.usb_process_op) }
.text.floppy_wait_irq 0xe674 : { *(.text.floppy_wait_irq) }
.text.floppy_pio 0x9ba4 : { *(.text.floppy_pio) }
.text.floppy_enable_controller 0x9cfd : { *(.text.floppy_enable_controller) }
.text.floppy_drive_pio 0x9d60 : { *(.text.floppy_drive_pio) }
.text.floppy_dma_cmd 0x9e0b : { *(.text.floppy_dma_cmd) }
.text.floppy_prep 0x9f45 : { *(.text.floppy_prep) }
.text.floppy_read 0xa281 : { *(.text.floppy_read) }
.text.floppy_write 0xa33a : { *(.text.floppy_write) }
.text.floppy_format 0xa3f3 : { *(.text.floppy_format) }
.text.megasas_process_op 0xf570 : { *(.text.megasas_process_op) }
.text.await_ide.constprop.0 0xa47b : { *(.text.await_ide.constprop.0) }
.text.await_not_bsy 0xa4ec : { *(.text.await_not_bsy) }
.text.ndelay_await_not_bsy 0xa4fc : { *(.text.ndelay_await_not_bsy) }
.text.ata_wait_data 0xa54c : { *(.text.ata_wait_data) }
.text.send_cmd 0xa578 : { *(.text.send_cmd) }
.text.ata_pio_transfer 0xa6a4 : { *(.text.ata_pio_transfer) }
.text.ata_readwrite 0xa7d7 : { *(.text.ata_readwrite) }
.text.ata_atapi_process_op 0xa95c : { *(.text.ata_atapi_process_op) }
.text.process_op 0xaadb : { *(.text.process_op) }
.text.cdemu_read 0xae62 : { *(.text.cdemu_read) }
.text.disk_1300 0xf066 : { *(.text.disk_1300) }
.text.basic_access 0xb090 : { *(.text.basic_access) }
.text.disk_1305 0xb1c6 : { *(.text.disk_1305) }
.text.disk_1310 0xb2e7 : { *(.text.disk_1310) }
.text.extended_access 0xb326 : { *(.text.extended_access) }
.text.disk_13 0xb3fb : { *(.text.disk_13) }
.text.handle_legacy_disk 0xb70c : { *(.text.handle_legacy_disk) }
.text.wait_irq 0xb799 : { *(.text.wait_irq) }
.text.dequeue_key 0xb7b9 : { *(.text.dequeue_key) }
.text.handle_1553 0xb896 : { *(.text.handle_1553) }
.text.handle_40 0xb9fe : { *(.text.handle_40) }
.text.handle_13 0xba30 : { *(.text.handle_13) }
.text.handle_76 0xbad2 : { *(.text.handle_76) }
.text.invoke_mouse_handler 0xbae3 : { *(.text.invoke_mouse_handler) }
.text.process_mouse 0xbb55 : { *(.text.process_mouse) }
.text.handle_16 0xbbac : { *(.text.handle_16) }
.text.handle_1589 0xbc9c : { *(.text.handle_1589) }
.text.handle_15 0xbd36 : { *(.text.handle_15) }
.text.handle_14 0xc4a4 : { *(.text.handle_14) }
.text.handle_17 0xe837 : { *(.text.handle_17) }
.text.handle_sercon 0xc677 : { *(.text.handle_sercon) }
.text.handle_1a 0xe990 : { *(.text.handle_1a) }
.text.handle_08 0xf0fc : { *(.text.handle_08) }
.text.handle_70 0xe742 : { *(.text.handle_70) }
.text.handle_resume 0xca67 : { *(.text.handle_resume) }
.text.handle_pnp 0xcb39 : { *(.text.handle_pnp) }
.text.handle_pcibios 0xcb82 : { *(.text.handle_pcibios) }
.text.handle_apm 0xf856 : { *(.text.handle_apm) }
.text.handle_hwpic1 0xe3f8 : { *(.text.handle_hwpic1) }
.text.handle_hwpic2 0xf84a : { *(.text.handle_hwpic2) }
.text.handle_74 0xcee3 : { *(.text.handle_74) }
.text.handle_09 0xcf1e : { *(.text.handle_09) }
.text.handle_0e 0xcf67 : { *(.text.handle_0e) }
.text.asm.transition32 0xec0b : { *(.text.asm.transition32) }
.text.asm.transition16 0xcf81 : { *(.text.asm.transition16) }
.text.asm.__farcall16 0xcfcf : { *(.text.asm.__farcall16) }
.text.asm.irq_trampoline_0x02 0xd05c : { *(.text.asm.irq_trampoline_0x02) }
.text.asm.irq_trampoline_0x05 0xd05f : { *(.text.asm.irq_trampoline_0x05) }
.text.asm.irq_trampoline_0x10 0xd062 : { *(.text.asm.irq_trampoline_0x10) }
.text.asm.irq_trampoline_0x13 0xd065 : { *(.text.asm.irq_trampoline_0x13) }
.text.asm.irq_trampoline_0x15 0xd068 : { *(.text.asm.irq_trampoline_0x15) }
.text.asm.irq_trampoline_0x16 0xef53 : { *(.text.asm.irq_trampoline_0x16) }
.text.asm.irq_trampoline_0x18 0xef50 : { *(.text.asm.irq_trampoline_0x18) }
.text.asm.irq_trampoline_0x19 0xe983 : { *(.text.asm.irq_trampoline_0x19) }
.text.asm.irq_trampoline_0x1b 0xe980 : { *(.text.asm.irq_trampoline_0x1b) }
.text.asm.irq_trampoline_0x1c 0xe829 : { *(.text.asm.irq_trampoline_0x1c) }
.text.asm.irq_trampoline_0x4a 0xff50 : { *(.text.asm.irq_trampoline_0x4a) }
.text.asm.entry_smi 0xe2ae : { *(.text.asm.entry_smi) }
.text.asm.entry_smp 0xd06b : { *(.text.asm.entry_smp) }
.text.asm.entry_resume 0xd09b : { *(.text.asm.entry_resume) }
.text.asm.entry_pmm 0xd0b0 : { *(.text.asm.entry_pmm) }
.text.asm.entry_pnp_real 0xd10e : { *(.text.asm.entry_pnp_real) }
.text.asm.entry_apm16 0xd156 : { *(.text.asm.entry_apm16) }
.text.asm.entry_apm32 0xd197 : { *(.text.asm.entry_apm32) }
.text.asm.entry_pcibios32 0xd1c9 : { *(.text.asm.entry_pcibios32) }
.text.asm.entry_pcibios16 0xd1f7 : { *(.text.asm.entry_pcibios16) }
.text.asm.entry_1589 0xd231 : { *(.text.asm.entry_1589) }
.text.asm.entry_bios32 0xd26b : { *(.text.asm.entry_bios32) }
.text.asm.entry_sercon 0xd28a : { *(.text.asm.entry_sercon) }
.text.asm.irqentry_extrastack 0xd2d1 : { *(.text.asm.irqentry_extrastack) }
.text.asm.irqentry_arg_extrastack 0xd35e : { *(.text.asm.irqentry_arg_extrastack) }
.text.asm.entry_13 0xd400 : { *(.text.asm.entry_13) }
.text.asm.entry_76 0xd409 : { *(.text.asm.entry_76) }
.text.asm.entry_70 0xd412 : { *(.text.asm.entry_70) }
.text.asm.entry_74 0xd41b : { *(.text.asm.entry_74) }
.text.asm.entry_75 0xd424 : { *(.text.asm.entry_75) }
.text.asm.entry_hwpic1 0xd42d : { *(.text.asm.entry_hwpic1) }
.text.asm.entry_hwpic2 0xd436 : { *(.text.asm.entry_hwpic2) }
.text.asm.entry_19 0xd43f : { *(.text.asm.entry_19) }
.text.asm.entry_18 0xd452 : { *(.text.asm.entry_18) }
.rodata 0xd465 : { *(.rodata) }
.rodata.__func__.0 0xd8a8 : { *(.rodata.__func__.0) }
.rodata.__func__.2 0xd8bc : { *(.rodata.__func__.2) }
.rodata.__func__.3 0xd8c8 : { *(.rodata.__func__.3) }
.rodata.__func__.4 0xd8d4 : { *(.rodata.__func__.4) }
.rodata.__func__.5 0xd8e0 : { *(.rodata.__func__.5) }
.rodata.__func__.10 0xd8f0 : { *(.rodata.__func__.10) }
.rodata.__func__.11 0xd900 : { *(.rodata.__func__.11) }
.rodata.__func__.21 0xd910 : { *(.rodata.__func__.21) }
.rodata.__func__.22 0xd91c : { *(.rodata.__func__.22) }
.rodata.__func__.25 0xd924 : { *(.rodata.__func__.25) }
.rodata.__func__.30 0xd934 : { *(.rodata.__func__.30) }
.rodata.__func__.31 0xd944 : { *(.rodata.__func__.31) }
.rodata.__func__.97 0xd958 : { *(.rodata.__func__.97) }
.rodata.__func__.102 0xd964 : { *(.rodata.__func__.102) }
.rodata.__func__.105 0xd970 : { *(.rodata.__func__.105) }
.rodata.__func__.106 0xd97c : { *(.rodata.__func__.106) }
.rodata.__func__.107 0xd988 : { *(.rodata.__func__.107) }
.data16../src/hw/usb-hid.c.205 0xd994 : { *(.data16../src/hw/usb-hid.c.205) }
.data16../src/hw/usb-hid.c.188 0xd9c0 : { *(.data16../src/hw/usb-hid.c.188) }
.data16../src/cp437.c.11 0xdaa0 : { *(.data16../src/cp437.c.11) }
.data16../src/sercon.c.554 0xdca0 : { *(.data16../src/sercon.c.554) }
.data16../src/sercon.c.70 0xdd50 : { *(.data16../src/sercon.c.70) }
.data16../src/kbd.c.374 0xdd58 : { *(.data16../src/kbd.c.374) }
.data16../src/kbd.c.371 0xdd60 : { *(.data16../src/kbd.c.371) }
.data16../src/kbd.c.279 0xdd80 : { *(.data16../src/kbd.c.279) }
.data16../src/mouse.c.106 0xe048 : { *(.data16../src/mouse.c.106) }
.fixedaddr.0xe05b 0xe05b : { *(.fixedaddr.0xe05b) }
.fixedaddr.0xe2c3 0xe2c3 : { *(.fixedaddr.0xe2c3) }
.fixedaddr.0xe3fe 0xe3fe : { *(.fixedaddr.0xe3fe) }
.fixedaddr.0xe6f2 0xe6f2 : { *(.fixedaddr.0xe6f2) }
.fixedaddr.0xe739 0xe739 : { *(.fixedaddr.0xe739) }
.fixedaddr.0xe82e 0xe82e : { *(.fixedaddr.0xe82e) }
.fixedaddr.0xe987 0xe987 : { *(.fixedaddr.0xe987) }
.fixedaddr.0xec59 0xec59 : { *(.fixedaddr.0xec59) }
.fixedaddr.0xef57 0xef57 : { *(.fixedaddr.0xef57) }
.fixedaddr.0xefd2 0xefd2 : { *(.fixedaddr.0xefd2) }
.fixedaddr.0xf045 0xf045 : { *(.fixedaddr.0xf045) }
.fixedaddr.0xf065 0xf065 : { *(.fixedaddr.0xf065) }
.fixedaddr.0xf841 0xf841 : { *(.fixedaddr.0xf841) }
.fixedaddr.0xf84d 0xf84d : { *(.fixedaddr.0xf84d) }
.fixedaddr.0xf859 0xf859 : { *(.fixedaddr.0xf859) }
.fixedaddr.0xfe6e 0xfe6e : { *(.fixedaddr.0xfe6e) }
.fixedaddr.0xfea5 0xfea5 : { *(.fixedaddr.0xfea5) }
.fixedaddr.0xff53 0xff53 : { *(.fixedaddr.0xff53) }
.fixedaddr.0xff54 0xff54 : { *(.fixedaddr.0xff54) }
.fixedaddr.0xfff0 0xfff0 : { *(.fixedaddr.0xfff0) }



        /* Discard regular data sections to force a link error if
         * code attempts to access data not marked with VAR16 (or other
         * appropriate macro)
         */
        /DISCARD/ : {
                *(.text*) *(.data*) *(.bss*) *(.rodata*)
                *(COMMON) *(.discard*) *(.eh_frame) *(.note*)
                }
}
