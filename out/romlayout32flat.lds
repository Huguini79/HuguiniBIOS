
/* DO NOT EDIT!  This is an autogenerated file.  See scripts/layoutrom.py. */
OUTPUT_FORMAT("elf32-i386")
OUTPUT_ARCH("i386")
SECTIONS
{
TPM_interface_shutdown = 0xe7240 ;
sercon_attr = 0xe728c ;
BootSequence = 0xe7258 ;
sercon_col_last = 0xe728f ;
TimerLast = 0xe7274 ;
tpm_state = 0xe7244 ;
emulated_drive_gf = 0xe72a8 ;
sercon_port = 0xe7294 ;
StackPos = 0xe72d0 ;
LastUSBkey = 0xe7264 ;
CDEmu = 0xe72ac ;
reply_msg = 0xe725c ;
Century = 0xe7278 ;
sercon_split = 0xe7292 ;
ExtraStack = 0xe72d8 ;
sercon_attr_last = 0xe7290 ;
DefaultDPTE = 0xe72c0 ;
sercon_enable = 0xe7291 ;
sercon_row_last = 0xe728e ;
rx_buf = 0xe727c ;
Ps2ctr = 0xe726c ;
rx_bytes = 0xe7279 ;
Call16Data = 0xe7adc ;
sercon_char = 0xe728d ;
RTCusers = 0xe7270 ;
CDRom_locks = 0xe7298 ;
TPM_working = 0xe7241 ;
FloppyDOR = 0xe7260 ;
reset_vector = 0xffff0 ;
entry_smi = 0xfe2ae ;
transition16big = 0xfcf96 ;
transition16 = 0xfcf81 ;
_cfunc16_call16_helper = 0xf7d75 ;
transition32_nmi_off = 0xfec23 ;
_cfunc16_check_irqs = 0xf8a24 ;
_cfunc16_wait_irq = 0xfb799 ;
_cfunc16__farcall16 = 0xf8223 ;
entry_10 = 0xff065 ;
irq_trampoline_0x10 = 0xfd062 ;
irq_trampoline_0x16 = 0xfef53 ;
entry_smp = 0xfd06b ;
entry_iret_official = 0xfff53 ;
entry_hwpic1 = 0xfd42d ;
entry_hwpic2 = 0xfd436 ;
entry_02 = 0xfe2c3 ;
entry_05 = 0xfff54 ;
entry_11 = 0xff84d ;
entry_12 = 0xff841 ;
entry_13_official = 0xfe3fe ;
entry_14 = 0xfe739 ;
entry_15_official = 0xff859 ;
entry_16 = 0xfe82e ;
entry_17 = 0xfefd2 ;
entry_18 = 0xfd452 ;
entry_19_official = 0xfe6f2 ;
entry_1a_official = 0xffe6e ;
entry_40 = 0xfec59 ;
entry_bios32 = 0xfd26b ;
entry_pmm = 0xfd0b0 ;
entry_pnp_real = 0xfd112 ;
entry_pnp_prot = 0xfd10e ;
irq_trampoline_0x13 = 0xfd065 ;
entry_09 = 0xfe987 ;
entry_74 = 0xfd41b ;
entry_0e = 0xfef57 ;
entry_76 = 0xfd409 ;
entry_75 = 0xfd424 ;
entry_08 = 0xffea5 ;
entry_70 = 0xfd412 ;
irq_trampoline_0x18 = 0xfef50 ;
irq_trampoline_0x19 = 0xfe983 ;
entry_sercon = 0xfd28a ;

    _reloc_min_align = 0x20 ;
    zonefseg_start = 0xf4cc0 ;
    zonefseg_end = 0xf54c0 ;
    zonelow_base = 0xd8000 ;
    final_varlow_start = 0xe7240 ;
    final_readonly_start = 0xe7b00 ;
    varlow_start = 0xd2c20 ;
    varlow_end = 0xd34e0 ;
    code32init_start = 0xd34e0 ;
    code32init_end = 0xe7b00 ;

    code32flat_start = 0xd1340 ;
    .text code32flat_start : {

        _reloc_abs_start = ABSOLUTE(.) ;
LONG(0xd384d - code32init_start)
LONG(0xd38a6 - code32init_start)
LONG(0xd38ae - code32init_start)
LONG(0xd38de - code32init_start)
LONG(0xd38e6 - code32init_start)
LONG(0xd38ff - code32init_start)
LONG(0xd399a - code32init_start)
LONG(0xd3a8e - code32init_start)
LONG(0xd3a97 - code32init_start)
LONG(0xd3aca - code32init_start)
LONG(0xd3ad3 - code32init_start)
LONG(0xd3b1f - code32init_start)
LONG(0xd3b30 - code32init_start)
LONG(0xd3b3b - code32init_start)
LONG(0xd3b7d - code32init_start)
LONG(0xd3b96 - code32init_start)
LONG(0xd3c74 - code32init_start)
LONG(0xd3c8c - code32init_start)
LONG(0xd3cc4 - code32init_start)
LONG(0xd3cf2 - code32init_start)
LONG(0xd3cfe - code32init_start)
LONG(0xd3d34 - code32init_start)
LONG(0xd3d41 - code32init_start)
LONG(0xd3d54 - code32init_start)
LONG(0xd3d5f - code32init_start)
LONG(0xd3d65 - code32init_start)
LONG(0xd3d69 - code32init_start)
LONG(0xd3e9b - code32init_start)
LONG(0xd3ea3 - code32init_start)
LONG(0xd4481 - code32init_start)
LONG(0xd449b - code32init_start)
LONG(0xd44ae - code32init_start)
LONG(0xd44c1 - code32init_start)
LONG(0xd44d4 - code32init_start)
LONG(0xd44e3 - code32init_start)
LONG(0xd44f6 - code32init_start)
LONG(0xd4505 - code32init_start)
LONG(0xd4a26 - code32init_start)
LONG(0xd4c0b - code32init_start)
LONG(0xd52d5 - code32init_start)
LONG(0xd55b2 - code32init_start)
LONG(0xd5698 - code32init_start)
LONG(0xd59f8 - code32init_start)
LONG(0xd5a24 - code32init_start)
LONG(0xd5a3f - code32init_start)
LONG(0xd5aa4 - code32init_start)
LONG(0xd5ad1 - code32init_start)
LONG(0xd5b13 - code32init_start)
LONG(0xd5b70 - code32init_start)
LONG(0xd5de0 - code32init_start)
LONG(0xd5dfa - code32init_start)
LONG(0xd5e09 - code32init_start)
LONG(0xd5eb5 - code32init_start)
LONG(0xd5ef3 - code32init_start)
LONG(0xd5f3b - code32init_start)
LONG(0xd5f58 - code32init_start)
LONG(0xd5f6c - code32init_start)
LONG(0xd5f7d - code32init_start)
LONG(0xd5f89 - code32init_start)
LONG(0xd5f9a - code32init_start)
LONG(0xd601a - code32init_start)
LONG(0xd603b - code32init_start)
LONG(0xd605f - code32init_start)
LONG(0xd60a6 - code32init_start)
LONG(0xd6100 - code32init_start)
LONG(0xd6129 - code32init_start)
LONG(0xd6130 - code32init_start)
LONG(0xd617d - code32init_start)
LONG(0xd61b8 - code32init_start)
LONG(0xd6201 - code32init_start)
LONG(0xd6206 - code32init_start)
LONG(0xd620e - code32init_start)
LONG(0xd6251 - code32init_start)
LONG(0xd630a - code32init_start)
LONG(0xd633c - code32init_start)
LONG(0xd63bc - code32init_start)
LONG(0xd63cd - code32init_start)
LONG(0xd642e - code32init_start)
LONG(0xd643f - code32init_start)
LONG(0xd658a - code32init_start)
LONG(0xd65d2 - code32init_start)
LONG(0xd6625 - code32init_start)
LONG(0xd6726 - code32init_start)
LONG(0xd676f - code32init_start)
LONG(0xd67e0 - code32init_start)
LONG(0xd6881 - code32init_start)
LONG(0xd68af - code32init_start)
LONG(0xd697e - code32init_start)
LONG(0xd69e9 - code32init_start)
LONG(0xd6a89 - code32init_start)
LONG(0xd6b0c - code32init_start)
LONG(0xd6b62 - code32init_start)
LONG(0xd6cc7 - code32init_start)
LONG(0xd6cd5 - code32init_start)
LONG(0xd6d42 - code32init_start)
LONG(0xd6de7 - code32init_start)
LONG(0xd6e1b - code32init_start)
LONG(0xd6e29 - code32init_start)
LONG(0xd6e54 - code32init_start)
LONG(0xd6ee7 - code32init_start)
LONG(0xd6f53 - code32init_start)
LONG(0xd6f9b - code32init_start)
LONG(0xd6fab - code32init_start)
LONG(0xd7061 - code32init_start)
LONG(0xd70af - code32init_start)
LONG(0xd7300 - code32init_start)
LONG(0xd7356 - code32init_start)
LONG(0xd7360 - code32init_start)
LONG(0xd739f - code32init_start)
LONG(0xd73a5 - code32init_start)
LONG(0xd73cf - code32init_start)
LONG(0xd73e1 - code32init_start)
LONG(0xd73e6 - code32init_start)
LONG(0xd740b - code32init_start)
LONG(0xd744b - code32init_start)
LONG(0xd75ac - code32init_start)
LONG(0xd7645 - code32init_start)
LONG(0xd7883 - code32init_start)
LONG(0xd7a11 - code32init_start)
LONG(0xd7ac7 - code32init_start)
LONG(0xd7cfc - code32init_start)
LONG(0xd7dea - code32init_start)
LONG(0xd7e17 - code32init_start)
LONG(0xd7f63 - code32init_start)
LONG(0xd846d - code32init_start)
LONG(0xd8473 - code32init_start)
LONG(0xd8545 - code32init_start)
LONG(0xd854b - code32init_start)
LONG(0xd855a - code32init_start)
LONG(0xd85a5 - code32init_start)
LONG(0xd8666 - code32init_start)
LONG(0xd872d - code32init_start)
LONG(0xd88c6 - code32init_start)
LONG(0xd893e - code32init_start)
LONG(0xd89e4 - code32init_start)
LONG(0xd8e10 - code32init_start)
LONG(0xd8fbd - code32init_start)
LONG(0xd9182 - code32init_start)
LONG(0xd9230 - code32init_start)
LONG(0xd928e - code32init_start)
LONG(0xd92e9 - code32init_start)
LONG(0xd92f4 - code32init_start)
LONG(0xd9332 - code32init_start)
LONG(0xd939d - code32init_start)
LONG(0xd941f - code32init_start)
LONG(0xd94eb - code32init_start)
LONG(0xd96bc - code32init_start)
LONG(0xd972b - code32init_start)
LONG(0xd97d9 - code32init_start)
LONG(0xd97fb - code32init_start)
LONG(0xd9874 - code32init_start)
LONG(0xd9aa1 - code32init_start)
LONG(0xd9b3b - code32init_start)
LONG(0xd9b46 - code32init_start)
LONG(0xd9b4c - code32init_start)
LONG(0xd9b50 - code32init_start)
LONG(0xd9b72 - code32init_start)
LONG(0xd9b78 - code32init_start)
LONG(0xd9baa - code32init_start)
LONG(0xd9bc3 - code32init_start)
LONG(0xd9bcb - code32init_start)
LONG(0xd9c0e - code32init_start)
LONG(0xd9d7f - code32init_start)
LONG(0xd9dfe - code32init_start)
LONG(0xd9fbb - code32init_start)
LONG(0xda0ee - code32init_start)
LONG(0xda0f5 - code32init_start)
LONG(0xda169 - code32init_start)
LONG(0xda1eb - code32init_start)
LONG(0xda1f2 - code32init_start)
LONG(0xda1f9 - code32init_start)
LONG(0xda200 - code32init_start)
LONG(0xda239 - code32init_start)
LONG(0xda2a3 - code32init_start)
LONG(0xda33b - code32init_start)
LONG(0xda36d - code32init_start)
LONG(0xda58c - code32init_start)
LONG(0xda5b7 - code32init_start)
LONG(0xda63a - code32init_start)
LONG(0xda65a - code32init_start)
LONG(0xdaaee - code32init_start)
LONG(0xdab23 - code32init_start)
LONG(0xdab2d - code32init_start)
LONG(0xdab62 - code32init_start)
LONG(0xdae4a - code32init_start)
LONG(0xdae50 - code32init_start)
LONG(0xdae66 - code32init_start)
LONG(0xdae6c - code32init_start)
LONG(0xdaf00 - code32init_start)
LONG(0xdaf22 - code32init_start)
LONG(0xdaf63 - code32init_start)
LONG(0xdaf6e - code32init_start)
LONG(0xdaf76 - code32init_start)
LONG(0xdb18a - code32init_start)
LONG(0xdb194 - code32init_start)
LONG(0xdb19e - code32init_start)
LONG(0xdb1a8 - code32init_start)
LONG(0xdb1d5 - code32init_start)
LONG(0xdb1e2 - code32init_start)
LONG(0xdb1ea - code32init_start)
LONG(0xdb1f2 - code32init_start)
LONG(0xdb22a - code32init_start)
LONG(0xdb256 - code32init_start)
LONG(0xdb25b - code32init_start)
LONG(0xdb268 - code32init_start)
LONG(0xdb271 - code32init_start)
LONG(0xdb28a - code32init_start)
LONG(0xdb29e - code32init_start)
LONG(0xdb2f6 - code32init_start)
LONG(0xdb322 - code32init_start)
LONG(0xdb327 - code32init_start)
LONG(0xdb334 - code32init_start)
LONG(0xdb33d - code32init_start)
LONG(0xdb356 - code32init_start)
LONG(0xdb36e - code32init_start)
LONG(0xdb80a - code32init_start)
LONG(0xdb81d - code32init_start)
LONG(0xdb959 - code32init_start)
LONG(0xdbd1f - code32init_start)
LONG(0xdbf3f - code32init_start)
LONG(0xdc275 - code32init_start)
LONG(0xdc4f4 - code32init_start)
LONG(0xdc507 - code32init_start)
LONG(0xdc523 - code32init_start)
LONG(0xdc58b - code32init_start)
LONG(0xdc685 - code32init_start)
LONG(0xdc6e3 - code32init_start)
LONG(0xdc834 - code32init_start)
LONG(0xdcb72 - code32init_start)
LONG(0xdcc4b - code32init_start)
LONG(0xdccef - code32init_start)
LONG(0xdcd05 - code32init_start)
LONG(0xdcd16 - code32init_start)
LONG(0xdcdb1 - code32init_start)
LONG(0xdced4 - code32init_start)
LONG(0xdced9 - code32init_start)
LONG(0xdcf29 - code32init_start)
LONG(0xdcf98 - code32init_start)
LONG(0xdcfeb - code32init_start)
LONG(0xdd002 - code32init_start)
LONG(0xdd06f - code32init_start)
LONG(0xdd0b7 - code32init_start)
LONG(0xdd0ca - code32init_start)
LONG(0xdd11d - code32init_start)
LONG(0xdd18a - code32init_start)
LONG(0xdd19a - code32init_start)
LONG(0xdd212 - code32init_start)
LONG(0xdd222 - code32init_start)
LONG(0xdd255 - code32init_start)
LONG(0xdd3af - code32init_start)
LONG(0xdd531 - code32init_start)
LONG(0xdd73e - code32init_start)
LONG(0xdd7f5 - code32init_start)
LONG(0xdd813 - code32init_start)
LONG(0xdd847 - code32init_start)
LONG(0xdd988 - code32init_start)
LONG(0xdd991 - code32init_start)
LONG(0xdd9a1 - code32init_start)
LONG(0xdda4f - code32init_start)
LONG(0xdda5f - code32init_start)
LONG(0xddabe - code32init_start)
LONG(0xddc31 - code32init_start)
LONG(0xddc61 - code32init_start)
LONG(0xddcd9 - code32init_start)
LONG(0xddcf9 - code32init_start)
LONG(0xddd24 - code32init_start)
LONG(0xddd7a - code32init_start)
LONG(0xdddcf - code32init_start)
LONG(0xdde2a - code32init_start)
LONG(0xdde6e - code32init_start)
LONG(0xddeb4 - code32init_start)
LONG(0xddeb9 - code32init_start)
LONG(0xddf12 - code32init_start)
LONG(0xddf7f - code32init_start)
LONG(0xddf92 - code32init_start)
LONG(0xddfe7 - code32init_start)
LONG(0xde02b - code32init_start)
LONG(0xde045 - code32init_start)
LONG(0xde05d - code32init_start)
LONG(0xde0ae - code32init_start)
LONG(0xde11f - code32init_start)
LONG(0xde137 - code32init_start)
LONG(0xde17e - code32init_start)
LONG(0xde1ce - code32init_start)
LONG(0xde1e7 - code32init_start)
LONG(0xde26c - code32init_start)
LONG(0xde2eb - code32init_start)
LONG(0xde2f0 - code32init_start)
LONG(0xde339 - code32init_start)
LONG(0xde36a - code32init_start)
LONG(0xde3c4 - code32init_start)
LONG(0xde43f - code32init_start)
LONG(0xde4b1 - code32init_start)
LONG(0xde51b - code32init_start)
LONG(0xde5ac - code32init_start)
LONG(0xde5e4 - code32init_start)
LONG(0xde61d - code32init_start)
LONG(0xde63a - code32init_start)
LONG(0xde675 - code32init_start)
LONG(0xde689 - code32init_start)
LONG(0xde69f - code32init_start)
LONG(0xde6e6 - code32init_start)
LONG(0xde6ff - code32init_start)
LONG(0xde746 - code32init_start)
LONG(0xde758 - code32init_start)
LONG(0xde770 - code32init_start)
LONG(0xde782 - code32init_start)
LONG(0xde79a - code32init_start)
LONG(0xde7ac - code32init_start)
LONG(0xde807 - code32init_start)
LONG(0xde819 - code32init_start)
LONG(0xde831 - code32init_start)
LONG(0xde843 - code32init_start)
LONG(0xde86e - code32init_start)
LONG(0xde880 - code32init_start)
LONG(0xde89d - code32init_start)
LONG(0xde9fe - code32init_start)
LONG(0xdeae7 - code32init_start)
LONG(0xdeb08 - code32init_start)
LONG(0xdec9f - code32init_start)
LONG(0xdecf2 - code32init_start)
LONG(0xdecfe - code32init_start)
LONG(0xded27 - code32init_start)
LONG(0xded7e - code32init_start)
LONG(0xded98 - code32init_start)
LONG(0xded9e - code32init_start)
LONG(0xdeda9 - code32init_start)
LONG(0xdedb7 - code32init_start)
LONG(0xdedbd - code32init_start)
LONG(0xdee60 - code32init_start)
LONG(0xdee72 - code32init_start)
LONG(0xdee78 - code32init_start)
LONG(0xdee83 - code32init_start)
LONG(0xdee89 - code32init_start)
LONG(0xdee94 - code32init_start)
LONG(0xdeefa - code32init_start)
LONG(0xdeeff - code32init_start)
LONG(0xdef07 - code32init_start)
LONG(0xdef0c - code32init_start)
LONG(0xdef42 - code32init_start)
LONG(0xdef73 - code32init_start)
LONG(0xdefd1 - code32init_start)
LONG(0xdefd7 - code32init_start)
LONG(0xdf027 - code32init_start)
LONG(0xdf02d - code32init_start)
LONG(0xdf040 - code32init_start)
LONG(0xdf10b - code32init_start)
LONG(0xdf111 - code32init_start)
LONG(0xdf13c - code32init_start)
LONG(0xdf142 - code32init_start)
LONG(0xdf1b3 - code32init_start)
LONG(0xdf403 - code32init_start)
LONG(0xdf445 - code32init_start)
LONG(0xdf45b - code32init_start)
LONG(0xdf49f - code32init_start)
LONG(0xdf4ce - code32init_start)
LONG(0xdf623 - code32init_start)
LONG(0xdf66a - code32init_start)
LONG(0xdf6d0 - code32init_start)
LONG(0xdf796 - code32init_start)
LONG(0xdf79c - code32init_start)
LONG(0xdf7ab - code32init_start)
LONG(0xdf7b1 - code32init_start)
LONG(0xdf869 - code32init_start)
LONG(0xdf877 - code32init_start)
LONG(0xdf882 - code32init_start)
LONG(0xdf890 - code32init_start)
LONG(0xdf8aa - code32init_start)
LONG(0xdf9f5 - code32init_start)
LONG(0xdfa78 - code32init_start)
LONG(0xdfd54 - code32init_start)
LONG(0xdfe42 - code32init_start)
LONG(0xe0455 - code32init_start)
LONG(0xe045d - code32init_start)
LONG(0xe0463 - code32init_start)
LONG(0xe05fc - code32init_start)
LONG(0xe064e - code32init_start)
LONG(0xe0654 - code32init_start)
LONG(0xe0688 - code32init_start)
LONG(0xe068e - code32init_start)
LONG(0xe0714 - code32init_start)
LONG(0xe076d - code32init_start)
LONG(0xe0773 - code32init_start)
LONG(0xe07d5 - code32init_start)
LONG(0xe0910 - code32init_start)
LONG(0xe09a0 - code32init_start)
LONG(0xe0aa6 - code32init_start)
LONG(0xe0ad4 - code32init_start)
LONG(0xe0b5e - code32init_start)
LONG(0xe0b6c - code32init_start)
LONG(0xe0bba - code32init_start)
LONG(0xe0bfb - code32init_start)
LONG(0xe0c70 - code32init_start)
LONG(0xe0cf5 - code32init_start)
LONG(0xe0df5 - code32init_start)
LONG(0xe0dfc - code32init_start)
LONG(0xe0e41 - code32init_start)
LONG(0xe0e6a - code32init_start)
LONG(0xe0e71 - code32init_start)
LONG(0xe0eab - code32init_start)
LONG(0xe1020 - code32init_start)
LONG(0xe1065 - code32init_start)
LONG(0xe106c - code32init_start)
LONG(0xe1089 - code32init_start)
LONG(0xe155f - code32init_start)
LONG(0xe16e2 - code32init_start)
LONG(0xe19f1 - code32init_start)
LONG(0xe1a87 - code32init_start)
LONG(0xe1ba3 - code32init_start)
LONG(0xe1ce1 - code32init_start)
LONG(0xe1d24 - code32init_start)
LONG(0xe1dc4 - code32init_start)
LONG(0xe1e39 - code32init_start)
LONG(0xe1ef4 - code32init_start)
LONG(0xe233e - code32init_start)
LONG(0xe2484 - code32init_start)
LONG(0xe25d8 - code32init_start)
LONG(0xe277a - code32init_start)
LONG(0xe29b6 - code32init_start)
LONG(0xe2bb4 - code32init_start)
LONG(0xe2c5f - code32init_start)
LONG(0xe2d6e - code32init_start)
LONG(0xe2db5 - code32init_start)
LONG(0xe2e77 - code32init_start)
LONG(0xe2f86 - code32init_start)
LONG(0xe2fe7 - code32init_start)
LONG(0xe30b6 - code32init_start)
LONG(0xe318b - code32init_start)
LONG(0xe3256 - code32init_start)
LONG(0xe3311 - code32init_start)
LONG(0xe3362 - code32init_start)
LONG(0xe3373 - code32init_start)
LONG(0xe364b - code32init_start)
LONG(0xe367d - code32init_start)
LONG(0xe387d - code32init_start)
LONG(0xe38f1 - code32init_start)
LONG(0xe3a09 - code32init_start)
LONG(0xe3ae6 - code32init_start)
LONG(0xe3afe - code32init_start)
LONG(0xe3b17 - code32init_start)
LONG(0xe3bcc - code32init_start)
LONG(0xe3fb7 - code32init_start)
LONG(0xe419f - code32init_start)
LONG(0xe506d - code32init_start)
LONG(0xe50b5 - code32init_start)
LONG(0xe50c0 - code32init_start)
LONG(0xe50ee - code32init_start)
LONG(0xe511a - code32init_start)
LONG(0xe5400 - code32init_start)
LONG(0xe544c - code32init_start)
LONG(0xe5975 - code32init_start)
LONG(0xe5993 - code32init_start)
LONG(0xe59c6 - code32init_start)
LONG(0xe59eb - code32init_start)
LONG(0xe5bca - code32init_start)
LONG(0xe5bd1 - code32init_start)
LONG(0xe5c0d - code32init_start)
LONG(0xe6008 - code32init_start)
LONG(0xe6048 - code32init_start)
LONG(0xe6067 - code32init_start)
LONG(0xe60b5 - code32init_start)
LONG(0xe6105 - code32init_start)
LONG(0xe6130 - code32init_start)
LONG(0xe613f - code32init_start)
LONG(0xe61cc - code32init_start)
LONG(0xe6376 - code32init_start)
LONG(0xe63c3 - code32init_start)
LONG(0xe64b2 - code32init_start)
LONG(0xe64ca - code32init_start)
LONG(0xe6541 - code32init_start)
LONG(0xe6553 - code32init_start)
LONG(0xe656c - code32init_start)
LONG(0xe6756 - code32init_start)
LONG(0xe6778 - code32init_start)
LONG(0xe6789 - code32init_start)
LONG(0xe679a - code32init_start)
LONG(0xe679f - code32init_start)
LONG(0xe67a9 - code32init_start)
LONG(0xe67af - code32init_start)
LONG(0xe67f9 - code32init_start)
LONG(0xe680e - code32init_start)
LONG(0xe690f - code32init_start)
LONG(0xe692c - code32init_start)
LONG(0xe693f - code32init_start)
LONG(0xe69f9 - code32init_start)
LONG(0xe6a11 - code32init_start)
LONG(0xe6a68 - code32init_start)
LONG(0xe6a6d - code32init_start)
LONG(0xe6a74 - code32init_start)
LONG(0xe6a79 - code32init_start)
LONG(0xe6b30 - code32init_start)
LONG(0xe6bad - code32init_start)
LONG(0xe6bec - code32init_start)
LONG(0xe6bf0 - code32init_start)
LONG(0xe6bf4 - code32init_start)
LONG(0xe6bf8 - code32init_start)
LONG(0xe6bfc - code32init_start)
LONG(0xe6c00 - code32init_start)
LONG(0xe6c04 - code32init_start)
LONG(0xe6c08 - code32init_start)
LONG(0xe6c0c - code32init_start)
LONG(0xe6c10 - code32init_start)
LONG(0xe6c14 - code32init_start)
LONG(0xe6c18 - code32init_start)
LONG(0xe6c1c - code32init_start)
LONG(0xe6c20 - code32init_start)
LONG(0xe6c24 - code32init_start)
LONG(0xe6c28 - code32init_start)
LONG(0xe6c2c - code32init_start)
LONG(0xe6c30 - code32init_start)
LONG(0xe6c34 - code32init_start)
LONG(0xe6c38 - code32init_start)
LONG(0xe6c3c - code32init_start)
LONG(0xe6c40 - code32init_start)
LONG(0xe6c44 - code32init_start)
LONG(0xe6c48 - code32init_start)
LONG(0xe6c4c - code32init_start)
LONG(0xe6c50 - code32init_start)
LONG(0xe6c54 - code32init_start)
LONG(0xe6c58 - code32init_start)
LONG(0xe6c5c - code32init_start)
LONG(0xe6c60 - code32init_start)
LONG(0xe6c64 - code32init_start)
LONG(0xe6c68 - code32init_start)
LONG(0xe6c6c - code32init_start)
LONG(0xe6c70 - code32init_start)
LONG(0xe6c74 - code32init_start)
LONG(0xe6c78 - code32init_start)
LONG(0xe6c7c - code32init_start)
LONG(0xe6c80 - code32init_start)
LONG(0xe6c84 - code32init_start)
LONG(0xe6c88 - code32init_start)
LONG(0xe6c8c - code32init_start)
LONG(0xe6c90 - code32init_start)
LONG(0xe6c94 - code32init_start)
LONG(0xe6c98 - code32init_start)
LONG(0xe6c9c - code32init_start)
LONG(0xe6ca0 - code32init_start)
LONG(0xe6ca4 - code32init_start)
LONG(0xe6ca8 - code32init_start)
LONG(0xe6cac - code32init_start)
LONG(0xe6cb0 - code32init_start)
LONG(0xe6cb4 - code32init_start)
LONG(0xe6cb8 - code32init_start)
LONG(0xe6cbc - code32init_start)
LONG(0xe6cc0 - code32init_start)
LONG(0xe6cc4 - code32init_start)
LONG(0xe6cc8 - code32init_start)
LONG(0xe6ccc - code32init_start)
LONG(0xe6cd0 - code32init_start)
LONG(0xe6cd4 - code32init_start)
LONG(0xe6cd8 - code32init_start)
LONG(0xe6cdc - code32init_start)
LONG(0xe6ce0 - code32init_start)
LONG(0xe6ce4 - code32init_start)
LONG(0xe6ce8 - code32init_start)
LONG(0xe6cec - code32init_start)
LONG(0xe6cf0 - code32init_start)
LONG(0xe6cf4 - code32init_start)
LONG(0xe6cf8 - code32init_start)
LONG(0xe75f0 - code32init_start)
LONG(0xe7604 - code32init_start)
LONG(0xe7630 - code32init_start)
LONG(0xe7644 - code32init_start)
LONG(0xe7658 - code32init_start)
LONG(0xe766c - code32init_start)
LONG(0xe7680 - code32init_start)
LONG(0xe7694 - code32init_start)
LONG(0xe76a8 - code32init_start)
LONG(0xe76bc - code32init_start)
LONG(0xe76d0 - code32init_start)
LONG(0xe76e4 - code32init_start)
LONG(0xe76f8 - code32init_start)
LONG(0xe770c - code32init_start)
LONG(0xe7720 - code32init_start)
LONG(0xe7890 - code32init_start)
LONG(0xe78a4 - code32init_start)
LONG(0xe7960 - code32init_start)
LONG(0xe7978 - code32init_start)
LONG(0xe797c - code32init_start)
LONG(0xe7984 - code32init_start)
LONG(0xe7988 - code32init_start)
LONG(0xe798c - code32init_start)
LONG(0xe7990 - code32init_start)
LONG(0xe7994 - code32init_start)
LONG(0xe7a04 - code32init_start)
LONG(0xe7a08 - code32init_start)
LONG(0xe7a0c - code32init_start)
LONG(0xe7a10 - code32init_start)
LONG(0xe7a14 - code32init_start)
LONG(0xe7a44 - code32init_start)
LONG(0xe7a48 - code32init_start)
LONG(0xe7a50 - code32init_start)
LONG(0xe7a54 - code32init_start)
LONG(0xe7a58 - code32init_start)
LONG(0xe7a60 - code32init_start)
LONG(0xe7a64 - code32init_start)
LONG(0xe7a68 - code32init_start)
LONG(0xe7a70 - code32init_start)
        _reloc_abs_end = ABSOLUTE(.) ;
        _reloc_rel_start = ABSOLUTE(.) ;
LONG(0xd3532 - code32init_start)
LONG(0xd3572 - code32init_start)
LONG(0xd358a - code32init_start)
LONG(0xd35aa - code32init_start)
LONG(0xd35ba - code32init_start)
LONG(0xd35e2 - code32init_start)
LONG(0xd35fa - code32init_start)
LONG(0xd3911 - code32init_start)
LONG(0xd398e - code32init_start)
LONG(0xd39aa - code32init_start)
LONG(0xd39d0 - code32init_start)
LONG(0xd39ea - code32init_start)
LONG(0xd3d15 - code32init_start)
LONG(0xd3d22 - code32init_start)
LONG(0xd3d2f - code32init_start)
LONG(0xd3eea - code32init_start)
LONG(0xd3fce - code32init_start)
LONG(0xd3fdf - code32init_start)
LONG(0xd3ff6 - code32init_start)
LONG(0xd4018 - code32init_start)
LONG(0xd4029 - code32init_start)
LONG(0xd403d - code32init_start)
LONG(0xd404e - code32init_start)
LONG(0xd4062 - code32init_start)
LONG(0xd40a2 - code32init_start)
LONG(0xd40b5 - code32init_start)
LONG(0xd40ca - code32init_start)
LONG(0xd40f9 - code32init_start)
LONG(0xd410c - code32init_start)
LONG(0xd4121 - code32init_start)
LONG(0xd413a - code32init_start)
LONG(0xd4153 - code32init_start)
LONG(0xd41e7 - code32init_start)
LONG(0xd42aa - code32init_start)
LONG(0xd47cd - code32init_start)
LONG(0xd4810 - code32init_start)
LONG(0xd4830 - code32init_start)
LONG(0xd4857 - code32init_start)
LONG(0xd487d - code32init_start)
LONG(0xd4891 - code32init_start)
LONG(0xd4cb3 - code32init_start)
LONG(0xd4cc5 - code32init_start)
LONG(0xd4cf1 - code32init_start)
LONG(0xd4d10 - code32init_start)
LONG(0xd4dee - code32init_start)
LONG(0xd4e03 - code32init_start)
LONG(0xd52c4 - code32init_start)
LONG(0xd5339 - code32init_start)
LONG(0xd5377 - code32init_start)
LONG(0xd5413 - code32init_start)
LONG(0xd5426 - code32init_start)
LONG(0xd543f - code32init_start)
LONG(0xd5457 - code32init_start)
LONG(0xd54a5 - code32init_start)
LONG(0xd5511 - code32init_start)
LONG(0xd553a - code32init_start)
LONG(0xd5557 - code32init_start)
LONG(0xd5590 - code32init_start)
LONG(0xd55a5 - code32init_start)
LONG(0xd5600 - code32init_start)
LONG(0xd561a - code32init_start)
LONG(0xd564e - code32init_start)
LONG(0xd566b - code32init_start)
LONG(0xd567b - code32init_start)
LONG(0xd568f - code32init_start)
LONG(0xd56a8 - code32init_start)
LONG(0xd5726 - code32init_start)
LONG(0xd5759 - code32init_start)
LONG(0xd5769 - code32init_start)
LONG(0xd5782 - code32init_start)
LONG(0xd57e2 - code32init_start)
LONG(0xd57f2 - code32init_start)
LONG(0xd57ff - code32init_start)
LONG(0xd582e - code32init_start)
LONG(0xd585a - code32init_start)
LONG(0xd5863 - code32init_start)
LONG(0xd586c - code32init_start)
LONG(0xd592e - code32init_start)
LONG(0xd5948 - code32init_start)
LONG(0xd595b - code32init_start)
LONG(0xd5972 - code32init_start)
LONG(0xd5980 - code32init_start)
LONG(0xd59a9 - code32init_start)
LONG(0xd59d0 - code32init_start)
LONG(0xd59e0 - code32init_start)
LONG(0xd59e6 - code32init_start)
LONG(0xd5a02 - code32init_start)
LONG(0xd5a1b - code32init_start)
LONG(0xd5a49 - code32init_start)
LONG(0xd5a93 - code32init_start)
LONG(0xd5aaf - code32init_start)
LONG(0xd5adb - code32init_start)
LONG(0xd5b1f - code32init_start)
LONG(0xd5b81 - code32init_start)
LONG(0xd5e13 - code32init_start)
LONG(0xd5f20 - code32init_start)
LONG(0xd5fb9 - code32init_start)
LONG(0xd601f - code32init_start)
LONG(0xd6045 - code32init_start)
LONG(0xd6053 - code32init_start)
LONG(0xd6072 - code32init_start)
LONG(0xd60b0 - code32init_start)
LONG(0xd610f - code32init_start)
LONG(0xd61c7 - code32init_start)
LONG(0xd61d5 - code32init_start)
LONG(0xd625b - code32init_start)
LONG(0xd626c - code32init_start)
LONG(0xd6314 - code32init_start)
LONG(0xd6346 - code32init_start)
LONG(0xd6354 - code32init_start)
LONG(0xd6397 - code32init_start)
LONG(0xd63d7 - code32init_start)
LONG(0xd6409 - code32init_start)
LONG(0xd6449 - code32init_start)
LONG(0xd64b7 - code32init_start)
LONG(0xd64d4 - code32init_start)
LONG(0xd6528 - code32init_start)
LONG(0xd6537 - code32init_start)
LONG(0xd6549 - code32init_start)
LONG(0xd6594 - code32init_start)
LONG(0xd6599 - code32init_start)
LONG(0xd6639 - code32init_start)
LONG(0xd6647 - code32init_start)
LONG(0xd6654 - code32init_start)
LONG(0xd6661 - code32init_start)
LONG(0xd66de - code32init_start)
LONG(0xd66f3 - code32init_start)
LONG(0xd6716 - code32init_start)
LONG(0xd6730 - code32init_start)
LONG(0xd675b - code32init_start)
LONG(0xd6779 - code32init_start)
LONG(0xd67ea - code32init_start)
LONG(0xd67fd - code32init_start)
LONG(0xd6817 - code32init_start)
LONG(0xd682f - code32init_start)
LONG(0xd6889 - code32init_start)
LONG(0xd689b - code32init_start)
LONG(0xd68e6 - code32init_start)
LONG(0xd695f - code32init_start)
LONG(0xd6975 - code32init_start)
LONG(0xd6988 - code32init_start)
LONG(0xd6998 - code32init_start)
LONG(0xd69f3 - code32init_start)
LONG(0xd6a06 - code32init_start)
LONG(0xd6a13 - code32init_start)
LONG(0xd6a63 - code32init_start)
LONG(0xd6a80 - code32init_start)
LONG(0xd6a93 - code32init_start)
LONG(0xd6b14 - code32init_start)
LONG(0xd6b4c - code32init_start)
LONG(0xd6b8c - code32init_start)
LONG(0xd6c23 - code32init_start)
LONG(0xd6c31 - code32init_start)
LONG(0xd6c5a - code32init_start)
LONG(0xd6c7b - code32init_start)
LONG(0xd6c89 - code32init_start)
LONG(0xd6c9d - code32init_start)
LONG(0xd6ccc - code32init_start)
LONG(0xd6cdf - code32init_start)
LONG(0xd6ce9 - code32init_start)
LONG(0xd6d09 - code32init_start)
LONG(0xd6d1a - code32init_start)
LONG(0xd6d31 - code32init_start)
LONG(0xd6d38 - code32init_start)
LONG(0xd6d4c - code32init_start)
LONG(0xd6d53 - code32init_start)
LONG(0xd6d66 - code32init_start)
LONG(0xd6d75 - code32init_start)
LONG(0xd6d87 - code32init_start)
LONG(0xd6dcd - code32init_start)
LONG(0xd6dde - code32init_start)
LONG(0xd6df1 - code32init_start)
LONG(0xd6dfb - code32init_start)
LONG(0xd6e33 - code32init_start)
LONG(0xd6e4a - code32init_start)
LONG(0xd6e5e - code32init_start)
LONG(0xd6e72 - code32init_start)
LONG(0xd6e7b - code32init_start)
LONG(0xd6ebc - code32init_start)
LONG(0xd6ed2 - code32init_start)
LONG(0xd6ede - code32init_start)
LONG(0xd6ef1 - code32init_start)
LONG(0xd6f5d - code32init_start)
LONG(0xd6f79 - code32init_start)
LONG(0xd6f92 - code32init_start)
LONG(0xd6fa5 - code32init_start)
LONG(0xd6fb5 - code32init_start)
LONG(0xd6fcd - code32init_start)
LONG(0xd701b - code32init_start)
LONG(0xd709c - code32init_start)
LONG(0xd70e6 - code32init_start)
LONG(0xd71a0 - code32init_start)
LONG(0xd71c1 - code32init_start)
LONG(0xd71e4 - code32init_start)
LONG(0xd7222 - code32init_start)
LONG(0xd7236 - code32init_start)
LONG(0xd7243 - code32init_start)
LONG(0xd727d - code32init_start)
LONG(0xd72b6 - code32init_start)
LONG(0xd730a - code32init_start)
LONG(0xd7324 - code32init_start)
LONG(0xd7335 - code32init_start)
LONG(0xd7351 - code32init_start)
LONG(0xd7399 - code32init_start)
LONG(0xd7402 - code32init_start)
LONG(0xd7423 - code32init_start)
LONG(0xd7431 - code32init_start)
LONG(0xd7455 - code32init_start)
LONG(0xd7498 - code32init_start)
LONG(0xd74fa - code32init_start)
LONG(0xd7519 - code32init_start)
LONG(0xd752b - code32init_start)
LONG(0xd7541 - code32init_start)
LONG(0xd756a - code32init_start)
LONG(0xd7578 - code32init_start)
LONG(0xd758a - code32init_start)
LONG(0xd75b6 - code32init_start)
LONG(0xd75df - code32init_start)
LONG(0xd75f6 - code32init_start)
LONG(0xd7604 - code32init_start)
LONG(0xd7635 - code32init_start)
LONG(0xd764f - code32init_start)
LONG(0xd765c - code32init_start)
LONG(0xd7672 - code32init_start)
LONG(0xd7681 - code32init_start)
LONG(0xd7691 - code32init_start)
LONG(0xd76a0 - code32init_start)
LONG(0xd76c0 - code32init_start)
LONG(0xd76d4 - code32init_start)
LONG(0xd76e4 - code32init_start)
LONG(0xd76f3 - code32init_start)
LONG(0xd7709 - code32init_start)
LONG(0xd7740 - code32init_start)
LONG(0xd7769 - code32init_start)
LONG(0xd778a - code32init_start)
LONG(0xd77aa - code32init_start)
LONG(0xd77c5 - code32init_start)
LONG(0xd77d9 - code32init_start)
LONG(0xd77f4 - code32init_start)
LONG(0xd7899 - code32init_start)
LONG(0xd78f6 - code32init_start)
LONG(0xd7904 - code32init_start)
LONG(0xd7922 - code32init_start)
LONG(0xd7930 - code32init_start)
LONG(0xd7956 - code32init_start)
LONG(0xd7974 - code32init_start)
LONG(0xd7997 - code32init_start)
LONG(0xd79b5 - code32init_start)
LONG(0xd79c5 - code32init_start)
LONG(0xd79d5 - code32init_start)
LONG(0xd7a36 - code32init_start)
LONG(0xd7a62 - code32init_start)
LONG(0xd7a95 - code32init_start)
LONG(0xd7ab0 - code32init_start)
LONG(0xd7ae0 - code32init_start)
LONG(0xd7b23 - code32init_start)
LONG(0xd7b47 - code32init_start)
LONG(0xd7b55 - code32init_start)
LONG(0xd7b73 - code32init_start)
LONG(0xd7bd2 - code32init_start)
LONG(0xd7c45 - code32init_start)
LONG(0xd7c86 - code32init_start)
LONG(0xd7c99 - code32init_start)
LONG(0xd7d1c - code32init_start)
LONG(0xd7d26 - code32init_start)
LONG(0xd7d52 - code32init_start)
LONG(0xd7d5f - code32init_start)
LONG(0xd7db1 - code32init_start)
LONG(0xd7e2b - code32init_start)
LONG(0xd7e37 - code32init_start)
LONG(0xd7e8d - code32init_start)
LONG(0xd7e9d - code32init_start)
LONG(0xd7eb9 - code32init_start)
LONG(0xd7ed1 - code32init_start)
LONG(0xd7f3e - code32init_start)
LONG(0xd7f5e - code32init_start)
LONG(0xd7fda - code32init_start)
LONG(0xd803a - code32init_start)
LONG(0xd8056 - code32init_start)
LONG(0xd8074 - code32init_start)
LONG(0xd80b8 - code32init_start)
LONG(0xd80c5 - code32init_start)
LONG(0xd80e0 - code32init_start)
LONG(0xd8101 - code32init_start)
LONG(0xd8113 - code32init_start)
LONG(0xd8120 - code32init_start)
LONG(0xd8131 - code32init_start)
LONG(0xd8298 - code32init_start)
LONG(0xd8310 - code32init_start)
LONG(0xd831a - code32init_start)
LONG(0xd833f - code32init_start)
LONG(0xd8376 - code32init_start)
LONG(0xd8384 - code32init_start)
LONG(0xd83cc - code32init_start)
LONG(0xd83da - code32init_start)
LONG(0xd83e8 - code32init_start)
LONG(0xd841c - code32init_start)
LONG(0xd8490 - code32init_start)
LONG(0xd84aa - code32init_start)
LONG(0xd84b7 - code32init_start)
LONG(0xd84ca - code32init_start)
LONG(0xd85b7 - code32init_start)
LONG(0xd867f - code32init_start)
LONG(0xd8737 - code32init_start)
LONG(0xd874f - code32init_start)
LONG(0xd875c - code32init_start)
LONG(0xd8769 - code32init_start)
LONG(0xd8776 - code32init_start)
LONG(0xd88d0 - code32init_start)
LONG(0xd892b - code32init_start)
LONG(0xd8958 - code32init_start)
LONG(0xd89ee - code32init_start)
LONG(0xd8a01 - code32init_start)
LONG(0xd8a47 - code32init_start)
LONG(0xd8a60 - code32init_start)
LONG(0xd8a87 - code32init_start)
LONG(0xd8ab3 - code32init_start)
LONG(0xd8ad8 - code32init_start)
LONG(0xd8ae9 - code32init_start)
LONG(0xd8b01 - code32init_start)
LONG(0xd8b22 - code32init_start)
LONG(0xd8b47 - code32init_start)
LONG(0xd8b55 - code32init_start)
LONG(0xd8bfa - code32init_start)
LONG(0xd8c20 - code32init_start)
LONG(0xd8c35 - code32init_start)
LONG(0xd8c50 - code32init_start)
LONG(0xd8c65 - code32init_start)
LONG(0xd8c83 - code32init_start)
LONG(0xd8c98 - code32init_start)
LONG(0xd8cad - code32init_start)
LONG(0xd8cca - code32init_start)
LONG(0xd8ce8 - code32init_start)
LONG(0xd8d0f - code32init_start)
LONG(0xd8d24 - code32init_start)
LONG(0xd8d3f - code32init_start)
LONG(0xd8d54 - code32init_start)
LONG(0xd8d72 - code32init_start)
LONG(0xd8d87 - code32init_start)
LONG(0xd8d9c - code32init_start)
LONG(0xd8dad - code32init_start)
LONG(0xd8dd3 - code32init_start)
LONG(0xd8e1a - code32init_start)
LONG(0xd8e2d - code32init_start)
LONG(0xd8eac - code32init_start)
LONG(0xd8f16 - code32init_start)
LONG(0xd8f4a - code32init_start)
LONG(0xd8f78 - code32init_start)
LONG(0xd8fa6 - code32init_start)
LONG(0xd8fc7 - code32init_start)
LONG(0xd8fd7 - code32init_start)
LONG(0xd9029 - code32init_start)
LONG(0xd90f9 - code32init_start)
LONG(0xd911b - code32init_start)
LONG(0xd914b - code32init_start)
LONG(0xd9179 - code32init_start)
LONG(0xd918c - code32init_start)
LONG(0xd91bd - code32init_start)
LONG(0xd91f5 - code32init_start)
LONG(0xd920d - code32init_start)
LONG(0xd923a - code32init_start)
LONG(0xd9249 - code32init_start)
LONG(0xd926e - code32init_start)
LONG(0xd92a8 - code32init_start)
LONG(0xd92c0 - code32init_start)
LONG(0xd92d2 - code32init_start)
LONG(0xd930a - code32init_start)
LONG(0xd931b - code32init_start)
LONG(0xd9354 - code32init_start)
LONG(0xd9389 - code32init_start)
LONG(0xd93ae - code32init_start)
LONG(0xd93bd - code32init_start)
LONG(0xd93d6 - code32init_start)
LONG(0xd9429 - code32init_start)
LONG(0xd9474 - code32init_start)
LONG(0xd9480 - code32init_start)
LONG(0xd948c - code32init_start)
LONG(0xd94ac - code32init_start)
LONG(0xd94f5 - code32init_start)
LONG(0xd952b - code32init_start)
LONG(0xd9562 - code32init_start)
LONG(0xd958a - code32init_start)
LONG(0xd95ba - code32init_start)
LONG(0xd9657 - code32init_start)
LONG(0xd9674 - code32init_start)
LONG(0xd9685 - code32init_start)
LONG(0xd96f1 - code32init_start)
LONG(0xd974f - code32init_start)
LONG(0xd9765 - code32init_start)
LONG(0xd97b6 - code32init_start)
LONG(0xd97d0 - code32init_start)
LONG(0xd97e3 - code32init_start)
LONG(0xd97ea - code32init_start)
LONG(0xd9819 - code32init_start)
LONG(0xd9849 - code32init_start)
LONG(0xd9861 - code32init_start)
LONG(0xd986b - code32init_start)
LONG(0xd987e - code32init_start)
LONG(0xd9888 - code32init_start)
LONG(0xd989e - code32init_start)
LONG(0xd990e - code32init_start)
LONG(0xd9a5d - code32init_start)
LONG(0xd9a79 - code32init_start)
LONG(0xd9a94 - code32init_start)
LONG(0xd9aae - code32init_start)
LONG(0xd9ab3 - code32init_start)
LONG(0xd9b0e - code32init_start)
LONG(0xd9b20 - code32init_start)
LONG(0xd9bbb - code32init_start)
LONG(0xd9c07 - code32init_start)
LONG(0xd9c31 - code32init_start)
LONG(0xd9ceb - code32init_start)
LONG(0xd9cfb - code32init_start)
LONG(0xd9d11 - code32init_start)
LONG(0xd9d72 - code32init_start)
LONG(0xd9e8c - code32init_start)
LONG(0xd9ef1 - code32init_start)
LONG(0xd9f08 - code32init_start)
LONG(0xd9f17 - code32init_start)
LONG(0xd9f61 - code32init_start)
LONG(0xd9f7a - code32init_start)
LONG(0xd9f99 - code32init_start)
LONG(0xd9fd4 - code32init_start)
LONG(0xda173 - code32init_start)
LONG(0xda254 - code32init_start)
LONG(0xda2c5 - code32init_start)
LONG(0xda2d4 - code32init_start)
LONG(0xda345 - code32init_start)
LONG(0xda3d6 - code32init_start)
LONG(0xda3e9 - code32init_start)
LONG(0xda469 - code32init_start)
LONG(0xda4c9 - code32init_start)
LONG(0xda596 - code32init_start)
LONG(0xda5af - code32init_start)
LONG(0xda644 - code32init_start)
LONG(0xda664 - code32init_start)
LONG(0xda680 - code32init_start)
LONG(0xda69a - code32init_start)
LONG(0xda6aa - code32init_start)
LONG(0xda6f6 - code32init_start)
LONG(0xda7d8 - code32init_start)
LONG(0xda7e9 - code32init_start)
LONG(0xda899 - code32init_start)
LONG(0xdaa58 - code32init_start)
LONG(0xdaa69 - code32init_start)
LONG(0xdab56 - code32init_start)
LONG(0xdabcd - code32init_start)
LONG(0xdac24 - code32init_start)
LONG(0xdac45 - code32init_start)
LONG(0xdac80 - code32init_start)
LONG(0xdaca5 - code32init_start)
LONG(0xdacc7 - code32init_start)
LONG(0xdad3b - code32init_start)
LONG(0xdad5b - code32init_start)
LONG(0xdad64 - code32init_start)
LONG(0xdad7e - code32init_start)
LONG(0xdad87 - code32init_start)
LONG(0xdadc5 - code32init_start)
LONG(0xdade2 - code32init_start)
LONG(0xdae76 - code32init_start)
LONG(0xdae9f - code32init_start)
LONG(0xdaebb - code32init_start)
LONG(0xdaf2c - code32init_start)
LONG(0xdaf3d - code32init_start)
LONG(0xdb10a - code32init_start)
LONG(0xdb12b - code32init_start)
LONG(0xdb27b - code32init_start)
LONG(0xdb296 - code32init_start)
LONG(0xdb2d3 - code32init_start)
LONG(0xdb347 - code32init_start)
LONG(0xdb365 - code32init_start)
LONG(0xdb3d5 - code32init_start)
LONG(0xdb3f8 - code32init_start)
LONG(0xdb421 - code32init_start)
LONG(0xdb44c - code32init_start)
LONG(0xdb814 - code32init_start)
LONG(0xdb83a - code32init_start)
LONG(0xdb880 - code32init_start)
LONG(0xdb898 - code32init_start)
LONG(0xdb8b7 - code32init_start)
LONG(0xdb8c1 - code32init_start)
LONG(0xdb8d9 - code32init_start)
LONG(0xdb8e8 - code32init_start)
LONG(0xdb8f5 - code32init_start)
LONG(0xdb90b - code32init_start)
LONG(0xdb922 - code32init_start)
LONG(0xdb92d - code32init_start)
LONG(0xdb943 - code32init_start)
LONG(0xdb950 - code32init_start)
LONG(0xdb963 - code32init_start)
LONG(0xdb971 - code32init_start)
LONG(0xdb981 - code32init_start)
LONG(0xdb99f - code32init_start)
LONG(0xdb9ae - code32init_start)
LONG(0xdb9c5 - code32init_start)
LONG(0xdb9e9 - code32init_start)
LONG(0xdb9fc - code32init_start)
LONG(0xdbba3 - code32init_start)
LONG(0xdbbc5 - code32init_start)
LONG(0xdbbe8 - code32init_start)
LONG(0xdbc0e - code32init_start)
LONG(0xdbc23 - code32init_start)
LONG(0xdbc3e - code32init_start)
LONG(0xdbc55 - code32init_start)
LONG(0xdbc8a - code32init_start)
LONG(0xdbd0a - code32init_start)
LONG(0xdbd33 - code32init_start)
LONG(0xdbd41 - code32init_start)
LONG(0xdbdad - code32init_start)
LONG(0xdbdd2 - code32init_start)
LONG(0xdbdf0 - code32init_start)
LONG(0xdbe01 - code32init_start)
LONG(0xdbe28 - code32init_start)
LONG(0xdbe41 - code32init_start)
LONG(0xdbe62 - code32init_start)
LONG(0xdbe73 - code32init_start)
LONG(0xdbe88 - code32init_start)
LONG(0xdbe9d - code32init_start)
LONG(0xdbf2a - code32init_start)
LONG(0xdbf53 - code32init_start)
LONG(0xdbf61 - code32init_start)
LONG(0xdbff1 - code32init_start)
LONG(0xdc00f - code32init_start)
LONG(0xdc020 - code32init_start)
LONG(0xdc047 - code32init_start)
LONG(0xdc06b - code32init_start)
LONG(0xdc080 - code32init_start)
LONG(0xdc095 - code32init_start)
LONG(0xdc0c1 - code32init_start)
LONG(0xdc0e6 - code32init_start)
LONG(0xdc151 - code32init_start)
LONG(0xdc232 - code32init_start)
LONG(0xdc286 - code32init_start)
LONG(0xdc292 - code32init_start)
LONG(0xdc3c4 - code32init_start)
LONG(0xdc3e8 - code32init_start)
LONG(0xdc3f2 - code32init_start)
LONG(0xdc448 - code32init_start)
LONG(0xdc477 - code32init_start)
LONG(0xdc481 - code32init_start)
LONG(0xdc52d - code32init_start)
LONG(0xdc53b - code32init_start)
LONG(0xdc595 - code32init_start)
LONG(0xdc74e - code32init_start)
LONG(0xdc783 - code32init_start)
LONG(0xdc7c4 - code32init_start)
LONG(0xdc7e1 - code32init_start)
LONG(0xdc804 - code32init_start)
LONG(0xdc82b - code32init_start)
LONG(0xdc83e - code32init_start)
LONG(0xdc872 - code32init_start)
LONG(0xdc8ab - code32init_start)
LONG(0xdc8dd - code32init_start)
LONG(0xdc93a - code32init_start)
LONG(0xdc9cd - code32init_start)
LONG(0xdca8c - code32init_start)
LONG(0xdcaca - code32init_start)
LONG(0xdcb20 - code32init_start)
LONG(0xdcb7c - code32init_start)
LONG(0xdcb8a - code32init_start)
LONG(0xdcc07 - code32init_start)
LONG(0xdcc2a - code32init_start)
LONG(0xdcc9e - code32init_start)
LONG(0xdccb4 - code32init_start)
LONG(0xdccd8 - code32init_start)
LONG(0xdcd00 - code32init_start)
LONG(0xdce75 - code32init_start)
LONG(0xdcebc - code32init_start)
LONG(0xdcece - code32init_start)
LONG(0xdcf36 - code32init_start)
LONG(0xdd156 - code32init_start)
LONG(0xdd16f - code32init_start)
LONG(0xdd1a9 - code32init_start)
LONG(0xdd1c3 - code32init_start)
LONG(0xdd1dc - code32init_start)
LONG(0xdd22c - code32init_start)
LONG(0xdd23b - code32init_start)
LONG(0xdd3b9 - code32init_start)
LONG(0xdd3d7 - code32init_start)
LONG(0xdd547 - code32init_start)
LONG(0xdd658 - code32init_start)
LONG(0xdd754 - code32init_start)
LONG(0xdd851 - code32init_start)
LONG(0xdd874 - code32init_start)
LONG(0xdd87f - code32init_start)
LONG(0xdd88a - code32init_start)
LONG(0xdd9b7 - code32init_start)
LONG(0xdda69 - code32init_start)
LONG(0xdda77 - code32init_start)
LONG(0xddac8 - code32init_start)
LONG(0xddc6b - code32init_start)
LONG(0xddca2 - code32init_start)
LONG(0xddce3 - code32init_start)
LONG(0xddd03 - code32init_start)
LONG(0xddd2e - code32init_start)
LONG(0xdddd9 - code32init_start)
LONG(0xdde34 - code32init_start)
LONG(0xdde78 - code32init_start)
LONG(0xddef3 - code32init_start)
LONG(0xddf68 - code32init_start)
LONG(0xddff1 - code32init_start)
LONG(0xddfff - code32init_start)
LONG(0xde037 - code32init_start)
LONG(0xde0b8 - code32init_start)
LONG(0xde0c6 - code32init_start)
LONG(0xde0dd - code32init_start)
LONG(0xde0f6 - code32init_start)
LONG(0xde10a - code32init_start)
LONG(0xde188 - code32init_start)
LONG(0xde196 - code32init_start)
LONG(0xde1ac - code32init_start)
LONG(0xde232 - code32init_start)
LONG(0xde2e6 - code32init_start)
LONG(0xde3ce - code32init_start)
LONG(0xde3e5 - code32init_start)
LONG(0xde3fa - code32init_start)
LONG(0xde41a - code32init_start)
LONG(0xde436 - code32init_start)
LONG(0xde449 - code32init_start)
LONG(0xde453 - code32init_start)
LONG(0xde465 - code32init_start)
LONG(0xde4c4 - code32init_start)
LONG(0xde525 - code32init_start)
LONG(0xde536 - code32init_start)
LONG(0xde543 - code32init_start)
LONG(0xde550 - code32init_start)
LONG(0xde561 - code32init_start)
LONG(0xde575 - code32init_start)
LONG(0xde590 - code32init_start)
LONG(0xde5a3 - code32init_start)
LONG(0xde693 - code32init_start)
LONG(0xde6db - code32init_start)
LONG(0xde73b - code32init_start)
LONG(0xde91a - code32init_start)
LONG(0xde977 - code32init_start)
LONG(0xde9dd - code32init_start)
LONG(0xdea39 - code32init_start)
LONG(0xdea4a - code32init_start)
LONG(0xdea85 - code32init_start)
LONG(0xdea9b - code32init_start)
LONG(0xdeace - code32init_start)
LONG(0xdeb02 - code32init_start)
LONG(0xdeb5b - code32init_start)
LONG(0xdeb8b - code32init_start)
LONG(0xdeb93 - code32init_start)
LONG(0xdeba3 - code32init_start)
LONG(0xdebb0 - code32init_start)
LONG(0xdec28 - code32init_start)
LONG(0xdecc3 - code32init_start)
LONG(0xded0a - code32init_start)
LONG(0xded16 - code32init_start)
LONG(0xded5c - code32init_start)
LONG(0xdede1 - code32init_start)
LONG(0xdedfc - code32init_start)
LONG(0xdee13 - code32init_start)
LONG(0xdee2a - code32init_start)
LONG(0xdee3e - code32init_start)
LONG(0xdee52 - code32init_start)
LONG(0xdee6a - code32init_start)
LONG(0xdee9e - code32init_start)
LONG(0xdeef0 - code32init_start)
LONG(0xdef59 - code32init_start)
LONG(0xdef7d - code32init_start)
LONG(0xdef96 - code32init_start)
LONG(0xdefb1 - code32init_start)
LONG(0xdf01a - code32init_start)
LONG(0xdf037 - code32init_start)
LONG(0xdf3ab - code32init_start)
LONG(0xdf424 - code32init_start)
LONG(0xdf433 - code32init_start)
LONG(0xdf454 - code32init_start)
LONG(0xdf4bd - code32init_start)
LONG(0xdf4f4 - code32init_start)
LONG(0xdf502 - code32init_start)
LONG(0xdf528 - code32init_start)
LONG(0xdf5a2 - code32init_start)
LONG(0xdf5ca - code32init_start)
LONG(0xdf733 - code32init_start)
LONG(0xdf75e - code32init_start)
LONG(0xdf842 - code32init_start)
LONG(0xdf853 - code32init_start)
LONG(0xdf87c - code32init_start)
LONG(0xdf8b4 - code32init_start)
LONG(0xdf8c5 - code32init_start)
LONG(0xdf91d - code32init_start)
LONG(0xdf98f - code32init_start)
LONG(0xdfa09 - code32init_start)
LONG(0xdfa2a - code32init_start)
LONG(0xdfa5b - code32init_start)
LONG(0xdfab9 - code32init_start)
LONG(0xdfad2 - code32init_start)
LONG(0xdfb28 - code32init_start)
LONG(0xdfb82 - code32init_start)
LONG(0xdfc1f - code32init_start)
LONG(0xdfc35 - code32init_start)
LONG(0xdfc5b - code32init_start)
LONG(0xdfd5e - code32init_start)
LONG(0xdfd83 - code32init_start)
LONG(0xdfda1 - code32init_start)
LONG(0xdfdd4 - code32init_start)
LONG(0xdfe08 - code32init_start)
LONG(0xdfe2a - code32init_start)
LONG(0xdfe4c - code32init_start)
LONG(0xdfe61 - code32init_start)
LONG(0xdff95 - code32init_start)
LONG(0xe0158 - code32init_start)
LONG(0xe0892 - code32init_start)
LONG(0xe09aa - code32init_start)
LONG(0xe09cd - code32init_start)
LONG(0xe0a3c - code32init_start)
LONG(0xe0a54 - code32init_start)
LONG(0xe0ab0 - code32init_start)
LONG(0xe0ade - code32init_start)
LONG(0xe0d0d - code32init_start)
LONG(0xe0e06 - code32init_start)
LONG(0xe0e23 - code32init_start)
LONG(0xe0e4b - code32init_start)
LONG(0xe0e7b - code32init_start)
LONG(0xe0eb5 - code32init_start)
LONG(0xe0fbf - code32init_start)
LONG(0xe0fe7 - code32init_start)
LONG(0xe1007 - code32init_start)
LONG(0xe104f - code32init_start)
LONG(0xe1093 - code32init_start)
LONG(0xe109d - code32init_start)
LONG(0xe10ee - code32init_start)
LONG(0xe1123 - code32init_start)
LONG(0xe1150 - code32init_start)
LONG(0xe121f - code32init_start)
LONG(0xe122d - code32init_start)
LONG(0xe1236 - code32init_start)
LONG(0xe1301 - code32init_start)
LONG(0xe130f - code32init_start)
LONG(0xe139f - code32init_start)
LONG(0xe1417 - code32init_start)
LONG(0xe142d - code32init_start)
LONG(0xe1449 - code32init_start)
LONG(0xe1464 - code32init_start)
LONG(0xe147b - code32init_start)
LONG(0xe1484 - code32init_start)
LONG(0xe14b7 - code32init_start)
LONG(0xe14d0 - code32init_start)
LONG(0xe14f8 - code32init_start)
LONG(0xe1596 - code32init_start)
LONG(0xe15de - code32init_start)
LONG(0xe15ff - code32init_start)
LONG(0xe1688 - code32init_start)
LONG(0xe16a1 - code32init_start)
LONG(0xe16b9 - code32init_start)
LONG(0xe16c7 - code32init_start)
LONG(0xe16d9 - code32init_start)
LONG(0xe16ec - code32init_start)
LONG(0xe170b - code32init_start)
LONG(0xe17bd - code32init_start)
LONG(0xe1819 - code32init_start)
LONG(0xe192c - code32init_start)
LONG(0xe19fb - code32init_start)
LONG(0xe1a91 - code32init_start)
LONG(0xe1ac7 - code32init_start)
LONG(0xe1add - code32init_start)
LONG(0xe1af0 - code32init_start)
LONG(0xe1b09 - code32init_start)
LONG(0xe1b19 - code32init_start)
LONG(0xe1bad - code32init_start)
LONG(0xe1bbc - code32init_start)
LONG(0xe1bc9 - code32init_start)
LONG(0xe1bdf - code32init_start)
LONG(0xe1ca5 - code32init_start)
LONG(0xe1cbe - code32init_start)
LONG(0xe1d09 - code32init_start)
LONG(0xe1d35 - code32init_start)
LONG(0xe1d96 - code32init_start)
LONG(0xe1e1e - code32init_start)
LONG(0xe1e4a - code32init_start)
LONG(0xe1ea4 - code32init_start)
LONG(0xe1f5c - code32init_start)
LONG(0xe1f70 - code32init_start)
LONG(0xe1f9c - code32init_start)
LONG(0xe2037 - code32init_start)
LONG(0xe209a - code32init_start)
LONG(0xe20ab - code32init_start)
LONG(0xe20c3 - code32init_start)
LONG(0xe20ea - code32init_start)
LONG(0xe20fb - code32init_start)
LONG(0xe2112 - code32init_start)
LONG(0xe213f - code32init_start)
LONG(0xe2148 - code32init_start)
LONG(0xe2159 - code32init_start)
LONG(0xe2170 - code32init_start)
LONG(0xe2193 - code32init_start)
LONG(0xe21b8 - code32init_start)
LONG(0xe21cb - code32init_start)
LONG(0xe21e6 - code32init_start)
LONG(0xe221b - code32init_start)
LONG(0xe22d7 - code32init_start)
LONG(0xe248e - code32init_start)
LONG(0xe25ba - code32init_start)
LONG(0xe265a - code32init_start)
LONG(0xe269c - code32init_start)
LONG(0xe2784 - code32init_start)
LONG(0xe2792 - code32init_start)
LONG(0xe27e5 - code32init_start)
LONG(0xe282a - code32init_start)
LONG(0xe2864 - code32init_start)
LONG(0xe2970 - code32init_start)
LONG(0xe29d1 - code32init_start)
LONG(0xe2a2a - code32init_start)
LONG(0xe2acf - code32init_start)
LONG(0xe2b19 - code32init_start)
LONG(0xe2bbe - code32init_start)
LONG(0xe2be6 - code32init_start)
LONG(0xe2c69 - code32init_start)
LONG(0xe2c85 - code32init_start)
LONG(0xe2d32 - code32init_start)
LONG(0xe2d4b - code32init_start)
LONG(0xe2dbf - code32init_start)
LONG(0xe2ddc - code32init_start)
LONG(0xe2e81 - code32init_start)
LONG(0xe2e9d - code32init_start)
LONG(0xe2f55 - code32init_start)
LONG(0xe2fc5 - code32init_start)
LONG(0xe3052 - code32init_start)
LONG(0xe30c0 - code32init_start)
LONG(0xe3153 - code32init_start)
LONG(0xe3195 - code32init_start)
LONG(0xe31a6 - code32init_start)
LONG(0xe326a - code32init_start)
LONG(0xe327c - code32init_start)
LONG(0xe3288 - code32init_start)
LONG(0xe32c7 - code32init_start)
LONG(0xe331b - code32init_start)
LONG(0xe332c - code32init_start)
LONG(0xe337d - code32init_start)
LONG(0xe3417 - code32init_start)
LONG(0xe344e - code32init_start)
LONG(0xe34c7 - code32init_start)
LONG(0xe356d - code32init_start)
LONG(0xe357a - code32init_start)
LONG(0xe3583 - code32init_start)
LONG(0xe35c0 - code32init_start)
LONG(0xe35f6 - code32init_start)
LONG(0xe3609 - code32init_start)
LONG(0xe3666 - code32init_start)
LONG(0xe3678 - code32init_start)
LONG(0xe36ac - code32init_start)
LONG(0xe36bf - code32init_start)
LONG(0xe36e8 - code32init_start)
LONG(0xe36fb - code32init_start)
LONG(0xe3712 - code32init_start)
LONG(0xe3725 - code32init_start)
LONG(0xe374e - code32init_start)
LONG(0xe3761 - code32init_start)
LONG(0xe37d5 - code32init_start)
LONG(0xe3812 - code32init_start)
LONG(0xe3829 - code32init_start)
LONG(0xe3878 - code32init_start)
LONG(0xe38a6 - code32init_start)
LONG(0xe3928 - code32init_start)
LONG(0xe3964 - code32init_start)
LONG(0xe3988 - code32init_start)
LONG(0xe39ca - code32init_start)
LONG(0xe3a1c - code32init_start)
LONG(0xe3a26 - code32init_start)
LONG(0xe3a8f - code32init_start)
LONG(0xe3b21 - code32init_start)
LONG(0xe3b33 - code32init_start)
LONG(0xe3b4e - code32init_start)
LONG(0xe3b98 - code32init_start)
LONG(0xe3f93 - code32init_start)
LONG(0xe3fc1 - code32init_start)
LONG(0xe4039 - code32init_start)
LONG(0xe408e - code32init_start)
LONG(0xe409e - code32init_start)
LONG(0xe40b9 - code32init_start)
LONG(0xe410c - code32init_start)
LONG(0xe41a9 - code32init_start)
LONG(0xe42a8 - code32init_start)
LONG(0xe4ffe - code32init_start)
LONG(0xe5015 - code32init_start)
LONG(0xe5050 - code32init_start)
LONG(0xe50e4 - code32init_start)
LONG(0xe5125 - code32init_start)
LONG(0xe5144 - code32init_start)
LONG(0xe515a - code32init_start)
LONG(0xe51bf - code32init_start)
LONG(0xe51ec - code32init_start)
LONG(0xe5207 - code32init_start)
LONG(0xe5266 - code32init_start)
LONG(0xe527f - code32init_start)
LONG(0xe529c - code32init_start)
LONG(0xe52b9 - code32init_start)
LONG(0xe52d0 - code32init_start)
LONG(0xe52e0 - code32init_start)
LONG(0xe52eb - code32init_start)
LONG(0xe52fe - code32init_start)
LONG(0xe531b - code32init_start)
LONG(0xe5336 - code32init_start)
LONG(0xe5353 - code32init_start)
LONG(0xe5370 - code32init_start)
LONG(0xe538d - code32init_start)
LONG(0xe53af - code32init_start)
LONG(0xe53cf - code32init_start)
LONG(0xe5501 - code32init_start)
LONG(0xe5549 - code32init_start)
LONG(0xe557f - code32init_start)
LONG(0xe5589 - code32init_start)
LONG(0xe5593 - code32init_start)
LONG(0xe560f - code32init_start)
LONG(0xe5698 - code32init_start)
LONG(0xe56bf - code32init_start)
LONG(0xe56eb - code32init_start)
LONG(0xe572f - code32init_start)
LONG(0xe5742 - code32init_start)
LONG(0xe574d - code32init_start)
LONG(0xe5760 - code32init_start)
LONG(0xe576f - code32init_start)
LONG(0xe5842 - code32init_start)
LONG(0xe5868 - code32init_start)
LONG(0xe5899 - code32init_start)
LONG(0xe58af - code32init_start)
LONG(0xe58ca - code32init_start)
LONG(0xe58d9 - code32init_start)
LONG(0xe5912 - code32init_start)
LONG(0xe596e - code32init_start)
LONG(0xe59b2 - code32init_start)
LONG(0xe5a07 - code32init_start)
LONG(0xe5a7b - code32init_start)
LONG(0xe5ade - code32init_start)
LONG(0xe5b98 - code32init_start)
LONG(0xe5bb2 - code32init_start)
LONG(0xe5bc1 - code32init_start)
LONG(0xe5bdd - code32init_start)
LONG(0xe5c5c - code32init_start)
LONG(0xe5f10 - code32init_start)
LONG(0xe5fc4 - code32init_start)
LONG(0xe6071 - code32init_start)
LONG(0xe6084 - code32init_start)
LONG(0xe60ae - code32init_start)
LONG(0xe60c0 - code32init_start)
LONG(0xe6123 - code32init_start)
LONG(0xe613a - code32init_start)
LONG(0xe6176 - code32init_start)
LONG(0xe618e - code32init_start)
LONG(0xe61e3 - code32init_start)
LONG(0xe6205 - code32init_start)
LONG(0xe6210 - code32init_start)
LONG(0xe621f - code32init_start)
LONG(0xe623f - code32init_start)
LONG(0xe6244 - code32init_start)
LONG(0xe6266 - code32init_start)
LONG(0xe6282 - code32init_start)
LONG(0xe6291 - code32init_start)
LONG(0xe629f - code32init_start)
LONG(0xe62da - code32init_start)
LONG(0xe62e9 - code32init_start)
LONG(0xe6305 - code32init_start)
LONG(0xe6341 - code32init_start)
LONG(0xe6362 - code32init_start)
LONG(0xe63b1 - code32init_start)
LONG(0xe63ff - code32init_start)
LONG(0xe641d - code32init_start)
LONG(0xe643d - code32init_start)
LONG(0xe64bc - code32init_start)
LONG(0xe64f0 - code32init_start)
LONG(0xe6528 - code32init_start)
LONG(0xe6534 - code32init_start)
LONG(0xe6560 - code32init_start)
LONG(0xe6587 - code32init_start)
LONG(0xe6595 - code32init_start)
LONG(0xe65b5 - code32init_start)
LONG(0xe65be - code32init_start)
LONG(0xe65d8 - code32init_start)
LONG(0xe6623 - code32init_start)
LONG(0xe662c - code32init_start)
LONG(0xe6646 - code32init_start)
LONG(0xe6659 - code32init_start)
LONG(0xe6673 - code32init_start)
LONG(0xe6684 - code32init_start)
LONG(0xe66bc - code32init_start)
LONG(0xe66ff - code32init_start)
LONG(0xe6738 - code32init_start)
LONG(0xe6818 - code32init_start)
LONG(0xe697d - code32init_start)
LONG(0xe698e - code32init_start)
LONG(0xe6a2e - code32init_start)
        _reloc_rel_end = ABSOLUTE(.) ;
        _reloc_init_start = ABSOLUTE(.) ;
LONG(0xee30c - code32flat_start)
LONG(0xfd0d5 - code32flat_start)
LONG(0xfe7c8 - code32flat_start)
        _reloc_init_end = ABSOLUTE(.) ;

. = ( 0xd2c20 - code32flat_start ) ;
*32flat.*(.data.varlow../src/tcgbios.c.1414)
. = ( 0xd2c21 - code32flat_start ) ;
*32flat.*(.data.varlow../src/tcgbios.c.962)
. = ( 0xd2c24 - code32flat_start ) ;
*32flat.*(.data.varlow../src/tcgbios.c.49)
. = ( 0xd2c38 - code32flat_start ) ;
*32flat.*(.data.varlow../src/boot.c.1020)
. = ( 0xd2c3c - code32flat_start ) ;
*32flat.*(.data.varlow../src/hw/mpt-scsi.c.48)
. = ( 0xd2c40 - code32flat_start ) ;
*32flat.*(.data.varlow../src/hw/floppy.c.194)
. = ( 0xd2c44 - code32flat_start ) ;
*32flat.*(.data.varlow../src/hw/usb-hid.c.274)
. = ( 0xd2c4c - code32flat_start ) ;
*32flat.*(.data.varlow../src/hw/ps2port.c.211)
. = ( 0xd2c50 - code32flat_start ) ;
*32flat.*(.data.varlow../src/hw/rtc.c.74)
. = ( 0xd2c54 - code32flat_start ) ;
*32flat.*(.data.varlow../src/hw/timer.c.155)
. = ( 0xd2c58 - code32flat_start ) ;
*32flat.*(.data.varlow../src/clock.c.30)
. = ( 0xd2c59 - code32flat_start ) ;
*32flat.*(.data.varlow../src/sercon.c.552)
. = ( 0xd2c5c - code32flat_start ) ;
*32flat.*(.data.varlow../src/sercon.c.551)
. = ( 0xd2c6c - code32flat_start ) ;
*32flat.*(.data.varlow../src/sercon.c.68)
. = ( 0xd2c6d - code32flat_start ) ;
*32flat.*(.data.varlow../src/sercon.c.67)
. = ( 0xd2c6e - code32flat_start ) ;
*32flat.*(.data.varlow../src/sercon.c.66)
. = ( 0xd2c6f - code32flat_start ) ;
*32flat.*(.data.varlow../src/sercon.c.65)
. = ( 0xd2c70 - code32flat_start ) ;
*32flat.*(.data.varlow../src/sercon.c.64)
. = ( 0xd2c71 - code32flat_start ) ;
*32flat.*(.data.varlow../src/sercon.c.51)
. = ( 0xd2c72 - code32flat_start ) ;
*32flat.*(.data.varlow../src/sercon.c.50)
. = ( 0xd2c74 - code32flat_start ) ;
*32flat.*(.data.varlow../src/sercon.c.49)
. = ( 0xd2c78 - code32flat_start ) ;
*32flat.*(.data.varlow../src/disk.c.439)
. = ( 0xd2c88 - code32flat_start ) ;
*32flat.*(.data.varlow../src/cdrom.c.26)
. = ( 0xd2c8c - code32flat_start ) ;
*32flat.*(.data.varlow../src/cdrom.c.25)
. = ( 0xd2ca0 - code32flat_start ) ;
*32flat.*(.data.varlow../src/block.c.418)
. = ( 0xd2cb0 - code32flat_start ) ;
*32flat.*(.data.varlow../src/stacks.c.327)
. = ( 0xd2cb8 - code32flat_start ) ;
*32flat.*(.data.varlow../src/stacks.c.326)
. = ( 0xd34bc - code32flat_start ) ;
*32flat.*(.data.varlow../src/stacks.c.33)
. = ( 0xd34e0 - code32flat_start ) ;
*32flat.*(.text.hlist_del)
. = ( 0xd34ef - code32flat_start ) ;
*32flat.*(.text.hlist_add)
. = ( 0xd3500 - code32flat_start ) ;
*32flat.*(.text.putc_str)
. = ( 0xd350e - code32flat_start ) ;
*32flat.*(.text.strtcpy)
. = ( 0xd352e - code32flat_start ) ;
*32flat.*(.text.nullTrailingSpace)
. = ( 0xd355c - code32flat_start ) ;
*32flat.*(.text.pci_find_capability)
. = ( 0xd35cf - code32flat_start ) ;
*32flat.*(.text.pci_next)
. = ( 0xd3615 - code32flat_start ) ;
*32flat.*(.text.usb_add_freelist)
. = ( 0xd3622 - code32flat_start ) ;
*32flat.*(.text.usb_get_freelist)
. = ( 0xd3641 - code32flat_start ) ;
*32flat.*(.text.usb_desc2pipe)
. = ( 0xd367b - code32flat_start ) ;
*32flat.*(.text.usb_find_desc)
. = ( 0xd36c2 - code32flat_start ) ;
*32flat.*(.text.uhci_hub_disconnect)
. = ( 0xd36d1 - code32flat_start ) ;
*32flat.*(.text.ohci_hub_detect)
. = ( 0xd36e2 - code32flat_start ) ;
*32flat.*(.text.ohci_hub_disconnect)
. = ( 0xd36f4 - code32flat_start ) ;
*32flat.*(.text.ohci_desc2pipe)
. = ( 0xd373d - code32flat_start ) ;
*32flat.*(.text.ehci_hub_disconnect)
. = ( 0xd3752 - code32flat_start ) ;
*32flat.*(.text.ehci_desc2pipe)
. = ( 0xd37f5 - code32flat_start ) ;
*32flat.*(.text.ata_extract_version)
. = ( 0xd382c - code32flat_start ) ;
*32flat.*(.text.found_compatibleahci)
. = ( 0xd382d - code32flat_start ) ;
*32flat.*(.text.alloc_free)
. = ( 0xd3846 - code32flat_start ) ;
*32flat.*(.text.alloc_find)
. = ( 0xd3865 - code32flat_start ) ;
*32flat.*(.text.malloc_pfree)
. = ( 0xd389a - code32flat_start ) ;
*32flat.*(.text.malloc_getspace)
. = ( 0xd38fc - code32flat_start ) ;
*32flat.*(.text.rom_reserve)
. = ( 0xd3938 - code32flat_start ) ;
*32flat.*(.text.calcRamSize)
. = ( 0xd3986 - code32flat_start ) ;
*32flat.*(.text.romfile_findprefix)
. = ( 0xd39bc - code32flat_start ) ;
*32flat.*(.text.is_pci_vga)
. = ( 0xd3a03 - code32flat_start ) ;
*32flat.*(.text.glob_prefix)
. = ( 0xd3a3d - code32flat_start ) ;
*32flat.*(.text.parse_u32)
. = ( 0xd3a6b - code32flat_start ) ;
*32flat.*(.text.usb_portmap)
. = ( 0xd3a84 - code32flat_start ) ;
*32flat.*(.text.add_bev)
. = ( 0xd3adb - code32flat_start ) ;
*32flat.*(.text.getword)
. = ( 0xd3b04 - code32flat_start ) ;
*32flat.*(.text.idctqtab)
. = ( 0xd3b60 - code32flat_start ) ;
*32flat.*(.text.tpm_can_show_menu)
. = ( 0xd3b92 - code32flat_start ) ;
*32flat.*(.text.pci_find_device)
. = ( 0xd3bba - code32flat_start ) ;
*32flat.*(.text.xhci_hub_detect)
. = ( 0xd3bc9 - code32flat_start ) ;
*32flat.*(.text.xhci_hub_portmap)
. = ( 0xd3c0e - code32flat_start ) ;
*32flat.*(.text.xhci_hub_disconnect)
. = ( 0xd3c0f - code32flat_start ) ;
*32flat.*(.text.smbios_next)
. = ( 0xd3c70 - code32flat_start ) ;
*32flat.*(.text.smbios_get_tables)
. = ( 0xd3c9e - code32flat_start ) ;
*32flat.*(.text.piix_pci_slot_get_irq)
. = ( 0xd3cca - code32flat_start ) ;
*32flat.*(.text.mch_pci_slot_get_irq)
. = ( 0xd3d04 - code32flat_start ) ;
*32flat.*(.text.piix_ide_setup)
. = ( 0xd3d26 - code32flat_start ) ;
*32flat.*(.text.ich9_smbus_setup)
. = ( 0xd3d33 - code32flat_start ) ;
*32flat.*(.text.i440fx_mem_addr_setup)
. = ( 0xd3d6e - code32flat_start ) ;
*32flat.*(.text.pci_region_align)
. = ( 0xd3d84 - code32flat_start ) ;
*32flat.*(.text.pci_region_sum)
. = ( 0xd3dac - code32flat_start ) ;
*32flat.*(.text.pci_region_migrate_64bit_entries)
. = ( 0xd3df0 - code32flat_start ) ;
*32flat.*(.text.pci_bios_init_root_regions_mem)
. = ( 0xd3eca - code32flat_start ) ;
*32flat.*(.text.romfile_loader_find)
. = ( 0xd3f07 - code32flat_start ) ;
*32flat.*(.text.parse_resource_int)
. = ( 0xd3f4d - code32flat_start ) ;
*32flat.*(.text.parse_pkglength)
. = ( 0xd3fb1 - code32flat_start ) ;
*32flat.*(.text.vp_get_features)
. = ( 0xd4076 - code32flat_start ) ;
*32flat.*(.text.vp_set_features)
. = ( 0xd4160 - code32flat_start ) ;
*32flat.*(.text.const_read_file)
. = ( 0xd4186 - code32flat_start ) ;
*32flat.*(.text.tpm20_write_EfiSpecIdEventStruct)
. = ( 0xd42ba - code32flat_start ) ;
*32flat.*(.text.fillbits)
. = ( 0xd4332 - code32flat_start ) ;
*32flat.*(.text.dec_rec2)
. = ( 0xd4431 - code32flat_start ) ;
*32flat.*(.text.idct)
. = ( 0xd4740 - code32flat_start ) ;
*32flat.*(.text.parse_nameseg)
. = ( 0xd479b - code32flat_start ) ;
*32flat.*(.text.vp_get_status)
. = ( 0xd47d2 - code32flat_start ) ;
*32flat.*(.text.vp_set_status)
. = ( 0xd4818 - code32flat_start ) ;
*32flat.*(.text.vp_reset)
. = ( 0xd4895 - code32flat_start ) ;
*32flat.*(.text.ata_extract_model.constprop.0)
. = ( 0xd48ba - code32flat_start ) ;
*32flat.*(.text.find_resource)
. = ( 0xd4b2b - code32flat_start ) ;
*32flat.*(.text.parse_namestring.constprop.0)
. = ( 0xd4bfd - code32flat_start ) ;
*32flat.*(.text.parse_termarg_int)
. = ( 0xd4c61 - code32flat_start ) ;
*32flat.*(.text.detect_serial.constprop.0)
. = ( 0xd4ca5 - code32flat_start ) ;
*32flat.*(.text.pci_config_maskw.constprop.0)
. = ( 0xd4cc9 - code32flat_start ) ;
*32flat.*(.text.get_acpi_rsdp_length)
. = ( 0xd4d2f - code32flat_start ) ;
*32flat.*(.text.enable_hwirq.constprop.0)
. = ( 0xd4d67 - code32flat_start ) ;
*32flat.*(.text.pci_init_device.constprop.0.isra.0)
. = ( 0xd4db4 - code32flat_start ) ;
*32flat.*(.text.pci_set_io_region_addr)
. = ( 0xd4e0c - code32flat_start ) ;
*32flat.*(.text.storage_ide_setup)
. = ( 0xd4e66 - code32flat_start ) ;
*32flat.*(.text.pic_ibm_setup)
. = ( 0xd4e7a - code32flat_start ) ;
*32flat.*(.text.apple_macio_setup)
. = ( 0xd4e8e - code32flat_start ) ;
*32flat.*(.text.tpm20_get_suppt_pcrbanks.isra.0)
. = ( 0xd4f10 - code32flat_start ) ;
*32flat.*(.text.readtables)
. = ( 0xd529b - code32flat_start ) ;
*32flat.*(.text.usb_get_period.isra.0)
. = ( 0xd52bb - code32flat_start ) ;
*32flat.*(.text.getFBSize.isra.0)
. = ( 0xd52de - code32flat_start ) ;
*32flat.*(.text.memmove.isra.0)
. = ( 0xd52fc - code32flat_start ) ;
*32flat.*(.text.remove_e820)
. = ( 0xd532b - code32flat_start ) ;
*32flat.*(.text.vp_init_mmio)
. = ( 0xd5367 - code32flat_start ) ;
*32flat.*(.text.tpm_set_log_area)
. = ( 0xd53a4 - code32flat_start ) ;
*32flat.*(.text.alloc_new.isra.0)
. = ( 0xd53f0 - code32flat_start ) ;
*32flat.*(.text.tpm12_get_capability)
. = ( 0xd5464 - code32flat_start ) ;
*32flat.*(.text.tpm12_read_has_owner)
. = ( 0xd5495 - code32flat_start ) ;
*32flat.*(.text.tpm12_read_permanent_flags.constprop.0)
. = ( 0xd54dc - code32flat_start ) ;
*32flat.*(.text.tpm12_enable_tpm.constprop.0)
. = ( 0xd5525 - code32flat_start ) ;
*32flat.*(.text.tpm12_startup)
. = ( 0xd5689 - code32flat_start ) ;
*32flat.*(.text.romfile_find)
. = ( 0xd56ba - code32flat_start ) ;
*32flat.*(.text.romfile_loadint)
. = ( 0xd570e - code32flat_start ) ;
*32flat.*(.text.uhci_hub_reset)
. = ( 0xd574c - code32flat_start ) ;
*32flat.*(.text.wait_threads)
. = ( 0xd5760 - code32flat_start ) ;
*32flat.*(.text.mutex_lock)
. = ( 0xd5777 - code32flat_start ) ;
*32flat.*(.text.iomemcpy)
. = ( 0xd57bb - code32flat_start ) ;
*32flat.*(.text.qemu_cfg_read_file)
. = ( 0xd5811 - code32flat_start ) ;
*32flat.*(.text.wait_preempt.isra.0)
. = ( 0xd5835 - code32flat_start ) ;
*32flat.*(.text.pci_enable_busmaster)
. = ( 0xd5858 - code32flat_start ) ;
*32flat.*(.text.msleep)
. = ( 0xd5874 - code32flat_start ) ;
*32flat.*(.text.uhci_hub_detect)
. = ( 0xd589e - code32flat_start ) ;
*32flat.*(.text.ehci_hub_reset)
. = ( 0xd58d8 - code32flat_start ) ;
*32flat.*(.text.ehci_hub_detect)
. = ( 0xd5928 - code32flat_start ) ;
*32flat.*(.text.get_keystroke_full)
. = ( 0xd59b8 - code32flat_start ) ;
*32flat.*(.text.get_keystroke)
. = ( 0xd59c5 - code32flat_start ) ;
*32flat.*(.text.call16_int10)
. = ( 0xd59ea - code32flat_start ) ;
*32flat.*(.text.free)
. = ( 0xd5a07 - code32flat_start ) ;
*32flat.*(.text.pci_enable_iobar)
. = ( 0xd5a70 - code32flat_start ) ;
*32flat.*(.text.__end_thread)
. = ( 0xd5a99 - code32flat_start ) ;
*32flat.*(.text.add_drive)
. = ( 0xd5aba - code32flat_start ) ;
*32flat.*(.text.deploy_romfile)
. = ( 0xd5afb - code32flat_start ) ;
*32flat.*(.text.wrmsr_smp)
. = ( 0xd5b42 - code32flat_start ) ;
*32flat.*(.text.insert_e820)
. = ( 0xd5bde - code32flat_start ) ;
*32flat.*(.text.e820_add.part.0)
. = ( 0xd5db2 - code32flat_start ) ;
*32flat.*(.text.e820_add)
. = ( 0xd5dcf - code32flat_start ) ;
*32flat.*(.text.alloc_new_detail)
. = ( 0xd5e59 - code32flat_start ) ;
*32flat.*(.text.malloc_palloc)
. = ( 0xd5e99 - code32flat_start ) ;
*32flat.*(.text.run_thread)
. = ( 0xd5f33 - code32flat_start ) ;
*32flat.*(.text.malloc_tmphigh)
. = ( 0xd5f44 - code32flat_start ) ;
*32flat.*(.text.malloc_tmp)
. = ( 0xd5f64 - code32flat_start ) ;
*32flat.*(.text.malloc_low)
. = ( 0xd5f75 - code32flat_start ) ;
*32flat.*(.text.malloc_fseg)
. = ( 0xd5f86 - code32flat_start ) ;
*32flat.*(.text.memalign_high)
. = ( 0xd5f92 - code32flat_start ) ;
*32flat.*(.text.malloc_high)
. = ( 0xd5fa3 - code32flat_start ) ;
*32flat.*(.text.zalloc_page_aligned)
. = ( 0xd5fbf - code32flat_start ) ;
*32flat.*(.text.alloc_add)
. = ( 0xd600e - code32flat_start ) ;
*32flat.*(.text.usb_enumerate)
. = ( 0xd607c - code32flat_start ) ;
*32flat.*(.text.romfile_loadfile)
. = ( 0xd60e2 - code32flat_start ) ;
*32flat.*(.text.bootentry_add)
. = ( 0xd617a - code32flat_start ) ;
*32flat.*(.text.boot_add_hd)
. = ( 0xd6199 - code32flat_start ) ;
*32flat.*(.text.qemu_romfile_add)
. = ( 0xd6218 - code32flat_start ) ;
*32flat.*(.text.pci_region_create_entry)
. = ( 0xd62f2 - code32flat_start ) ;
*32flat.*(.text.create_bounce_buf)
. = ( 0xd6324 - code32flat_start ) ;
*32flat.*(.text.init_atadrive)
. = ( 0xd637f - code32flat_start ) ;
*32flat.*(.text.nvme_init_cq)
. = ( 0xd63f1 - code32flat_start ) ;
*32flat.*(.text.nvme_init_sq)
. = ( 0xd6465 - code32flat_start ) ;
*32flat.*(.text.tpm20_startup)
. = ( 0xd65aa - code32flat_start ) ;
*32flat.*(.text.pvscsi_init_rings.constprop.0)
. = ( 0xd66cd - code32flat_start ) ;
*32flat.*(.text.__i8042_command)
. = ( 0xd6749 - code32flat_start ) ;
*32flat.*(.text.i8042_flush)
. = ( 0xd6785 - code32flat_start ) ;
*32flat.*(.text.configure_uhci)
. = ( 0xd693f - code32flat_start ) ;
*32flat.*(.text.ohci_hub_reset)
. = ( 0xd69b9 - code32flat_start ) ;
*32flat.*(.text.configure_ohci)
. = ( 0xd6c0d - code32flat_start ) ;
*32flat.*(.text.send_ata_identity)
. = ( 0xd6cb1 - code32flat_start ) ;
*32flat.*(.text.powerup_await_non_bsy)
. = ( 0xd6cfc - code32flat_start ) ;
*32flat.*(.text.ahci_port_reset)
. = ( 0xd6d90 - code32flat_start ) ;
*32flat.*(.text.ahci_port_release)
. = ( 0xd6dbe - code32flat_start ) ;
*32flat.*(.text.wait_bit)
. = ( 0xd6e08 - code32flat_start ) ;
*32flat.*(.text.nvme_admin_identify)
. = ( 0xd6e9b - code32flat_start ) ;
*32flat.*(.text.nvme_wait_csts_rdy)
. = ( 0xd6f01 - code32flat_start ) ;
*32flat.*(.text.configure_ehci)
. = ( 0xd7147 - code32flat_start ) ;
*32flat.*(.text.tsctimer_setfreq.part.0)
. = ( 0xd71aa - code32flat_start ) ;
*32flat.*(.text.pmtimer_setup)
. = ( 0xd71db - code32flat_start ) ;
*32flat.*(.text.piix4_pm_setup)
. = ( 0xd7205 - code32flat_start ) ;
*32flat.*(.text.map_pcirom)
. = ( 0xd7343 - code32flat_start ) ;
*32flat.*(.text.boot_lchs_find)
. = ( 0xd738c - code32flat_start ) ;
*32flat.*(.text.find_prio)
. = ( 0xd73cd - code32flat_start ) ;
*32flat.*(.text.is_bootprio_strict)
. = ( 0xd73f0 - code32flat_start ) ;
*32flat.*(.text.pci_enable_membar)
. = ( 0xd747a - code32flat_start ) ;
*32flat.*(.text.sdcard_set_frequency)
. = ( 0xd750e - code32flat_start ) ;
*32flat.*(.text.pci_find_resource_reserve_capability)
. = ( 0xd759f - code32flat_start ) ;
*32flat.*(.text.pci_bios_init_bus_rec)
. = ( 0xd77ee - code32flat_start ) ;
*32flat.*(.text.dummy_pci_slot_get_irq)
. = ( 0xd77ff - code32flat_start ) ;
*32flat.*(.text.pci_region_map_entries)
. = ( 0xd79fc - code32flat_start ) ;
*32flat.*(.text.piix_isa_bridge_setup)
. = ( 0xd7a6d - code32flat_start ) ;
*32flat.*(.text.vp_init_simple)
. = ( 0xd7ce6 - code32flat_start ) ;
*32flat.*(.text.mch_isa_bridge_setup)
. = ( 0xd7d9b - code32flat_start ) ;
*32flat.*(.text.pci_probe_devices)
. = ( 0xd7f4d - code32flat_start ) ;
*32flat.*(.text.pci_bios_check_devices)
. = ( 0xd86bf - code32flat_start ) ;
*32flat.*(.text.configure_xhci)
. = ( 0xd89b8 - code32flat_start ) ;
*32flat.*(.text.vp_find_vq)
. = ( 0xd8df8 - code32flat_start ) ;
*32flat.*(.text.xhci_controller_setup)
. = ( 0xd8f91 - code32flat_start ) ;
*32flat.*(.text.init_floppy)
. = ( 0xd9010 - code32flat_start ) ;
*32flat.*(.text.usb_send_default_control)
. = ( 0xd9032 - code32flat_start ) ;
*32flat.*(.text.get_port_status)
. = ( 0xd9074 - code32flat_start ) ;
*32flat.*(.text.set_port_feature)
. = ( 0xd90b3 - code32flat_start ) ;
*32flat.*(.text.usb_hub_disconnect)
. = ( 0xd9105 - code32flat_start ) ;
*32flat.*(.text.usb_hub_detect)
. = ( 0xd912f - code32flat_start ) ;
*32flat.*(.text.usb_hub_reset)
. = ( 0xd91d6 - code32flat_start ) ;
*32flat.*(.text.sdcard_pio_app.constprop.0)
. = ( 0xd9218 - code32flat_start ) ;
*32flat.*(.text.copy_fseg_table)
. = ( 0xd925d - code32flat_start ) ;
*32flat.*(.text.copy_pir.part.0)
. = ( 0xd928c - code32flat_start ) ;
*32flat.*(.text.copy_smbios_21)
. = ( 0xd92f2 - code32flat_start ) ;
*32flat.*(.text.copy_smbios_30)
. = ( 0xd933a - code32flat_start ) ;
*32flat.*(.text.copy_mptable.part.0)
. = ( 0xd93f1 - code32flat_start ) ;
*32flat.*(.text.smbios_build_tables)
. = ( 0xd961f - code32flat_start ) ;
*32flat.*(.text.qemu_cfg_detect)
. = ( 0xd969f - code32flat_start ) ;
*32flat.*(.text.xhci_print_port_state.constprop.0)
. = ( 0xd96fd - code32flat_start ) ;
*32flat.*(.text.xhci_cmd_submit)
. = ( 0xd9779 - code32flat_start ) ;
*32flat.*(.text.xhci_hub_reset)
. = ( 0xd9812 - code32flat_start ) ;
*32flat.*(.text.ps2_recvbyte.constprop.0)
. = ( 0xd9896 - code32flat_start ) ;
*32flat.*(.text.ps2_sendbyte.constprop.0)
. = ( 0xd98cb - code32flat_start ) ;
*32flat.*(.text.ps2_kbd_command)
. = ( 0xd99cb - code32flat_start ) ;
*32flat.*(.text.ps2_keyboard_setup)
. = ( 0xd9b17 - code32flat_start ) ;
*32flat.*(.text.mch_mem_addr_setup)
. = ( 0xd9b7d - code32flat_start ) ;
*32flat.*(.text.init_controller.constprop.0)
. = ( 0xd9c1e - code32flat_start ) ;
*32flat.*(.text.found_genericata)
. = ( 0xd9cde - code32flat_start ) ;
*32flat.*(.text.enable_vga_console)
. = ( 0xd9eaf - code32flat_start ) ;
*32flat.*(.text.tpm12_activate_tpm.constprop.0)
. = ( 0xd9f24 - code32flat_start ) ;
*32flat.*(.text.tpm12_set_owner_install.constprop.0)
. = ( 0xd9fa6 - code32flat_start ) ;
*32flat.*(.text.snprintf)
. = ( 0xd9ff1 - code32flat_start ) ;
*32flat.*(.text.bootprio_find_named_rom)
. = ( 0xda040 - code32flat_start ) ;
*32flat.*(.text.build_usb_path)
. = ( 0xda082 - code32flat_start ) ;
*32flat.*(.text.get_field)
. = ( 0xda0cd - code32flat_start ) ;
*32flat.*(.text.get_external)
. = ( 0xda214 - code32flat_start ) ;
*32flat.*(.text.acpi_dsdt_find_string)
. = ( 0xda265 - code32flat_start ) ;
*32flat.*(.text.acpi_dsdt_find_eisaid)
. = ( 0xda2e6 - code32flat_start ) ;
*32flat.*(.text.parse_pkg_skip)
. = ( 0xda329 - code32flat_start ) ;
*32flat.*(.text.parse_termobj)
. = ( 0xda616 - code32flat_start ) ;
*32flat.*(.text.parse_termlist)
. = ( 0xda675 - code32flat_start ) ;
*32flat.*(.text.acpi_dsdt_parse)
. = ( 0xda6c4 - code32flat_start ) ;
*32flat.*(.text.virtio_scsi_init_lun)
. = ( 0xda770 - code32flat_start ) ;
*32flat.*(.text.smbios_init_type_4)
. = ( 0xda98e - code32flat_start ) ;
*32flat.*(.text.smbios_init_type_17)
. = ( 0xdaadf - code32flat_start ) ;
*32flat.*(.text.interface_init)
. = ( 0xdb494 - code32flat_start ) ;
*32flat.*(.text.build_pci_path.constprop.0)
. = ( 0xdb540 - code32flat_start ) ;
*32flat.*(.text.bootprio_find_usb)
. = ( 0xdb5f6 - code32flat_start ) ;
*32flat.*(.text.getRomPriority)
. = ( 0xdb668 - code32flat_start ) ;
*32flat.*(.text.bootprio_find_pci_device)
. = ( 0xdb68a - code32flat_start ) ;
*32flat.*(.text.bootprio_find_ata_device)
. = ( 0xdb6d5 - code32flat_start ) ;
*32flat.*(.text.bootprio_find_scsi_device)
. = ( 0xdb720 - code32flat_start ) ;
*32flat.*(.text.boot_lchs_find_scsi_device.isra.0)
. = ( 0xdb78b - code32flat_start ) ;
*32flat.*(.text.boot_lchs_find_ata_device.isra.0)
. = ( 0xdb7f6 - code32flat_start ) ;
*32flat.*(.text.znprintf)
. = ( 0xdb857 - code32flat_start ) ;
*32flat.*(.text.ahci_port_setup)
. = ( 0xdbcf7 - code32flat_start ) ;
*32flat.*(.text.init_virtio_blk_mmio)
. = ( 0xdbf17 - code32flat_start ) ;
*32flat.*(.text.init_virtio_blk)
. = ( 0xdc20c - code32flat_start ) ;
*32flat.*(.text.nvme_controller_setup)
. = ( 0xdc658 - code32flat_start ) ;
*32flat.*(.text.addFloppy)
. = ( 0xdc6ff - code32flat_start ) ;
*32flat.*(.text.sdcard_card_setup.constprop.0)
. = ( 0xdcaad - code32flat_start ) ;
*32flat.*(.text.sdcard_controller_setup)
. = ( 0xdcbb7 - code32flat_start ) ;
*32flat.*(.text.sdcard_pci_setup)
. = ( 0xdcbe0 - code32flat_start ) ;
*32flat.*(.text.sdcard_romfile_setup)
. = ( 0xdcc1b - code32flat_start ) ;
*32flat.*(.text.init_optionrom.isra.0)
. = ( 0xdcd22 - code32flat_start ) ;
*32flat.*(.text.run_file_roms)
. = ( 0xdcd6c - code32flat_start ) ;
*32flat.*(.text.init_pcirom)
. = ( 0xdce9f - code32flat_start ) ;
*32flat.*(.text.optionrom_setup)
. = ( 0xdd0ad - code32flat_start ) ;
*32flat.*(.text.memalign_tmp)
. = ( 0xdd0d8 - code32flat_start ) ;
*32flat.*(.text.intel_igd_setup)
. = ( 0xdd1e9 - code32flat_start ) ;
*32flat.*(.text.xhci_alloc_inctx)
. = ( 0xdd2d0 - code32flat_start ) ;
*32flat.*(.text.usb_realloc_pipe)
. = ( 0xdde4c - code32flat_start ) ;
*32flat.*(.text.add_pipe_node)
. = ( 0xdde8f - code32flat_start ) ;
*32flat.*(.text.usb_free_pipe)
. = ( 0xdde9b - code32flat_start ) ;
*32flat.*(.text.device_hardware_setup)
. = ( 0xdea1e - code32flat_start ) ;
*32flat.*(.text.platform_hardware_setup)
. = ( 0xe1458 - code32flat_start ) ;
*32flat.*(.text.init../src/stacks.c.737)
. = ( 0xe1468 - code32flat_start ) ;
*32flat.*(.text.cdrom_media_info)
. = ( 0xe1525 - code32flat_start ) ;
*32flat.*(.text.boot_add_cd)
. = ( 0xe157c - code32flat_start ) ;
*32flat.*(.text.ata_detect)
. = ( 0xe19c4 - code32flat_start ) ;
*32flat.*(.text.ahci_port_detect)
. = ( 0xe1b40 - code32flat_start ) ;
*32flat.*(.text.scsi_rep_luns_scan)
. = ( 0xe1c7d - code32flat_start ) ;
*32flat.*(.text.init_esp_scsi)
. = ( 0xe1cf9 - code32flat_start ) ;
*32flat.*(.text.init_virtio_scsi_mmio)
. = ( 0xe1e0e - code32flat_start ) ;
*32flat.*(.text.init_virtio_scsi)
. = ( 0xe1f3e - code32flat_start ) ;
*32flat.*(.text.scsi_drive_setup)
. = ( 0xe22a9 - code32flat_start ) ;
*32flat.*(.text.usb_hub_port_setup)
. = ( 0xe2b94 - code32flat_start ) ;
*32flat.*(.text.uas_add_lun)
. = ( 0xe2c46 - code32flat_start ) ;
*32flat.*(.text.lsi_scsi_add_lun)
. = ( 0xe2d09 - code32flat_start ) ;
*32flat.*(.text.init_lsi_scsi)
. = ( 0xe2d9c - code32flat_start ) ;
*32flat.*(.text.esp_scsi_add_lun)
. = ( 0xe2e5e - code32flat_start ) ;
*32flat.*(.text.mpt_scsi_add_lun)
. = ( 0xe2f21 - code32flat_start ) ;
*32flat.*(.text.init_mpt_scsi)
. = ( 0xe3019 - code32flat_start ) ;
*32flat.*(.text.virtio_scsi_add_lun)
. = ( 0xe3127 - code32flat_start ) ;
*32flat.*(.text.init_pvscsi)
. = ( 0xe3232 - code32flat_start ) ;
*32flat.*(.text.megasas_scan_target)
. = ( 0xe3405 - code32flat_start ) ;
*32flat.*(.text.init_megasas)
. = ( 0xe35e1 - code32flat_start ) ;
*32flat.*(.text.maininit)
. = ( 0xe6237 - code32flat_start ) ;
*32flat.*(.text.init../src/post.c.303)
. = ( 0xe6a19 - code32flat_start ) ;
*32flat.*(.text.init../src/pmm.c.133)
. = ( 0xe6bec - code32flat_start ) ;
*32flat.*(.rodata.find_resource)
. = ( 0xe6c00 - code32flat_start ) ;
*32flat.*(.rodata.parse_termarg_int)
. = ( 0xe6c34 - code32flat_start ) ;
*32flat.*(.rodata.vp_init_simple)
. = ( 0xe6c48 - code32flat_start ) ;
*32flat.*(.rodata.parse_termobj)
. = ( 0xe6c9c - code32flat_start ) ;
*32flat.*(.rodata.maininit)
. = ( 0xe6cfc - code32flat_start ) ;
*32flat.*(.rodata.CSWTCH.1891)
. = ( 0xe6d10 - code32flat_start ) ;
*32flat.*(.rodata.__func__.2)
. = ( 0xe6d20 - code32flat_start ) ;
*32flat.*(.rodata.__func__.3)
. = ( 0xe6d34 - code32flat_start ) ;
*32flat.*(.rodata.__func__.4)
. = ( 0xe6d48 - code32flat_start ) ;
*32flat.*(.rodata.__func__.5)
. = ( 0xe6d58 - code32flat_start ) ;
*32flat.*(.rodata.__func__.6)
. = ( 0xe6d68 - code32flat_start ) ;
*32flat.*(.rodata.__func__.7)
. = ( 0xe6d80 - code32flat_start ) ;
*32flat.*(.rodata.__func__.12)
. = ( 0xe6d94 - code32flat_start ) ;
*32flat.*(.rodata.__func__.13)
. = ( 0xe6da8 - code32flat_start ) ;
*32flat.*(.rodata.__func__.14)
. = ( 0xe6dc0 - code32flat_start ) ;
*32flat.*(.rodata.__func__.15)
. = ( 0xe6dd0 - code32flat_start ) ;
*32flat.*(.rodata.__func__.16)
. = ( 0xe6e00 - code32flat_start ) ;
*32flat.*(.rodata.names.17)
. = ( 0xe6e6c - code32flat_start ) ;
*32flat.*(.rodata.__func__.19)
. = ( 0xe6e78 - code32flat_start ) ;
*32flat.*(.rodata.__func__.21)
. = ( 0xe6e8c - code32flat_start ) ;
*32flat.*(.rodata.__func__.23)
. = ( 0xe6e9c - code32flat_start ) ;
*32flat.*(.rodata.__func__.24)
. = ( 0xe6eac - code32flat_start ) ;
*32flat.*(.rodata.__func__.26)
. = ( 0xe6ecc - code32flat_start ) ;
*32flat.*(.rodata.__func__.27)
. = ( 0xe6ee8 - code32flat_start ) ;
*32flat.*(.rodata.__func__.28)
. = ( 0xe6f04 - code32flat_start ) ;
*32flat.*(.rodata.__func__.29)
. = ( 0xe6f1c - code32flat_start ) ;
*32flat.*(.rodata.__func__.30)
. = ( 0xe6f34 - code32flat_start ) ;
*32flat.*(.rodata.__func__.31)
. = ( 0xe6f50 - code32flat_start ) ;
*32flat.*(.rodata.__func__.32)
. = ( 0xe6f60 - code32flat_start ) ;
*32flat.*(.rodata.__func__.34)
. = ( 0xe6f74 - code32flat_start ) ;
*32flat.*(.rodata.__func__.35)
. = ( 0xe6f84 - code32flat_start ) ;
*32flat.*(.rodata.__func__.36)
. = ( 0xe6f90 - code32flat_start ) ;
*32flat.*(.rodata.__func__.38)
. = ( 0xe6fa0 - code32flat_start ) ;
*32flat.*(.rodata.__func__.39)
. = ( 0xe6fb8 - code32flat_start ) ;
*32flat.*(.rodata.__func__.40)
. = ( 0xe6fd0 - code32flat_start ) ;
*32flat.*(.rodata.__func__.41)
. = ( 0xe6fdc - code32flat_start ) ;
*32flat.*(.rodata.__func__.42)
. = ( 0xe6ff0 - code32flat_start ) ;
*32flat.*(.rodata.__func__.43)
. = ( 0xe7008 - code32flat_start ) ;
*32flat.*(.rodata.__func__.44)
. = ( 0xe701c - code32flat_start ) ;
*32flat.*(.rodata.__func__.47)
. = ( 0xe7030 - code32flat_start ) ;
*32flat.*(.rodata.__func__.48)
. = ( 0xe703c - code32flat_start ) ;
*32flat.*(.rodata.__func__.49)
. = ( 0xe7050 - code32flat_start ) ;
*32flat.*(.rodata.__func__.50)
. = ( 0xe706c - code32flat_start ) ;
*32flat.*(.rodata.__func__.51)
. = ( 0xe707c - code32flat_start ) ;
*32flat.*(.rodata.__func__.52)
. = ( 0xe708c - code32flat_start ) ;
*32flat.*(.rodata.__func__.53)
. = ( 0xe70a0 - code32flat_start ) ;
*32flat.*(.rodata.__func__.54)
. = ( 0xe70b8 - code32flat_start ) ;
*32flat.*(.rodata.__func__.57)
. = ( 0xe70c8 - code32flat_start ) ;
*32flat.*(.rodata.__func__.59)
. = ( 0xe70dc - code32flat_start ) ;
*32flat.*(.rodata.__func__.62)
. = ( 0xe70ec - code32flat_start ) ;
*32flat.*(.rodata.__func__.63)
. = ( 0xe70fc - code32flat_start ) ;
*32flat.*(.rodata.__func__.64)
. = ( 0xe710c - code32flat_start ) ;
*32flat.*(.rodata.__func__.65)
. = ( 0xe7120 - code32flat_start ) ;
*32flat.*(.rodata.__func__.66)
. = ( 0xe7138 - code32flat_start ) ;
*32flat.*(.rodata.__func__.67)
. = ( 0xe7144 - code32flat_start ) ;
*32flat.*(.rodata.__func__.68)
. = ( 0xe7154 - code32flat_start ) ;
*32flat.*(.rodata.__func__.69)
. = ( 0xe7164 - code32flat_start ) ;
*32flat.*(.rodata.__func__.70)
. = ( 0xe7174 - code32flat_start ) ;
*32flat.*(.rodata.__func__.71)
. = ( 0xe7188 - code32flat_start ) ;
*32flat.*(.rodata.__func__.72)
. = ( 0xe7198 - code32flat_start ) ;
*32flat.*(.rodata.__func__.73)
. = ( 0xe71ac - code32flat_start ) ;
*32flat.*(.rodata.__func__.74)
. = ( 0xe71bc - code32flat_start ) ;
*32flat.*(.rodata.__func__.75)
. = ( 0xe71cc - code32flat_start ) ;
*32flat.*(.rodata.__func__.76)
. = ( 0xe71e4 - code32flat_start ) ;
*32flat.*(.rodata.__func__.78)
. = ( 0xe71f8 - code32flat_start ) ;
*32flat.*(.rodata.__func__.79)
. = ( 0xe720c - code32flat_start ) ;
*32flat.*(.rodata.__func__.80)
. = ( 0xe7220 - code32flat_start ) ;
*32flat.*(.rodata.evt_separator.82)
. = ( 0xe7224 - code32flat_start ) ;
*32flat.*(.rodata.__func__.83)
. = ( 0xe7238 - code32flat_start ) ;
*32flat.*(.rodata.__func__.84)
. = ( 0xe724c - code32flat_start ) ;
*32flat.*(.rodata.__func__.87)
. = ( 0xe725c - code32flat_start ) ;
*32flat.*(.rodata.__func__.88)
. = ( 0xe7270 - code32flat_start ) ;
*32flat.*(.rodata.__func__.89)
. = ( 0xe7280 - code32flat_start ) ;
*32flat.*(.rodata.__func__.91)
. = ( 0xe7290 - code32flat_start ) ;
*32flat.*(.rodata.__func__.92)
. = ( 0xe729c - code32flat_start ) ;
*32flat.*(.rodata.__func__.93)
. = ( 0xe72ac - code32flat_start ) ;
*32flat.*(.rodata.__func__.94)
. = ( 0xe72c0 - code32flat_start ) ;
*32flat.*(.rodata.__func__.95)
. = ( 0xe72d8 - code32flat_start ) ;
*32flat.*(.rodata.__func__.96)
. = ( 0xe72ec - code32flat_start ) ;
*32flat.*(.rodata.__func__.99)
. = ( 0xe7300 - code32flat_start ) ;
*32flat.*(.rodata.__func__.100)
. = ( 0xe730c - code32flat_start ) ;
*32flat.*(.rodata.__func__.101)
. = ( 0xe7314 - code32flat_start ) ;
*32flat.*(.rodata.__func__.102)
. = ( 0xe7328 - code32flat_start ) ;
*32flat.*(.rodata.__func__.103)
. = ( 0xe7334 - code32flat_start ) ;
*32flat.*(.rodata.__func__.104)
. = ( 0xe7348 - code32flat_start ) ;
*32flat.*(.rodata.__func__.105)
. = ( 0xe7358 - code32flat_start ) ;
*32flat.*(.rodata.__func__.106)
. = ( 0xe736c - code32flat_start ) ;
*32flat.*(.rodata.__func__.108)
. = ( 0xe7380 - code32flat_start ) ;
*32flat.*(.rodata.__func__.109)
. = ( 0xe7394 - code32flat_start ) ;
*32flat.*(.rodata.__func__.110)
. = ( 0xe73a4 - code32flat_start ) ;
*32flat.*(.rodata.__func__.111)
. = ( 0xe73b4 - code32flat_start ) ;
*32flat.*(.rodata.__func__.112)
. = ( 0xe73cc - code32flat_start ) ;
*32flat.*(.rodata.__func__.114)
. = ( 0xe73dc - code32flat_start ) ;
*32flat.*(.rodata.__func__.115)
. = ( 0xe73e8 - code32flat_start ) ;
*32flat.*(.rodata.__func__.119)
. = ( 0xe73f4 - code32flat_start ) ;
*32flat.*(.rodata.__func__.120)
. = ( 0xe7408 - code32flat_start ) ;
*32flat.*(.rodata.__func__.121)
. = ( 0xe7414 - code32flat_start ) ;
*32flat.*(.rodata.__func__.122)
. = ( 0xe7428 - code32flat_start ) ;
*32flat.*(.rodata.__func__.123)
. = ( 0xe7438 - code32flat_start ) ;
*32flat.*(.rodata.__func__.126)
. = ( 0xe7450 - code32flat_start ) ;
*32flat.*(.rodata.__func__.127)
. = ( 0xe7464 - code32flat_start ) ;
*32flat.*(.rodata.__func__.129)
. = ( 0xe7474 - code32flat_start ) ;
*32flat.*(.rodata.__func__.130)
. = ( 0xe748c - code32flat_start ) ;
*32flat.*(.rodata.__func__.133)
. = ( 0xe74a0 - code32flat_start ) ;
*32flat.*(.rodata.__func__.135)
. = ( 0xe74b0 - code32flat_start ) ;
*32flat.*(.rodata.__func__.136)
. = ( 0xe74bc - code32flat_start ) ;
*32flat.*(.rodata.__func__.137)
. = ( 0xe74cc - code32flat_start ) ;
*32flat.*(.rodata.__func__.138)
. = ( 0xe74e4 - code32flat_start ) ;
*32flat.*(.rodata.__func__.141)
. = ( 0xe74fc - code32flat_start ) ;
*32flat.*(.rodata.__func__.142)
. = ( 0xe7510 - code32flat_start ) ;
*32flat.*(.rodata.__func__.144)
. = ( 0xe7520 - code32flat_start ) ;
*32flat.*(.rodata.__func__.145)
. = ( 0xe7538 - code32flat_start ) ;
*32flat.*(.rodata.__func__.146)
. = ( 0xe754c - code32flat_start ) ;
*32flat.*(.rodata.__func__.147)
. = ( 0xe755c - code32flat_start ) ;
*32flat.*(.rodata.__func__.148)
. = ( 0xe7568 - code32flat_start ) ;
*32flat.*(.rodata.__func__.149)
. = ( 0xe757c - code32flat_start ) ;
*32flat.*(.rodata.__func__.150)
. = ( 0xe758c - code32flat_start ) ;
*32flat.*(.rodata.__func__.151)
. = ( 0xe759c - code32flat_start ) ;
*32flat.*(.rodata.mem_power.158)
. = ( 0xe75a4 - code32flat_start ) ;
*32flat.*(.rodata.__func__.224)
. = ( 0xe75b4 - code32flat_start ) ;
*32flat.*(.rodata.__func__.225)
. = ( 0xe75c0 - code32flat_start ) ;
*32flat.*(.rodata.__func__.226)
. = ( 0xe75d4 - code32flat_start ) ;
*32flat.*(.rodata.__func__.227)
. = ( 0xe75e0 - code32flat_start ) ;
*32flat.*(.rodata.pci_platform_tbl)
. = ( 0xe7620 - code32flat_start ) ;
*32flat.*(.rodata.pci_device_tbl)
. = ( 0xe7738 - code32flat_start ) ;
*32flat.*(.rodata.pci_irqs)
. = ( 0xe773c - code32flat_start ) ;
*32flat.*(.rodata.region_type_name)
. = ( 0xe7748 - code32flat_start ) ;
*32flat.*(.rodata.speed_to_xhci)
. = ( 0xe7760 - code32flat_start ) ;
*32flat.*(.rodata.speed_from_xhci)
. = ( 0xe77a0 - code32flat_start ) ;
*32flat.*(.rodata.speed_name)
. = ( 0xe77e0 - code32flat_start ) ;
*32flat.*(.rodata.aaidct)
. = ( 0xe7800 - code32flat_start ) ;
*32flat.*(.rodata.zig)
. = ( 0xe7840 - code32flat_start ) ;
*32flat.*(.rodata.menuchars)
. = ( 0xe7880 - code32flat_start ) ;
*32flat.*(.rodata.pci_ata_tbl)
. = ( 0xe78bc - code32flat_start ) ;
*32flat.*(.rodata.speed_to_ctlsize)
. = ( 0xe78cc - code32flat_start ) ;
*32flat.*(.data.prio_halt.90)
. = ( 0xe78d0 - code32flat_start ) ;
*32flat.*(.data.varinit../src/fw/dsdt_parser.c.27)
. = ( 0xe78e0 - code32flat_start ) ;
*32flat.*(.data.PIR_TABLE)
. = ( 0xe7960 - code32flat_start ) ;
*32flat.*(.data.pci_slot_get_irq)
. = ( 0xe7964 - code32flat_start ) ;
*32flat.*(.data.pci_pad_mem64)
. = ( 0xe7968 - code32flat_start ) ;
*32flat.*(.data.pci_io_low_end)
. = ( 0xe7970 - code32flat_start ) ;
*32flat.*(.data.pcimem_start)
. = ( 0xe7978 - code32flat_start ) ;
*32flat.*(.data.HubOp)
. = ( 0xe7988 - code32flat_start ) ;
*32flat.*(.data.xhci_hub_ops)
. = ( 0xe7998 - code32flat_start ) ;
*32flat.*(.data.varinit../src/hw/pcidevice.c.16)
. = ( 0xe79a0 - code32flat_start ) ;
*32flat.*(.data.zig2)
. = ( 0xe79e0 - code32flat_start ) ;
*32flat.*(.data.varinit../src/boot.c.507)
. = ( 0xe79e4 - code32flat_start ) ;
*32flat.*(.data.DefaultBEVPrio)
. = ( 0xe79e8 - code32flat_start ) ;
*32flat.*(.data.DefaultHDPrio)
. = ( 0xe79ec - code32flat_start ) ;
*32flat.*(.data.DefaultCDPrio)
. = ( 0xe79f0 - code32flat_start ) ;
*32flat.*(.data.DefaultFloppyPrio)
. = ( 0xe79f4 - code32flat_start ) ;
*32flat.*(.data.varinit../src/boot.c.238)
. = ( 0xe79f8 - code32flat_start ) ;
*32flat.*(.data.varinit../src/boot.c.103)
. = ( 0xe79fc - code32flat_start ) ;
*32flat.*(.data.varinit../src/romfile.c.13)
. = ( 0xe7a00 - code32flat_start ) ;
*32flat.*(.data.RomEnd)
. = ( 0xe7a04 - code32flat_start ) ;
*32flat.*(.data.varinit../src/malloc.c.40)
. = ( 0xe7a18 - code32flat_start ) ;
*32flat.*(.data.varinit../src/malloc.c.38)
. = ( 0xe7a20 - code32flat_start ) ;
*32flat.*(.data.varinit../src/malloc.c.37)
. = ( 0xe7a24 - code32flat_start ) ;
*32flat.*(.data.varinit../src/malloc.c.36)
. = ( 0xe7a2c - code32flat_start ) ;
*32flat.*(.data.MptIOCInitRequest)
. = ( 0xe7a44 - code32flat_start ) ;
*32flat.*(.data.ehci_HubOp)
. = ( 0xe7a54 - code32flat_start ) ;
*32flat.*(.data.ohci_HubOp)
. = ( 0xe7a64 - code32flat_start ) ;
*32flat.*(.data.uhci_HubOp)
. = ( 0xe7a80 - code32flat_start ) ;
*32flat.*(.bss.used_bitmap.33)
. = ( 0xe7aa0 - code32flat_start ) ;
*32flat.*(.bss.ataid.113)
. = ( 0xe7aa4 - code32flat_start ) ;
*32flat.*(.bss.xen_hypercall_page)
. = ( 0xe7aa8 - code32flat_start ) ;
*32flat.*(.bss.pci_mem64_top)
. = ( 0xe7ab0 - code32flat_start ) ;
*32flat.*(.bss.kvmclock)
. = ( 0xe7ab4 - code32flat_start ) ;
*32flat.*(.bss.kvm_cpuid_base)
. = ( 0xe7ab8 - code32flat_start ) ;
*32flat.*(.bss.CPULongMode)
. = ( 0xe7ab9 - code32flat_start ) ;
*32flat.*(.bss.CPUPhysBits)
. = ( 0xe7ac0 - code32flat_start ) ;
*32flat.*(.bss.RamSizeOver4G)
. = ( 0xe7ac8 - code32flat_start ) ;
*32flat.*(.bss.RamSize)
. = ( 0xe7acc - code32flat_start ) ;
*32flat.*(.bss.SMBios30Addr)
. = ( 0xe7ad0 - code32flat_start ) ;
*32flat.*(.bss.SMBios21Addr)
. = ( 0xe7ad4 - code32flat_start ) ;
*32flat.*(.bss.TPM_has_physical_presence)
. = ( 0xe7ad8 - code32flat_start ) ;
*32flat.*(.bss.BootsplashActive)
. = ( 0xe7adc - code32flat_start ) ;
*32flat.*(.bss.HaveFDBoot)
. = ( 0xe7ae0 - code32flat_start ) ;
*32flat.*(.bss.HaveHDBoot)
. = ( 0xe7ae4 - code32flat_start ) ;
*32flat.*(.bss.BootorderCount)
. = ( 0xe7ae8 - code32flat_start ) ;
*32flat.*(.bss.BiosGeometryCount)
. = ( 0xe7aec - code32flat_start ) ;
*32flat.*(.bss.RunPCIroms)
. = ( 0xe7af0 - code32flat_start ) ;
*32flat.*(.bss.SpinupEnd)
. = ( 0xe7af4 - code32flat_start ) ;
*32flat.*(.bss.PendingEHCI)
. = ( 0xe7af8 - code32flat_start ) ;
*32flat.*(.bss.usb_time_sigatt)
. = ( 0xe7afc - code32flat_start ) ;
*32flat.*(.bss.CDCount)
. = ( 0xe7b00 - code32flat_start ) ;
*32flat.*(.text.set_a20)
. = ( 0xe7b1a - code32flat_start ) ;
*32flat.*(.text.runningOnXen)
. = ( 0xe7b25 - code32flat_start ) ;
*32flat.*(.text.threads_during_optionroms)
. = ( 0xe7b3d - code32flat_start ) ;
*32flat.*(.text.switch_next)
. = ( 0xe7b5b - code32flat_start ) ;
*32flat.*(.text.putc)
. = ( 0xe7b60 - code32flat_start ) ;
*32flat.*(.text.putuint)
. = ( 0xe7bae - code32flat_start ) ;
*32flat.*(.text.putsinglehex)
. = ( 0xe7bce - code32flat_start ) ;
*32flat.*(.text.puthex)
. = ( 0xe7c67 - code32flat_start ) ;
*32flat.*(.text.putprettyhex)
. = ( 0xe7cbc - code32flat_start ) ;
*32flat.*(.text.strlen)
. = ( 0xe7ccd - code32flat_start ) ;
*32flat.*(.text.memcmp)
. = ( 0xe7cee - code32flat_start ) ;
*32flat.*(.text.strcmp)
. = ( 0xe7d0e - code32flat_start ) ;
*32flat.*(.text.pci_config_writel)
. = ( 0xe7d4d - code32flat_start ) ;
*32flat.*(.text.pci_config_writew)
. = ( 0xe7d92 - code32flat_start ) ;
*32flat.*(.text.pci_config_writeb)
. = ( 0xe7dd5 - code32flat_start ) ;
*32flat.*(.text.pci_config_readl)
. = ( 0xe7e09 - code32flat_start ) ;
*32flat.*(.text.pci_config_readw)
. = ( 0xe7e47 - code32flat_start ) ;
*32flat.*(.text.pci_config_readb)
. = ( 0xe7e83 - code32flat_start ) ;
*32flat.*(.text.scsi_is_read)
. = ( 0xe7ea4 - code32flat_start ) ;
*32flat.*(.text.rom_get_max)
. = ( 0xe7eb5 - code32flat_start ) ;
*32flat.*(.text.cpuid)
. = ( 0xe7efe - code32flat_start ) ;
*32flat.*(.text.make_bios_readonly_intel)
. = ( 0xe7fac - code32flat_start ) ;
*32flat.*(.text.mch_isa_lpc_setup)
. = ( 0xe7fec - code32flat_start ) ;
*32flat.*(.text.piix4_pm_config_setup)
. = ( 0xe8059 - code32flat_start ) ;
*32flat.*(.text.ich9_smbus_enable)
. = ( 0xe808b - code32flat_start ) ;
*32flat.*(.text.smp_write_msrs)
. = ( 0xe80b3 - code32flat_start ) ;
*32flat.*(.text.apic_id_init)
. = ( 0xe8121 - code32flat_start ) ;
*32flat.*(.text._vp_read)
. = ( 0xe82c0 - code32flat_start ) ;
*32flat.*(.text._vp_write)
. = ( 0xe83ce - code32flat_start ) ;
*32flat.*(.text.tis_get_tpm_version)
. = ( 0xe83f5 - code32flat_start ) ;
*32flat.*(.text.crb_get_tpm_version)
. = ( 0xe83f8 - code32flat_start ) ;
*32flat.*(.text.crb_activate)
. = ( 0xe8408 - code32flat_start ) ;
*32flat.*(.text.crb_waitdatavalid)
. = ( 0xe840b - code32flat_start ) ;
*32flat.*(.text.nvme_commit_sqe)
. = ( 0xe8422 - code32flat_start ) ;
*32flat.*(.text.tpm_log_event)
. = ( 0xe8491 - code32flat_start ) ;
*32flat.*(.text.set_timeouts)
. = ( 0xe84e8 - code32flat_start ) ;
*32flat.*(.text.cpu_to_be64)
. = ( 0xe84f3 - code32flat_start ) ;
*32flat.*(.text.sha512_block)
. = ( 0xe8a08 - code32flat_start ) ;
*32flat.*(.text.cpu_to_be32)
. = ( 0xe8a0b - code32flat_start ) ;
*32flat.*(.text.sha1_block)
. = ( 0xe8b7e - code32flat_start ) ;
*32flat.*(.text.crb_readresp)
. = ( 0xe8bd8 - code32flat_start ) ;
*32flat.*(.text.tpmhw_transmit)
. = ( 0xe8c4c - code32flat_start ) ;
*32flat.*(.text.sha256_block)
. = ( 0xe8ead - code32flat_start ) ;
*32flat.*(.text.code_mutable_preinit)
. = ( 0xe8ec9 - code32flat_start ) ;
*32flat.*(.text.crb_senddata)
. = ( 0xe8ef4 - code32flat_start ) ;
*32flat.*(.text.init_timeout)
. = ( 0xe8f4a - code32flat_start ) ;
*32flat.*(.text.crb_init)
. = ( 0xe8f7a - code32flat_start ) ;
*32flat.*(.text.tis_init)
. = ( 0xe8f8e - code32flat_start ) ;
*32flat.*(.text.pic_reset.constprop.0)
. = ( 0xe8fb3 - code32flat_start ) ;
*32flat.*(.text.vring_kick.constprop.0)
. = ( 0xe90a9 - code32flat_start ) ;
*32flat.*(.text.checksum)
. = ( 0xe90b9 - code32flat_start ) ;
*32flat.*(.text.vring_get_buf.constprop.0.isra.0)
. = ( 0xe910e - code32flat_start ) ;
*32flat.*(.text.vp_get_isr.isra.0)
. = ( 0xe9144 - code32flat_start ) ;
*32flat.*(.text.ahci_port_writel.isra.0)
. = ( 0xe9157 - code32flat_start ) ;
*32flat.*(.text.ahci_port_readl.isra.0)
. = ( 0xe9166 - code32flat_start ) ;
*32flat.*(.text.default_process_op.isra.0)
. = ( 0xe917f - code32flat_start ) ;
*32flat.*(.text.memset.isra.0)
. = ( 0xe918a - code32flat_start ) ;
*32flat.*(.text.nvme_get_next_sqe.constprop.0)
. = ( 0xe91ec - code32flat_start ) ;
*32flat.*(.text.sha512_do)
. = ( 0xe9320 - code32flat_start ) ;
*32flat.*(.text.sha384)
. = ( 0xe9353 - code32flat_start ) ;
*32flat.*(.text.sha512)
. = ( 0xe9386 - code32flat_start ) ;
*32flat.*(.text.sha256)
. = ( 0xe9491 - code32flat_start ) ;
*32flat.*(.text.tpm_simple_cmd)
. = ( 0xe953e - code32flat_start ) ;
*32flat.*(.text.scsi_fill_cmd)
. = ( 0xe95ef - code32flat_start ) ;
*32flat.*(.text.tpm20_hierarchycontrol.constprop.0.isra.0)
. = ( 0xe965d - code32flat_start ) ;
*32flat.*(.text.tpm_set_failure)
. = ( 0xe96a6 - code32flat_start ) ;
*32flat.*(.text.tpm20_extend)
. = ( 0xe9741 - code32flat_start ) ;
*32flat.*(.text.tpm_extend)
. = ( 0xe97d4 - code32flat_start ) ;
*32flat.*(.text.debug_putc)
. = ( 0xe97e4 - code32flat_start ) ;
*32flat.*(.text.irqtimer_calc)
. = ( 0xe9827 - code32flat_start ) ;
*32flat.*(.text.xhci_trb_queue)
. = ( 0xe98c2 - code32flat_start ) ;
*32flat.*(.text.xhci_xfer_normal)
. = ( 0xe98ea - code32flat_start ) ;
*32flat.*(.text.start_preempt)
. = ( 0xe9922 - code32flat_start ) ;
*32flat.*(.text.smm_relocate_and_restore)
. = ( 0xe9982 - code32flat_start ) ;
*32flat.*(.text.smm_save_and_copy)
. = ( 0xe99d2 - code32flat_start ) ;
*32flat.*(.text.smm_setup)
. = ( 0xe9ad3 - code32flat_start ) ;
*32flat.*(.text.sha1_do)
. = ( 0xe9bc2 - code32flat_start ) ;
*32flat.*(.text.sha1)
. = ( 0xe9bf5 - code32flat_start ) ;
*32flat.*(.text.tpm_build_digest)
. = ( 0xe9d7d - code32flat_start ) ;
*32flat.*(.text.tpm_add_measurement_to_log)
. = ( 0xe9e17 - code32flat_start ) ;
*32flat.*(.text.tpm_add_action)
. = ( 0xe9e3b - code32flat_start ) ;
*32flat.*(.text.hash_log_extend.constprop.0)
. = ( 0xe9eed - code32flat_start ) ;
*32flat.*(.text.timer_read)
. = ( 0xe9f5d - code32flat_start ) ;
*32flat.*(.text.timer_calc)
. = ( 0xe9f70 - code32flat_start ) ;
*32flat.*(.text.timer_calc_usec)
. = ( 0xe9fb4 - code32flat_start ) ;
*32flat.*(.text.timer_check)
. = ( 0xe9fc8 - code32flat_start ) ;
*32flat.*(.text.timer_delay)
. = ( 0xe9fdc - code32flat_start ) ;
*32flat.*(.text.udelay)
. = ( 0xe9fe6 - code32flat_start ) ;
*32flat.*(.text.pci_ioconfig_next.constprop.0)
. = ( 0xea057 - code32flat_start ) ;
*32flat.*(.text.__make_bios_writable_intel)
. = ( 0xea112 - code32flat_start ) ;
*32flat.*(.text.make_bios_writable_intel)
. = ( 0xea151 - code32flat_start ) ;
*32flat.*(.text.bvprintf)
. = ( 0xea3f1 - code32flat_start ) ;
*32flat.*(.text.panic)
. = ( 0xea407 - code32flat_start ) ;
*32flat.*(.text.call16_override)
. = ( 0xea442 - code32flat_start ) ;
*32flat.*(.text.vring_add_buf.constprop.0)
. = ( 0xea552 - code32flat_start ) ;
*32flat.*(.text.call16.isra.0)
. = ( 0xea5cc - code32flat_start ) ;
*32flat.*(.text.reset)
. = ( 0xea5df - code32flat_start ) ;
*32flat.*(.text.check_irqs)
. = ( 0xea5f9 - code32flat_start ) ;
*32flat.*(.text.yield)
. = ( 0xea626 - code32flat_start ) ;
*32flat.*(.text.finish_preempt)
. = ( 0xea659 - code32flat_start ) ;
*32flat.*(.text.usleep)
. = ( 0xea675 - code32flat_start ) ;
*32flat.*(.text.virtio_blk_op_one_segment)
. = ( 0xea6da - code32flat_start ) ;
*32flat.*(.text.virtio_blk_op)
. = ( 0xea7f4 - code32flat_start ) ;
*32flat.*(.text.yield_toirq)
. = ( 0xea81c - code32flat_start ) ;
*32flat.*(.text.qemu_cfg_dma_transfer)
. = ( 0xea870 - code32flat_start ) ;
*32flat.*(.text.qemu_cfg_read)
. = ( 0xea896 - code32flat_start ) ;
*32flat.*(.text.qemu_cfg_read_entry)
. = ( 0xea8cc - code32flat_start ) ;
*32flat.*(.text.qemu_get_present_cpus_count)
. = ( 0xea917 - code32flat_start ) ;
*32flat.*(.text.qemu_cfg_skip)
. = ( 0xea940 - code32flat_start ) ;
*32flat.*(.text.__call16_int)
. = ( 0xea962 - code32flat_start ) ;
*32flat.*(.text.screenc)
. = ( 0xea9b6 - code32flat_start ) ;
*32flat.*(.text.screen_putc)
. = ( 0xea9e9 - code32flat_start ) ;
*32flat.*(.text.__dprintf)
. = ( 0xea9fc - code32flat_start ) ;
*32flat.*(.text.debug_banner)
. = ( 0xeaa1e - code32flat_start ) ;
*32flat.*(.text.__warn_internalerror)
. = ( 0xeaa2e - code32flat_start ) ;
*32flat.*(.text.qemu_cfg_write_file_simple)
. = ( 0xeaa9b - code32flat_start ) ;
*32flat.*(.text.__warn_noalloc)
. = ( 0xeaaab - code32flat_start ) ;
*32flat.*(.text.__warn_timeout)
. = ( 0xeaabb - code32flat_start ) ;
*32flat.*(.text.i8042_wait_write)
. = ( 0xeaaf5 - code32flat_start ) ;
*32flat.*(.text.uhci_waittick)
. = ( 0xeab3e - code32flat_start ) ;
*32flat.*(.text.ohci_waittick)
. = ( 0xeab86 - code32flat_start ) ;
*32flat.*(.text.ehci_waittick)
. = ( 0xeac09 - code32flat_start ) ;
*32flat.*(.text.await_ide.constprop.0)
. = ( 0xeac5d - code32flat_start ) ;
*32flat.*(.text.await_not_bsy)
. = ( 0xeac6c - code32flat_start ) ;
*32flat.*(.text.ndelay_await_not_bsy)
. = ( 0xeaca0 - code32flat_start ) ;
*32flat.*(.text.ata_wait_data)
. = ( 0xeacc2 - code32flat_start ) ;
*32flat.*(.text.send_cmd)
. = ( 0xeada0 - code32flat_start ) ;
*32flat.*(.text.ata_pio_transfer.constprop.0)
. = ( 0xeae35 - code32flat_start ) ;
*32flat.*(.text.ahci_command)
. = ( 0xeb07a - code32flat_start ) ;
*32flat.*(.text.ahci_disk_readwrite_aligned)
. = ( 0xeb16a - code32flat_start ) ;
*32flat.*(.text.ahci_disk_readwrite)
. = ( 0xeb239 - code32flat_start ) ;
*32flat.*(.text.wait_reg8)
. = ( 0xeb285 - code32flat_start ) ;
*32flat.*(.text.crb_probe)
. = ( 0xeb2ee - code32flat_start ) ;
*32flat.*(.text.tis_activate)
. = ( 0xeb35c - code32flat_start ) ;
*32flat.*(.text.tis_find_active_locality)
. = ( 0xeb37e - code32flat_start ) ;
*32flat.*(.text.tis_readresp)
. = ( 0xeb3bd - code32flat_start ) ;
*32flat.*(.text.tis_probe)
. = ( 0xeb41b - code32flat_start ) ;
*32flat.*(.text.crb_waitrespready)
. = ( 0xeb437 - code32flat_start ) ;
*32flat.*(.text.crb_ready)
. = ( 0xeb45c - code32flat_start ) ;
*32flat.*(.text.tis_ready)
. = ( 0xeb491 - code32flat_start ) ;
*32flat.*(.text.tis_waitdatavalid)
. = ( 0xeb4c5 - code32flat_start ) ;
*32flat.*(.text.tis_waitrespready)
. = ( 0xeb504 - code32flat_start ) ;
*32flat.*(.text.tis_senddata)
. = ( 0xeb5a1 - code32flat_start ) ;
*32flat.*(.text.nvme_wait)
. = ( 0xeb685 - code32flat_start ) ;
*32flat.*(.text.nvme_io_xfer)
. = ( 0xeb719 - code32flat_start ) ;
*32flat.*(.text.sdcard_reset.isra.0)
. = ( 0xeb752 - code32flat_start ) ;
*32flat.*(.text.wait_td)
. = ( 0xeb7a6 - code32flat_start ) ;
*32flat.*(.text.uhci_send_pipe)
. = ( 0xeba49 - code32flat_start ) ;
*32flat.*(.text.ohci_send_pipe)
. = ( 0xebc2c - code32flat_start ) ;
*32flat.*(.text.ehci_send_pipe)
. = ( 0xebe9f - code32flat_start ) ;
*32flat.*(.text.megasas_fire_cmd)
. = ( 0xebf3e - code32flat_start ) ;
*32flat.*(.text.is_valid_rom)
. = ( 0xebf8f - code32flat_start ) ;
*32flat.*(.text.sdcard_waitw)
. = ( 0xebff7 - code32flat_start ) ;
*32flat.*(.text.find_acpi_table)
. = ( 0xec0a1 - code32flat_start ) ;
*32flat.*(.text.make_bios_readonly)
. = ( 0xec0eb - code32flat_start ) ;
*32flat.*(.text.validate_info)
. = ( 0xec141 - code32flat_start ) ;
*32flat.*(.text.xhci_process_events)
. = ( 0xec232 - code32flat_start ) ;
*32flat.*(.text.xhci_event_wait)
. = ( 0xec28a - code32flat_start ) ;
*32flat.*(.text.usb_send_pipe)
. = ( 0xec3e1 - code32flat_start ) ;
*32flat.*(.text.sdcard_pio)
. = ( 0xec460 - code32flat_start ) ;
*32flat.*(.text.sdcard_pio_transfer)
. = ( 0xec586 - code32flat_start ) ;
*32flat.*(.text.make_bios_writable)
. = ( 0xec604 - code32flat_start ) ;
*32flat.*(.text.usb_process_op)
. = ( 0xec717 - code32flat_start ) ;
*32flat.*(.text.uas_process_op)
. = ( 0xec899 - code32flat_start ) ;
*32flat.*(.text.smp_scan)
. = ( 0xec9b3 - code32flat_start ) ;
*32flat.*(.text.mch_mmconfig_setup)
. = ( 0xeca07 - code32flat_start ) ;
*32flat.*(.text.printf)
. = ( 0xeca1a - code32flat_start ) ;
*32flat.*(.text.boot_fail)
. = ( 0xeca8f - code32flat_start ) ;
*32flat.*(.text.__callrom)
. = ( 0xecb20 - code32flat_start ) ;
*32flat.*(.text.call_boot_entry)
. = ( 0xecb82 - code32flat_start ) ;
*32flat.*(.text.boot_disk)
. = ( 0xecc7a - code32flat_start ) ;
*32flat.*(.text.runtime../src/stacks.c.762)
. = ( 0xecc8a - code32flat_start ) ;
*32flat.*(.text.runtime../src/block.c.571)
. = ( 0xed91b - code32flat_start ) ;
*32flat.*(.text.process_op)
. = ( 0xed95d - code32flat_start ) ;
*32flat.*(.text.scsi_is_ready)
. = ( 0xeda6a - code32flat_start ) ;
*32flat.*(.text.cdrom_boot)
. = ( 0xedd57 - code32flat_start ) ;
*32flat.*(.text.do_boot)
. = ( 0xedec6 - code32flat_start ) ;
*32flat.*(.text.runtime../src/resume.c.146)
. = ( 0xee1f1 - code32flat_start ) ;
*32flat.*(.text.runtime../src/post.c.182)
. = ( 0xee22b - code32flat_start ) ;
*32flat.*(.text.runtime../src/post.c.320)
. = ( 0xee310 - code32flat_start ) ;
*32flat.*(.text.runtime../src/boot.c.1023)
. = ( 0xee33c - code32flat_start ) ;
*32flat.*(.text.runtime../src/boot.c.1033)
. = ( 0xee366 - code32flat_start ) ;
*32flat.*(.text.runtime../src/tcgbios.c.1653)
. = ( 0xee676 - code32flat_start ) ;
*32flat.*(.text.runtime../src/hw/usb-xhci.c.1176)
. = ( 0xee6e1 - code32flat_start ) ;
*32flat.*(.text.runtime../src/fw/smm.c.70)
. = ( 0xee94a - code32flat_start ) ;
*32flat.*(.text.runtime../src/fw/smp.c.83)
. = ( 0xee980 - code32flat_start ) ;
_rodata32flat = . ;
*32flat.*(.rodata)
. = ( 0xf425c - code32flat_start ) ;
*32flat.*(.rodata.puthex)
. = ( 0xf4278 - code32flat_start ) ;
*32flat.*(.rodata.runtime../src/tcgbios.c.1653)
. = ( 0xf42a0 - code32flat_start ) ;
*32flat.*(.rodata.sha_ko.0)
. = ( 0xf4520 - code32flat_start ) ;
*32flat.*(.rodata.sha_ko.1)
. = ( 0xf4620 - code32flat_start ) ;
*32flat.*(.rodata.__func__.8)
. = ( 0xf462c - code32flat_start ) ;
*32flat.*(.rodata.__func__.9)
. = ( 0xf463c - code32flat_start ) ;
*32flat.*(.rodata.__func__.10)
. = ( 0xf464c - code32flat_start ) ;
*32flat.*(.rodata.__func__.11)
. = ( 0xf4658 - code32flat_start ) ;
*32flat.*(.rodata.__func__.37)
. = ( 0xf4664 - code32flat_start ) ;
*32flat.*(.rodata.__func__.45)
. = ( 0xf4674 - code32flat_start ) ;
*32flat.*(.rodata.__func__.46)
. = ( 0xf468c - code32flat_start ) ;
*32flat.*(.rodata.__func__.55)
. = ( 0xf469c - code32flat_start ) ;
*32flat.*(.rodata.__func__.56)
. = ( 0xf46ac - code32flat_start ) ;
*32flat.*(.rodata.__func__.58)
. = ( 0xf46bc - code32flat_start ) ;
*32flat.*(.rodata.__func__.60)
. = ( 0xf46d0 - code32flat_start ) ;
*32flat.*(.rodata.__func__.61)
. = ( 0xf46e0 - code32flat_start ) ;
*32flat.*(.rodata.__func__.77)
. = ( 0xf46f0 - code32flat_start ) ;
*32flat.*(.rodata.sha_ko.81)
. = ( 0xf4700 - code32flat_start ) ;
*32flat.*(.rodata.__func__.85)
. = ( 0xf470c - code32flat_start ) ;
*32flat.*(.rodata.__func__.86)
. = ( 0xf4718 - code32flat_start ) ;
*32flat.*(.rodata.__func__.107)
. = ( 0xf472c - code32flat_start ) ;
*32flat.*(.rodata.__func__.116)
. = ( 0xf4738 - code32flat_start ) ;
*32flat.*(.rodata.__func__.124)
. = ( 0xf4748 - code32flat_start ) ;
*32flat.*(.rodata.__func__.125)
. = ( 0xf4758 - code32flat_start ) ;
*32flat.*(.rodata.__func__.128)
. = ( 0xf4768 - code32flat_start ) ;
*32flat.*(.rodata.__func__.131)
. = ( 0xf4770 - code32flat_start ) ;
*32flat.*(.rodata.__func__.132)
. = ( 0xf4780 - code32flat_start ) ;
*32flat.*(.rodata.__func__.134)
. = ( 0xf4790 - code32flat_start ) ;
*32flat.*(.rodata.__func__.139)
. = ( 0xf479c - code32flat_start ) ;
*32flat.*(.rodata.__func__.140)
. = ( 0xf47a4 - code32flat_start ) ;
*32flat.*(.rodata.__func__.143)
. = ( 0xf47b4 - code32flat_start ) ;
*32flat.*(.rodata.__func__.152)
. = ( 0xf47c8 - code32flat_start ) ;
*32flat.*(.rodata.tpm_default_durations)
. = ( 0xf47d4 - code32flat_start ) ;
*32flat.*(.rodata.tis_default_timeouts)
. = ( 0xf4800 - code32flat_start ) ;
*32flat.*(.rodata.hash_parameters)
. = ( 0xf4860 - code32flat_start ) ;
*32flat.*(.data.TPMHW_driver_to_use)
. = ( 0xf4880 - code32flat_start ) ;
*32flat.*(.data.tpm_drivers)
. = ( 0xf48e0 - code32flat_start ) ;
*32flat.*(.data.SMMPMDeviceBDF)
. = ( 0xf48e4 - code32flat_start ) ;
*32flat.*(.data.SMMISADeviceBDF)
. = ( 0xf48e8 - code32flat_start ) ;
*32flat.*(.data.MCHMmcfgBDF)
. = ( 0xf48ec - code32flat_start ) ;
*32flat.*(.data.ICH9SmbusBDF)
. = ( 0xf48f0 - code32flat_start ) ;
*32flat.*(.data.PiixPmBDF)
. = ( 0xf48f4 - code32flat_start ) ;
*32flat.*(.data.ICH9LpcBDF)
. = ( 0xf48f8 - code32flat_start ) ;
*32flat.*(.data.ShadowBDF)
. = ( 0xf48fc - code32flat_start ) ;
*32flat.*(.data.acpi_pm_base)
. = ( 0xf4900 - code32flat_start ) ;
*32flat.*(.data.CheckFloppySig)
. = ( 0xf4904 - code32flat_start ) ;
*32flat.*(.data.screeninfo)
. = ( 0xf4908 - code32flat_start ) ;
*32flat.*(.data.debuginfo)
. = ( 0xf4920 - code32flat_start ) ;
*32flat.*(.data.BUILDINFO)
. = ( 0xf4970 - code32flat_start ) ;
*32flat.*(.data.VERSION)
. = ( 0xf4988 - code32flat_start ) ;
*32flat.*(.bss.nvme_dma_buffer)
. = ( 0xf498c - code32flat_start ) ;
*32flat.*(.bss.crb_resp)
. = ( 0xf4990 - code32flat_start ) ;
*32flat.*(.bss.crb_cmd)
. = ( 0xf4994 - code32flat_start ) ;
*32flat.*(.bss.crb_cmd_size)
. = ( 0xf4998 - code32flat_start ) ;
*32flat.*(.bss.tpm_default_to)
. = ( 0xf49a8 - code32flat_start ) ;
*32flat.*(.bss.tpm_default_dur)
. = ( 0xf49b4 - code32flat_start ) ;
*32flat.*(.bss.romfile_pointer_list)
. = ( 0xf49b8 - code32flat_start ) ;
*32flat.*(.bss.xen_cpuid_base)
. = ( 0xf49bc - code32flat_start ) ;
*32flat.*(.bss.SMPStack)
. = ( 0xf49c0 - code32flat_start ) ;
*32flat.*(.bss.SMPLock)
. = ( 0xf49e0 - code32flat_start ) ;
*32flat.*(.bss.FoundAPICIDs)
. = ( 0xf4a00 - code32flat_start ) ;
*32flat.*(.bss.CountCPUs)
. = ( 0xf4a04 - code32flat_start ) ;
*32flat.*(.bss.MaxCountCPUs)
. = ( 0xf4a08 - code32flat_start ) ;
*32flat.*(.bss.smp_msr_count)
. = ( 0xf4a20 - code32flat_start ) ;
*32flat.*(.bss.smp_msr)
. = ( 0xf4ba0 - code32flat_start ) ;
*32flat.*(.bss.cfg_dma_enabled)
. = ( 0xf4ba4 - code32flat_start ) ;
*32flat.*(.bss.cfg_enabled)
. = ( 0xf4ba8 - code32flat_start ) ;
*32flat.*(.bss.acpi_reset_val)
. = ( 0xf4bac - code32flat_start ) ;
*32flat.*(.bss.acpi_reset_reg)
. = ( 0xf4bb8 - code32flat_start ) ;
*32flat.*(.bss.RsdpAddr)
. = ( 0xf4bbc - code32flat_start ) ;
*32flat.*(.bss.tpm20_pcr_selection)
. = ( 0xf4bc0 - code32flat_start ) ;
*32flat.*(.bss.tpm20_pcr_selection_size)
. = ( 0xf4bc4 - code32flat_start ) ;
*32flat.*(.bss.TPM_version)
. = ( 0xf4bc8 - code32flat_start ) ;
*32flat.*(.bss.BEVCount)
. = ( 0xf4be0 - code32flat_start ) ;
*32flat.*(.bss.BEV)
. = ( 0xf4c80 - code32flat_start ) ;
*32flat.*(.bss.BootRetryTime)
. = ( 0xf4c84 - code32flat_start ) ;
*32flat.*(.bss.VgaROM)
. = ( 0xf4c88 - code32flat_start ) ;
*32flat.*(.bss.ScreenAndDebug)
. = ( 0xf4c8c - code32flat_start ) ;
*32flat.*(.bss.S3ResumeVga)
. = ( 0xf4c90 - code32flat_start ) ;
*32flat.*(.bss.EnforceChecksum)
. = ( 0xf4c94 - code32flat_start ) ;
*32flat.*(.bss.RomBase)
. = ( 0xf4c98 - code32flat_start ) ;
*32flat.*(.bss.mmconfig)
. = ( 0xf4c9c - code32flat_start ) ;
*32flat.*(.bss.PreemptCount)
. = ( 0xf4ca0 - code32flat_start ) ;
*32flat.*(.bss.ThreadControl)
. = ( 0xf4ca1 - code32flat_start ) ;
*32flat.*(.bss.CanInterrupt)
. = ( 0xf54c0 - code32flat_start ) ;
*32flat.*(.data.varfseg../src/fw/paravirt.c.40)
. = ( 0xf54c4 - code32flat_start ) ;
*32flat.*(.data.varfseg../src/fw/biostables.c.196)
. = ( 0xf54c8 - code32flat_start ) ;
*32flat.*(.data.varfseg../src/fw/biostables.c.22)
. = ( 0xf54cc - code32flat_start ) ;
*32flat.*(.data.varfseg../src/hw/pcidevice.c.17)
. = ( 0xf54d0 - code32flat_start ) ;
*32flat.*(.data.varfseg../src/pmm.c.20)
. = ( 0xf54e0 - code32flat_start ) ;
*32flat.*(.data.varfseg../src/malloc.c.473)
. = ( 0xf54e4 - code32flat_start ) ;
*32flat.*(.data.varfseg../src/e820map.c.19)
. = ( 0xf5500 - code32flat_start ) ;
*32flat.*(.data.varfseg../src/e820map.c.18)
. = ( 0xf5f00 - code32flat_start ) ;
*32flat.*(.data.varfseg../src/hw/floppy.c.88)
. = ( 0xf5f5c - code32flat_start ) ;
*32flat.*(.data.varfseg../src/hw/floppy.c.55)
. = ( 0xf5f6c - code32flat_start ) ;
*32flat.*(.data.varfseg../src/hw/usb-hid.c.23)
. = ( 0xf5f70 - code32flat_start ) ;
*32flat.*(.data.varfseg../src/hw/usb-hid.c.22)
. = ( 0xf5f74 - code32flat_start ) ;
*32flat.*(.data.varfseg../src/hw/serialio.c.104)
. = ( 0xf5f76 - code32flat_start ) ;
*32flat.*(.data.varfseg../src/hw/timer.c.54)
. = ( 0xf5f78 - code32flat_start ) ;
*32flat.*(.data.varfseg../src/hw/timer.c.53)
. = ( 0xf5f7c - code32flat_start ) ;
*32flat.*(.data.varfseg../src/hw/timer.c.52)
. = ( 0xf5f80 - code32flat_start ) ;
*32flat.*(.data.varfseg../src/pcibios.c.229)
. = ( 0xf5f90 - code32flat_start ) ;
*32flat.*(.data.varfseg../src/vgahooks.c.262)
. = ( 0xf5f91 - code32flat_start ) ;
*32flat.*(.data.varfseg../src/vgahooks.c.179)
. = ( 0xf5f94 - code32flat_start ) ;
*32flat.*(.data.varfseg../src/vgahooks.c.40)
. = ( 0xf5f9c - code32flat_start ) ;
*32flat.*(.data.varfseg../src/vgahooks.c.22)
. = ( 0xf5fa0 - code32flat_start ) ;
*32flat.*(.data.varfseg../src/pnpbios.c.18)
. = ( 0xf5fc4 - code32flat_start ) ;
*32flat.*(.data.varfseg../src/sercon.c.52)
. = ( 0xf5fc8 - code32flat_start ) ;
*32flat.*(.data.varfseg../src/cdrom.c.27)
. = ( 0xf5fcc - code32flat_start ) ;
*32flat.*(.data.varfseg../src/block.c.34)
. = ( 0xf5fe0 - code32flat_start ) ;
*32flat.*(.data.varfseg../src/block.c.33)
. = ( 0xf60a0 - code32flat_start ) ;
*32flat.*(.data.varfseg../src/block.c.31)
. = ( 0xf60a4 - code32flat_start ) ;
*32flat.*(.data.varfseg../src/stacks.c.696)
. = ( 0xf60a8 - code32flat_start ) ;
*32flat.*(.data.varfseg../src/stacks.c.476)
. = ( 0xf60b4 - code32flat_start ) ;
*32flat.*(.data.varfseg../src/stacks.c.38)
. = ( 0xf60b8 - code32flat_start ) ;
*32flat.*(.data.varfseg../src/misc.c.166)
. = ( 0xf60c0 - code32flat_start ) ;
*32flat.*(.data.varfseg../src/misc.c.148)
. = ( 0xf60f8 - code32flat_start ) ;
*32flat.*(.data.varfseg../src/misc.c.142)
. = ( 0xf60fe - code32flat_start ) ;
*32flat.*(.data.varfseg../src/misc.c.139)
. = ( 0xf6100 - code32flat_start ) ;
*32flat.*(.data.varfseg../src/misc.c.132)
. = ( 0xf6108 - code32flat_start ) ;
*32flat.*(.data.varfseg../src/misc.c.18)
. = ( 0xf6110 - code32flat_start ) ;
*32flat.*(.text.32fseg../src/stacks.c.215)
. = ( 0xf6136 - code32flat_start ) ;
*32flat.*(.text.32fseg../src/stacks.c.300)
. = ( 0xf6167 - code32flat_start ) ;
*32seg.*(.text.set_code_success)
. = ( 0xf6171 - code32flat_start ) ;
*32seg.*(.text.get_global_offset)
. = ( 0xf617d - code32flat_start ) ;
*32seg.*(.text.qemu_debug_putc)
. = ( 0xf6195 - code32flat_start ) ;
*32seg.*(.text.putsinglehex.constprop.0)
. = ( 0xf61af - code32flat_start ) ;
*32seg.*(.text.puthex.constprop.0)
. = ( 0xf6249 - code32flat_start ) ;
*32seg.*(.text.pci_next)
. = ( 0xf62bd - code32flat_start ) ;
*32seg.*(.text.putuint.constprop.0)
. = ( 0xf62fc - code32flat_start ) ;
*32seg.*(.text.__dprintf)
. = ( 0xf6594 - code32flat_start ) ;
*32seg.*(.text.handle_pcibios)
. = ( 0xf68ba - code32flat_start ) ;
*32seg.*(.text.handle_apm)
. = ( 0xf6a36 - code32flat_start ) ;
_rodata32seg = . ;
*32seg.*(.rodata)
. = ( 0xf6a60 - code32flat_start ) ;
*16.*(.text.set_a20)
. = ( 0xf6a80 - code32flat_start ) ;
*16.*(.text.set_code_success)
. = ( 0xf6a8c - code32flat_start ) ;
*16.*(.text.pic_eoi2)
. = ( 0xf6a94 - code32flat_start ) ;
*16.*(.text.call32_prep)
. = ( 0xf6b2d - code32flat_start ) ;
*16.*(.text.need_hop_back)
. = ( 0xf6b52 - code32flat_start ) ;
*16.*(.text.enqueue_key)
. = ( 0xf6bac - code32flat_start ) ;
*16.*(.text.kbd_set_flag)
. = ( 0xf6c09 - code32flat_start ) ;
*16.*(.text.cursor_pos_row)
. = ( 0xf6c1b - code32flat_start ) ;
*16.*(.text.shiftbuf)
. = ( 0xf6c61 - code32flat_start ) ;
*16.*(.text.irqtimer_check)
. = ( 0xf6c9a - code32flat_start ) ;
*16.*(.text.qemu_debug_putc)
. = ( 0xf6ca6 - code32flat_start ) ;
*16.*(.text.lba2chs)
. = ( 0xf6ced - code32flat_start ) ;
*16.*(.text.getLCHS)
. = ( 0xf6d97 - code32flat_start ) ;
*16.*(.text.clear_usertimer)
. = ( 0xf6dd8 - code32flat_start ) ;
*16.*(.text.putsinglehex.constprop.0)
. = ( 0xf6df9 - code32flat_start ) ;
*16.*(.text.puthex.constprop.0)
. = ( 0xf6ec4 - code32flat_start ) ;
*16.*(.text.call32_post)
. = ( 0xf6f67 - code32flat_start ) ;
*16.*(.text.default_process_op.isra.0)
. = ( 0xf6f87 - code32flat_start ) ;
*16.*(.text.memset.isra.0)
. = ( 0xf6f96 - code32flat_start ) ;
*16.*(.text.__disk_ret.constprop.0)
. = ( 0xf6fc5 - code32flat_start ) ;
*16.*(.text.disk_1308)
. = ( 0xf70f1 - code32flat_start ) ;
*16.*(.text.disk_1315)
. = ( 0xf7152 - code32flat_start ) ;
*16.*(.text.handle_1524XX)
. = ( 0xf715e - code32flat_start ) ;
*16.*(.text.getComAddr)
. = ( 0xf7192 - code32flat_start ) ;
*16.*(.text.getLptAddr)
. = ( 0xf71c7 - code32flat_start ) ;
*16.*(.text.floppy_dor_mask)
. = ( 0xf71ea - code32flat_start ) ;
*16.*(.text.floppy_disable_controller)
. = ( 0xf71f6 - code32flat_start ) ;
*16.*(.text.scsi_fill_cmd)
. = ( 0xf72c2 - code32flat_start ) ;
*16.*(.text.putuint.constprop.0)
. = ( 0xf7319 - code32flat_start ) ;
*16.*(.text.bvprintf.constprop.0)
. = ( 0xf761c - code32flat_start ) ;
*16.*(.text.panic.constprop.0)
. = ( 0xf7632 - code32flat_start ) ;
*16.*(.text.__dprintf)
. = ( 0xf7646 - code32flat_start ) ;
*16.*(.text.dump_regs)
. = ( 0xf76dd - code32flat_start ) ;
*16.*(.text.__warn_timeout)
. = ( 0xf76f3 - code32flat_start ) ;
*16.*(.text.disk_13XX.constprop.0)
. = ( 0xf7720 - code32flat_start ) ;
*16.*(.text.set_usertimer)
. = ( 0xf7799 - code32flat_start ) ;
*16.*(.text.timer_read)
. = ( 0xf7836 - code32flat_start ) ;
*16.*(.text.timer_calc)
. = ( 0xf7852 - code32flat_start ) ;
*16.*(.text.timer_calc_usec)
. = ( 0xf7882 - code32flat_start ) ;
*16.*(.text.timer_check)
. = ( 0xf789e - code32flat_start ) ;
*16.*(.text.udelay)
. = ( 0xf78bf - code32flat_start ) ;
*16.*(.text.i8042_wait_write)
. = ( 0xf7907 - code32flat_start ) ;
*16.*(.text.__i8042_command)
. = ( 0xf794d - code32flat_start ) ;
*16.*(.text.fill_generic_edd)
. = ( 0xf7ca8 - code32flat_start ) ;
*16.*(.text.__stack_hop_back.isra.0)
. = ( 0xf7d04 - code32flat_start ) ;
*16.*(.text.handle_12)
. = ( 0xf7d17 - code32flat_start ) ;
*16.*(.text.handle_11)
. = ( 0xf7d2a - code32flat_start ) ;
*16.*(.text.handle_05)
. = ( 0xf7d50 - code32flat_start ) ;
*16.*(.text.handle_02)
. = ( 0xf7d75 - code32flat_start ) ;
*16.*(.text.call16_helper)
. = ( 0xf7db5 - code32flat_start ) ;
*16.*(.text.__call32)
. = ( 0xf7e79 - code32flat_start ) ;
*16.*(.text.__call32_params.constprop.0)
. = ( 0xf7ec0 - code32flat_start ) ;
*16.*(.text.usb_poll_intr)
. = ( 0xf8223 - code32flat_start ) ;
*16.*(.text._farcall16)
. = ( 0xf826e - code32flat_start ) ;
*16.*(.text.__call16_int)
. = ( 0xf8281 - code32flat_start ) ;
*16.*(.text.handle_75)
. = ( 0xf82ed - code32flat_start ) ;
*16.*(.text.process_key)
. = ( 0xf86dd - code32flat_start ) ;
*16.*(.text.prockeys)
. = ( 0xf8754 - code32flat_start ) ;
*16.*(.text.procmodkey)
. = ( 0xf87a9 - code32flat_start ) ;
*16.*(.text.procscankey)
. = ( 0xf87cf - code32flat_start ) ;
*16.*(.text.ramdisk_copy)
. = ( 0xf897e - code32flat_start ) ;
*16.*(.text.disk_1346.constprop.0)
. = ( 0xf8a24 - code32flat_start ) ;
*16.*(.text.check_irqs)
. = ( 0xf8a46 - code32flat_start ) ;
*16.*(.text.sercon_putchar)
. = ( 0xf8ab1 - code32flat_start ) ;
*16.*(.text.sercon_term_clear_screen)
. = ( 0xf8ade - code32flat_start ) ;
*16.*(.text.sercon_term_cursor_goto)
. = ( 0xf8b7d - code32flat_start ) ;
*16.*(.text.sercon_set_attr)
. = ( 0xf8c72 - code32flat_start ) ;
*16.*(.text.sercon_lazy_putchar)
. = ( 0xf8d27 - code32flat_start ) ;
*16.*(.text.lsi_scsi_process_op)
. = ( 0xf8f44 - code32flat_start ) ;
*16.*(.text.mpt_scsi_process_op)
. = ( 0xf9122 - code32flat_start ) ;
*16.*(.text.rtc_updating)
. = ( 0xf916f - code32flat_start ) ;
*16.*(.text.ps2_recvbyte)
. = ( 0xf9223 - code32flat_start ) ;
*16.*(.text.mouse_command)
. = ( 0xf92ee - code32flat_start ) ;
*16.*(.text.mouse_15c201)
. = ( 0xf932f - code32flat_start ) ;
*16.*(.text.handle_160a)
. = ( 0xf9378 - code32flat_start ) ;
*16.*(.text.uhci_waittick)
. = ( 0xf93d4 - code32flat_start ) ;
*16.*(.text.uhci_send_pipe.constprop.0)
. = ( 0xf97ad - code32flat_start ) ;
*16.*(.text.usb_send_bulk)
. = ( 0xf97f9 - code32flat_start ) ;
*16.*(.text.uas_process_op)
. = ( 0xf9a1b - code32flat_start ) ;
*16.*(.text.usb_process_op)
. = ( 0xf9ba4 - code32flat_start ) ;
*16.*(.text.floppy_pio)
. = ( 0xf9cfd - code32flat_start ) ;
*16.*(.text.floppy_enable_controller)
. = ( 0xf9d60 - code32flat_start ) ;
*16.*(.text.floppy_drive_pio)
. = ( 0xf9e0b - code32flat_start ) ;
*16.*(.text.floppy_dma_cmd)
. = ( 0xf9f45 - code32flat_start ) ;
*16.*(.text.floppy_prep)
. = ( 0xfa281 - code32flat_start ) ;
*16.*(.text.floppy_read)
. = ( 0xfa33a - code32flat_start ) ;
*16.*(.text.floppy_write)
. = ( 0xfa3f3 - code32flat_start ) ;
*16.*(.text.floppy_format)
. = ( 0xfa47b - code32flat_start ) ;
*16.*(.text.await_ide.constprop.0)
. = ( 0xfa4ec - code32flat_start ) ;
*16.*(.text.await_not_bsy)
. = ( 0xfa4fc - code32flat_start ) ;
*16.*(.text.ndelay_await_not_bsy)
. = ( 0xfa54c - code32flat_start ) ;
*16.*(.text.ata_wait_data)
. = ( 0xfa578 - code32flat_start ) ;
*16.*(.text.send_cmd)
. = ( 0xfa6a4 - code32flat_start ) ;
*16.*(.text.ata_pio_transfer)
. = ( 0xfa7d7 - code32flat_start ) ;
*16.*(.text.ata_readwrite)
. = ( 0xfa95c - code32flat_start ) ;
*16.*(.text.ata_atapi_process_op)
. = ( 0xfaadb - code32flat_start ) ;
*16.*(.text.process_op)
. = ( 0xfae62 - code32flat_start ) ;
*16.*(.text.cdemu_read)
. = ( 0xfb090 - code32flat_start ) ;
*16.*(.text.basic_access)
. = ( 0xfb1c6 - code32flat_start ) ;
*16.*(.text.disk_1305)
. = ( 0xfb2e7 - code32flat_start ) ;
*16.*(.text.disk_1310)
. = ( 0xfb326 - code32flat_start ) ;
*16.*(.text.extended_access)
. = ( 0xfb3fb - code32flat_start ) ;
*16.*(.text.disk_13)
. = ( 0xfb70c - code32flat_start ) ;
*16.*(.text.handle_legacy_disk)
. = ( 0xfb799 - code32flat_start ) ;
*16.*(.text.wait_irq)
. = ( 0xfb7b9 - code32flat_start ) ;
*16.*(.text.dequeue_key)
. = ( 0xfb896 - code32flat_start ) ;
*16.*(.text.handle_1553)
. = ( 0xfb9fe - code32flat_start ) ;
*16.*(.text.handle_40)
. = ( 0xfba30 - code32flat_start ) ;
*16.*(.text.handle_13)
. = ( 0xfbad2 - code32flat_start ) ;
*16.*(.text.handle_76)
. = ( 0xfbae3 - code32flat_start ) ;
*16.*(.text.invoke_mouse_handler)
. = ( 0xfbb55 - code32flat_start ) ;
*16.*(.text.process_mouse)
. = ( 0xfbbac - code32flat_start ) ;
*16.*(.text.handle_16)
. = ( 0xfbc9c - code32flat_start ) ;
*16.*(.text.handle_1589)
. = ( 0xfbd36 - code32flat_start ) ;
*16.*(.text.handle_15)
. = ( 0xfc4a4 - code32flat_start ) ;
*16.*(.text.handle_14)
. = ( 0xfc677 - code32flat_start ) ;
*16.*(.text.handle_sercon)
. = ( 0xfca67 - code32flat_start ) ;
*16.*(.text.handle_resume)
. = ( 0xfcb39 - code32flat_start ) ;
*16.*(.text.handle_pnp)
. = ( 0xfcb82 - code32flat_start ) ;
*16.*(.text.handle_pcibios)
. = ( 0xfcee3 - code32flat_start ) ;
*16.*(.text.handle_74)
. = ( 0xfcf1e - code32flat_start ) ;
*16.*(.text.handle_09)
. = ( 0xfcf67 - code32flat_start ) ;
*16.*(.text.handle_0e)
. = ( 0xfcf81 - code32flat_start ) ;
*16.*(.text.asm.transition16)
. = ( 0xfcfcf - code32flat_start ) ;
*16.*(.text.asm.__farcall16)
. = ( 0xfd05c - code32flat_start ) ;
*16.*(.text.asm.irq_trampoline_0x02)
. = ( 0xfd05f - code32flat_start ) ;
*16.*(.text.asm.irq_trampoline_0x05)
. = ( 0xfd062 - code32flat_start ) ;
*16.*(.text.asm.irq_trampoline_0x10)
. = ( 0xfd065 - code32flat_start ) ;
*16.*(.text.asm.irq_trampoline_0x13)
. = ( 0xfd068 - code32flat_start ) ;
*16.*(.text.asm.irq_trampoline_0x15)
. = ( 0xfd06b - code32flat_start ) ;
*16.*(.text.asm.entry_smp)
. = ( 0xfd09b - code32flat_start ) ;
*16.*(.text.asm.entry_resume)
. = ( 0xfd0b0 - code32flat_start ) ;
*16.*(.text.asm.entry_pmm)
. = ( 0xfd10e - code32flat_start ) ;
*16.*(.text.asm.entry_pnp_real)
. = ( 0xfd156 - code32flat_start ) ;
*16.*(.text.asm.entry_apm16)
. = ( 0xfd197 - code32flat_start ) ;
*16.*(.text.asm.entry_apm32)
. = ( 0xfd1c9 - code32flat_start ) ;
*16.*(.text.asm.entry_pcibios32)
. = ( 0xfd1f7 - code32flat_start ) ;
*16.*(.text.asm.entry_pcibios16)
. = ( 0xfd231 - code32flat_start ) ;
*16.*(.text.asm.entry_1589)
. = ( 0xfd26b - code32flat_start ) ;
*16.*(.text.asm.entry_bios32)
. = ( 0xfd28a - code32flat_start ) ;
*16.*(.text.asm.entry_sercon)
. = ( 0xfd2d1 - code32flat_start ) ;
*16.*(.text.asm.irqentry_extrastack)
. = ( 0xfd35e - code32flat_start ) ;
*16.*(.text.asm.irqentry_arg_extrastack)
. = ( 0xfd400 - code32flat_start ) ;
*16.*(.text.asm.entry_13)
. = ( 0xfd409 - code32flat_start ) ;
*16.*(.text.asm.entry_76)
. = ( 0xfd412 - code32flat_start ) ;
*16.*(.text.asm.entry_70)
. = ( 0xfd41b - code32flat_start ) ;
*16.*(.text.asm.entry_74)
. = ( 0xfd424 - code32flat_start ) ;
*16.*(.text.asm.entry_75)
. = ( 0xfd42d - code32flat_start ) ;
*16.*(.text.asm.entry_hwpic1)
. = ( 0xfd436 - code32flat_start ) ;
*16.*(.text.asm.entry_hwpic2)
. = ( 0xfd43f - code32flat_start ) ;
*16.*(.text.asm.entry_19)
. = ( 0xfd452 - code32flat_start ) ;
*16.*(.text.asm.entry_18)
. = ( 0xfd465 - code32flat_start ) ;
_rodata16 = . ;
*16.*(.rodata)
. = ( 0xfd8a8 - code32flat_start ) ;
*16.*(.rodata.__func__.0)
. = ( 0xfd8bc - code32flat_start ) ;
*16.*(.rodata.__func__.2)
. = ( 0xfd8c8 - code32flat_start ) ;
*16.*(.rodata.__func__.3)
. = ( 0xfd8d4 - code32flat_start ) ;
*16.*(.rodata.__func__.4)
. = ( 0xfd8e0 - code32flat_start ) ;
*16.*(.rodata.__func__.5)
. = ( 0xfd8f0 - code32flat_start ) ;
*16.*(.rodata.__func__.10)
. = ( 0xfd900 - code32flat_start ) ;
*16.*(.rodata.__func__.11)
. = ( 0xfd910 - code32flat_start ) ;
*16.*(.rodata.__func__.21)
. = ( 0xfd91c - code32flat_start ) ;
*16.*(.rodata.__func__.22)
. = ( 0xfd924 - code32flat_start ) ;
*16.*(.rodata.__func__.25)
. = ( 0xfd934 - code32flat_start ) ;
*16.*(.rodata.__func__.30)
. = ( 0xfd944 - code32flat_start ) ;
*16.*(.rodata.__func__.31)
. = ( 0xfd958 - code32flat_start ) ;
*16.*(.rodata.__func__.97)
. = ( 0xfd964 - code32flat_start ) ;
*16.*(.rodata.__func__.102)
. = ( 0xfd970 - code32flat_start ) ;
*16.*(.rodata.__func__.105)
. = ( 0xfd97c - code32flat_start ) ;
*16.*(.rodata.__func__.106)
. = ( 0xfd988 - code32flat_start ) ;
*16.*(.rodata.__func__.107)
. = ( 0xfd994 - code32flat_start ) ;
*16.*(.data16../src/hw/usb-hid.c.205)
. = ( 0xfd9c0 - code32flat_start ) ;
*16.*(.data16../src/hw/usb-hid.c.188)
. = ( 0xfdaa0 - code32flat_start ) ;
*16.*(.data16../src/cp437.c.11)
. = ( 0xfdca0 - code32flat_start ) ;
*16.*(.data16../src/sercon.c.554)
. = ( 0xfdd50 - code32flat_start ) ;
*16.*(.data16../src/sercon.c.70)
. = ( 0xfdd58 - code32flat_start ) ;
*16.*(.data16../src/kbd.c.374)
. = ( 0xfdd60 - code32flat_start ) ;
*16.*(.data16../src/kbd.c.371)
. = ( 0xfdd80 - code32flat_start ) ;
*16.*(.data16../src/kbd.c.279)
. = ( 0xfe048 - code32flat_start ) ;
*16.*(.data16../src/mouse.c.106)
. = ( 0xfe05b - code32flat_start ) ;
*16.*(.fixedaddr.0xe05b)
. = ( 0xfe079 - code32flat_start ) ;
*16.*(.text.fill_edd)
. = ( 0xfe2ae - code32flat_start ) ;
*16.*(.text.asm.entry_smi)
. = ( 0xfe2c3 - code32flat_start ) ;
*16.*(.fixedaddr.0xe2c3)
. = ( 0xfe2e8 - code32flat_start ) ;
*16.*(.text.sercon_lazy_flush)
. = ( 0xfe3f8 - code32flat_start ) ;
*16.*(.text.handle_hwpic1)
. = ( 0xfe3fe - code32flat_start ) ;
*16.*(.fixedaddr.0xe3fe)
. = ( 0xfe401 - code32flat_start ) ;
*32flat.*(.fixedaddr.0xe401)
. = ( 0xfe411 - code32flat_start ) ;
*16.*(.text.__ps2_command)
. = ( 0xfe674 - code32flat_start ) ;
*16.*(.text.floppy_wait_irq)
. = ( 0xfe6f2 - code32flat_start ) ;
*16.*(.fixedaddr.0xe6f2)
. = ( 0xfe6f5 - code32flat_start ) ;
*32flat.*(.fixedaddr.0xe6f5)
. = ( 0xfe6ff - code32flat_start ) ;
*16.*(.text.sercon_cursor_pos_set)
. = ( 0xfe729 - code32flat_start ) ;
*32flat.*(.fixedaddr.0xe729)
. = ( 0xfe739 - code32flat_start ) ;
*16.*(.fixedaddr.0xe739)
. = ( 0xfe742 - code32flat_start ) ;
*16.*(.text.handle_70)
. = ( 0xfe829 - code32flat_start ) ;
*16.*(.text.asm.irq_trampoline_0x1c)
. = ( 0xfe82e - code32flat_start ) ;
*16.*(.fixedaddr.0xe82e)
. = ( 0xfe837 - code32flat_start ) ;
*16.*(.text.handle_17)
. = ( 0xfe980 - code32flat_start ) ;
*16.*(.text.asm.irq_trampoline_0x1b)
. = ( 0xfe983 - code32flat_start ) ;
*16.*(.text.asm.irq_trampoline_0x19)
. = ( 0xfe987 - code32flat_start ) ;
*16.*(.fixedaddr.0xe987)
. = ( 0xfe990 - code32flat_start ) ;
*16.*(.text.handle_1a)
. = ( 0xfec0b - code32flat_start ) ;
*16.*(.text.asm.transition32)
. = ( 0xfec59 - code32flat_start ) ;
*16.*(.fixedaddr.0xec59)
. = ( 0xfec62 - code32flat_start ) ;
*16.*(.text.ehci_send_pipe.constprop.0)
. = ( 0xfef50 - code32flat_start ) ;
*16.*(.text.asm.irq_trampoline_0x18)
. = ( 0xfef53 - code32flat_start ) ;
*16.*(.text.asm.irq_trampoline_0x16)
. = ( 0xfef57 - code32flat_start ) ;
*16.*(.fixedaddr.0xef57)
. = ( 0xfef60 - code32flat_start ) ;
*16.*(.text.set_leds)
. = ( 0xfefc7 - code32flat_start ) ;
*32flat.*(.fixedaddr.0xefc7)
. = ( 0xfefd2 - code32flat_start ) ;
*16.*(.fixedaddr.0xefd2)
. = ( 0xfefdb - code32flat_start ) ;
*16.*(.text.sercon_print_utf8)
. = ( 0xff045 - code32flat_start ) ;
*16.*(.fixedaddr.0xf045)
. = ( 0xff046 - code32flat_start ) ;
*16.*(.text.timer_sleep)
. = ( 0xff065 - code32flat_start ) ;
*16.*(.fixedaddr.0xf065)
. = ( 0xff066 - code32flat_start ) ;
*16.*(.text.disk_1300)
. = ( 0xff0a4 - code32flat_start ) ;
*32flat.*(.fixedaddr.0xf0a4)
. = ( 0xff0fc - code32flat_start ) ;
*16.*(.text.handle_08)
. = ( 0xff570 - code32flat_start ) ;
*16.*(.text.megasas_process_op)
. = ( 0xff7cc - code32flat_start ) ;
*16.*(.text.ps2_sendbyte)
. = ( 0xff841 - code32flat_start ) ;
*16.*(.fixedaddr.0xf841)
. = ( 0xff84a - code32flat_start ) ;
*16.*(.text.handle_hwpic2)
. = ( 0xff84d - code32flat_start ) ;
*16.*(.fixedaddr.0xf84d)
. = ( 0xff856 - code32flat_start ) ;
*16.*(.text.handle_apm)
. = ( 0xff859 - code32flat_start ) ;
*16.*(.fixedaddr.0xf859)
. = ( 0xff869 - code32flat_start ) ;
*16.*(.text.esp_scsi_process_op)
. = ( 0xffa63 - code32flat_start ) ;
*16.*(.text.usleep)
. = ( 0xffa6e - code32flat_start ) ;
*32flat.*(.fixedaddr.0xfa6e)
. = ( 0xffe6e - code32flat_start ) ;
*16.*(.fixedaddr.0xfe6e)
. = ( 0xffe7e - code32flat_start ) ;
*16.*(.text.rtc_setup)
. = ( 0xffea5 - code32flat_start ) ;
*16.*(.fixedaddr.0xfea5)
. = ( 0xffeae - code32flat_start ) ;
*16.*(.text.ehci_reset_pipe)
. = ( 0xffef3 - code32flat_start ) ;
*32flat.*(.fixedaddr.0xfef3)
. = ( 0xfff00 - code32flat_start ) ;
*16.*(.text.sercon_lazy_lf)
. = ( 0xfff50 - code32flat_start ) ;
*16.*(.text.asm.irq_trampoline_0x4a)
. = ( 0xfff53 - code32flat_start ) ;
*16.*(.fixedaddr.0xff53)
. = ( 0xfff54 - code32flat_start ) ;
*16.*(.fixedaddr.0xff54)
. = ( 0xfff5d - code32flat_start ) ;
*16.*(.text.pci_next)
. = ( 0xffff0 - code32flat_start ) ;
*16.*(.fixedaddr.0xfff0)
. = ( 0xffff5 - code32flat_start ) ;
*32flat.*(.fixedaddr.0xfff5)
. = ( 0xffffe - code32flat_start ) ;
*32flat.*(.fixedaddr.0xfffe)
. = ( 0xfffff - code32flat_start ) ;
*32flat.*(.fixedaddr.0xffff)

        code32flat_end = ABSOLUTE(.) ;
    } :text


        /* Discard regular data sections to force a link error if
         * code attempts to access data not marked with VAR16 (or other
         * appropriate macro)
         */
        /DISCARD/ : {
                *(.text*) *(.data*) *(.bss*) *(.rodata*)
                *(COMMON) *(.discard*) *(.eh_frame) *(.note*)
                }
}

ENTRY(reset_vector)
PHDRS
{
        text PT_LOAD AT ( code32flat_start ) ;
}
